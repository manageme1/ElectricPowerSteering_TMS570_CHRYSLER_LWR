AUTOSAR XML (schema 3.1.2)
package /NEXTEER_DEF
  ecu parameter definition AUTOSARParameterDefinition: module=Metrics
  module definition Metrics [0..1]: variants post-build/pre-compile  # Configuration of the MyCompany Metrics (Diagnostic Event Manager) module.
    container MetricsConfigSet: multiple-configuration-container=true  # This container contains the configuration parameters and sub containers of the MyCompany Metrics module supporting multiple configuration sets. This container is a MultipleConfigurationContainer, i.e. this container and its sub-containers exist once per configuration set.
      enumeration MetricsEventKind: {Metrics_EVENT_KIND_BSW, Metrics_EVENT_KIND_SWC}  # This container contains the configuaration (parameters) for MetricsEventType. This parameter is used to distinguish between SW-C and BSW events. SW-C events are for Metrics_SetEventStatus API and BSW events are for Metrics_ReportErrorStatus API.
      reference OsTaskRef: destination=OsTask  # This defines the Task which contains the runnables for which run-time monitoring is desired.
    container MetricsGeneral  # This container contains the configuration (parameters) of the MyCompany Metrics
      boolean MetricsDevErrorDetect: set at pre-compile  # Activate/Deactivate the Development Error Detection and Notification. true: Development Error Detection and Notification activated false: Development Error Detection and Notification deactivated
      boolean MetricsVersionInfoApi: set at pre-compile  # Activate/Deactivate the version information API. true: version information activated false: version information deactivated
