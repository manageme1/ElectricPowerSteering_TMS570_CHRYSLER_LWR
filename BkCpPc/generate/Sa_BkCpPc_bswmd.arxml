AUTOSAR XML (schema 3.1.2)
package /NEXTEER_DEF
  ecu parameter definition AUTOSARParameterDefinition: module=BkCpPc
  module definition BkCpPc [0..1]: variants post-build/pre-compile  # Configuration of the MyCompany BkCpPc module.
    container BkCpPcGeneral  # This container contains the configuration (parameters) of the BkCpPc watchdog checkpoints.
      enumeration BkCpPcCPEnable [0..255]: {BkCpP_Per1_CP0, BkCpP_Per1_CP1}, origin=NEXTEER  # This container contains the configuaration (parameters) for the BkCpPc watchdog checkpoints.
      integer BkCpPcPwrDiscConfiguration: 1..2, {1, 2}, set at pre-compile in variant pre-compile+link-time / post-build in variant post-build, origin=Nexteer, default-value=1  # A program specific power disconnect configuration variable: 1 - Configuration A (Power Disconnect supplies power to gate drive only. Bridge and Bulk cap are hot at all times). 2 - Configuration B (Power Disconnect supplies power to gate drive, bridge and bulk cap). (ES-11B)
    container CommonPublishedInformation  # Common container, aggregated by all modules. It contains published information about vendor and versions.
      integer ArMajorVersion: set at published-information, origin=Nexteer, default-value=3  # Major version number of AUTOSAR specification on which the appropriate implementation is based on.
      integer ArMinorVersion: set at published-information, origin=Nexteer, default-value=2  # Minor version number of AUTOSAR specification on which the appropriate implementation is based on.
      integer ArPatchVersion: set at published-information, origin=Nexteer, default-value=0  # Patch level version number of AUTOSAR specification on which the appropriate implementation is based on.
      integer SwMajorVersion: set at published-information, origin=Nexteer, default-value=0  # Major version number of the vendor specific implementation of the module.
      integer SwMinorVersion: set at published-information, origin=BMW GroupNexteer, default-value=0  # Minor version number of the vendor specific implementation of the module. The numbering is vendor specific.
      integer SwPatchVersion: set at published-information, origin=Nexteer, default-value=0  # Patch level version number of the vendor specific implementation of the module. The numbering is vendor specific.
      integer ModuleId: set at published-information, origin=Nexteer, default-value=0  # Module ID of this module from Module List
      integer VendorId: set at published-information, origin=Nexteer, default-value=0  # Vendor ID of the dedicated implementation of this module according to the AUTOSAR vendor list
      string VendorApiInfix [0..1]: set at published-information, origin=Nexteer
