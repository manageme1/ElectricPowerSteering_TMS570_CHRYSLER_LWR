AUTOSAR XML (schema 314)
package /ModeDclrGroup
  mode declaration group StaMd_Mode: initial-mode=WARMINIT  # EPS System State mode declaration
    4 x mode:
      DISABLE
      OFF
      OPERATE
      WARMINIT
package /PortInterface
  9 x client server interface:
    GeneratePosTraj_SCom  # Serial communication port for setting and getting a sdoftware component parameter. The parameter is typically an EOL parameter.
      operation GetPosTrajStatus
        arg PosTrajStatusDatPtr: type=Boolean, direction=OUT
      operation SetInputParam
        4 x arg, all with direction=IN:
          PosServHwAngle_HwDeg_f32: type=Float
          TargetVelocity_HwDegpSec_f32: type=Float
          TargetAcceleration_HwDegpSecSqr_f32: type=Float
          PosTrajEnable_Cnt_lgc: type=Boolean
      error ConditionsNotCorrect: error-code=34
      error RequestOutOfRange: error-code=49
    LearnPinionCtr_SCom  # Serial communication port for setting and getting a sdoftware component parameter. The parameter is typically an EOL parameter.
      operation GetLearnPinionCtrStatus
        arg LearnPinionCtrStatusDatPtr: type=Boolean, direction=OUT
      operation SetInputParam
        arg LearnPinionCtrEnable_lgc: type=Boolean, direction=IN
      error ConditionsNotCorrect: error-code=34
      error RequestOutOfRange: error-code=49
    NvM_AC3_SRBS_Srv: is-service=true  # Port Interface for NVRAM Blocks of Management Types "NATIVE" or "REDUNDANT" without default values.
      6 x operation:
        EraseBlock: possible-error=NvM_AC3_SRBS_Srv/E_NOT_OK
        GetErrorStatus
          arg ErrorStatus: type=NvM_RequestResultType, direction=OUT
        InvalidateNvBlock: possible-error=NvM_AC3_SRBS_Srv/E_NOT_OK
        ReadBlock: possible-error=NvM_AC3_SRBS_Srv/E_NOT_OK
          arg DstPtr: type=NvM_DestPtr, direction=OUT
        SetRamBlockStatus
          arg RamBlockStatus: type=Boolean, direction=IN
        WriteBlock: possible-error=NvM_AC3_SRBS_Srv/E_NOT_OK
          arg DstPtr: type=NvM_DestPtr, direction=IN
      error E_NOT_OK: error-code=1
    NxtrDiagMgr
      5 x operation, all with possible-error=NxtrDiagMgr/E_NOT_OK:
        GetNTCFailed
          arg NTC: type=NTCNumber, direction=IN
          arg EventFailed: type=Boolean, direction=OUT
        GetNTCStatus
          arg NTC: type=NTCNumber, direction=IN
          arg Status: type=UInt8, direction=OUT
        ResetEventStatus
        SetNTCStatus
          arg NTC: type=NTCNumber, direction=IN
          arg Param: type=UInt8, direction=IN
          arg Status: type=NxtrDiagMgrStatus, direction=IN
        SetOperationCycleState
          arg OperationCycle: type=NxtrOpCycle, direction=IN
          arg CycleState: type=NxtrOpCycleState, direction=IN
      error E_NOT_OK: error-code=1
    OscTraj_SCom  # Serial communication port for passing input parameters to and returning the status of "OscTraj".
      operation GetOscStatus
        arg OscTrajStatus: type=Boolean, direction=OUT
      operation SetInputParams
        5 x arg, all with direction=IN:
          Amplitude_HwDeg_f32: type=Float
          CalculateFlag_Cnt_lgc: type=Boolean
          Cycles_Cnt_u08: type=UInt8
          Frequency_Hz_f32: type=Float
          HandwheelPosition_HwDeg_f32: type=Float
    SCom_ParEng  # Serial communication port for setting and getting a sdoftware component parameter. The parameter is typically an EOL parameter.
      operation Get
        arg Par_f32: type=Float, direction=OUT
      operation Set
        arg Par_f32: type=Float, direction=IN
      error ConditionsNotCorrect: error-code=34
      error RequestOutOfRange: error-code=49
    Scom_RtnAsync  # Serial communication port for activating a remote asynchronous routine
      operation Start: possible-error=Scom_RtnAsync/ConditionsNotCorrect
      operation Status: possible-error=Scom_RtnAsync/ConditionsNotCorrect
        arg status: type=RoutineStatus, direction=OUT
      operation Stop: possible-error=Scom_RtnAsync/ConditionsNotCorrect
      error ConditionsNotCorrect: error-code=34
      error RequestOutOfRange: error-code=49
    SCom_RtnSync  # Serial communication port for activating a remote synchronous routine
      operation Start: possible-error=SCom_RtnSync/ConditionsNotCorrect
      error ConditionsNotCorrect: error-code=34
      error RequestOutOfRange: error-code=49
    SystemTime: is-service=true
      6 x operation:
        DtrmnElapsedTime_mS_u16  # MyCompany SystemTime Service
          arg InitialTime: type=UInt32, direction=IN
          arg ElapsedTime: type=UInt16, direction=OUT
        DtrmnElapsedTime_mS_u32
          arg InitialTime: type=UInt32, direction=IN
          arg ElapsedTime: type=UInt32, direction=OUT
        DtrmnElapsedTime_uS_u16
          arg InitialTime: type=UInt32, direction=IN
          arg ElapsedTime: type=UInt16, direction=OUT
        DtrmnElapsedTime_uS_u32
          arg InitialTime: type=UInt32, direction=IN
          arg ElapsedTime: type=UInt32, direction=OUT
        GetSystemTime_mS_u32
          arg CurrentTime: type=UInt32, direction=OUT
        GetSystemTime_uS_u32
          arg CurrentTime: type=UInt32, direction=OUT
  36 x sender receiver interface:
    Authority
      data Uls_f32: sw-calibration-access=READ-ONLY, type=Float
    BoolStatusFlag
      data Cnt_lgc: sw-calibration-access=READ-ONLY, type=Boolean
    Counter
      data Cnt_u08: type=UInt8
    Current
      data Amp_f32: sw-calibration-access=READ-ONLY, type=Float
    Cycles
      data Cnt_u08: sw-calibration-access=READ-ONLY, type=UInt8
    Direction
      data Cnt_s08: sw-calibration-access=READ-ONLY, type=SInt8
    Enable
      data Cnt_lgc: sw-calibration-access=READ-ONLY, type=Boolean
    ForcekN
      data kN_f32: type=Float
    Frequency
      data Hz_f32: sw-calibration-access=READ-ONLY, type=Float
    HwAccel
      data HwDegpSecSqr_f32: sw-calibration-access=READ-ONLY, type=Float
    HwPos
      data HwDeg_f32: sw-calibration-access=READ-ONLY, type=Float
    HwTrq
      data HwNm_f32: sw-calibration-access=READ-ONLY, type=Float
    HwVel
      data HwRadpS_f32: sw-calibration-access=READ-ONLY, type=Float
    HwVelDegpSec
      data HwDegpSec_f32: sw-calibration-access=READ-ONLY, type=Float
    Inductance
      data Henry_f32: sw-calibration-access=READ-ONLY, type=Float
    ManufModes
      data Cnt_enum: sw-calibration-access=READ-ONLY, type=ManufModeType
    MtrPosDeg
      data Deg_f32: sw-calibration-access=READ-ONLY, type=Float
    MtrPosRev
      data Rev_f32: sw-calibration-access=READ-ONLY, type=Float
    MtrQuad
      data Cnt_u08: sw-calibration-access=READ-ONLY, type=UInt8
    MtrTrq
      data MtrNm_f32: sw-calibration-access=READ-ONLY, type=Float
    MtrVel
      data MtrRadpS_f32: sw-calibration-access=READ-ONLY, type=Float
    MtrVltConstant
      data VpRadpS_f32: sw-calibration-access=READ-ONLY, type=Float
    PhsAdv
      data Cnt_s16: sw-calibration-access=READ-ONLY, type=SInt16
    PkCurr
      data AmpSq_f32: sw-calibration-access=READ-ONLY, type=Float
    RampRate
      data XpmS_f32: sw-calibration-access=READ-ONLY, type=Float
    Resistance
      data Ohm_f32: sw-calibration-access=READ-ONLY, type=Float
    ScaleFactor
      data Uls_f32: sw-calibration-access=READ-ONLY, type=Float
    SystemState
      mode declaration group prototype Mode: type=StaMd_Mode
    Temperature
      data DegC_f32: sw-calibration-access=READ-ONLY, type=Float
    UnityScalar
      data Uls_f32: sw-calibration-access=READ-ONLY, type=Float
    Validity
      data Cnt_lgc: sw-calibration-access=READ-ONLY, type=Boolean
    Vecu
      data Volt_f32: sw-calibration-access=READ-ONLY, range raw >5..<31, type=Float  # This port prototype is inteded to communicate voltage signals that represent the ecu supplied voltage. This signal has a lower limit, which is non-zero, to allow users of the signal to use it as a denominator in an expression without requiring a divide by 0 check.
    VehAccel
      data KphpS_f32: sw-calibration-access=READ-ONLY, type=Float
    VehSpd
      data Kph_f32: sw-calibration-access=READ-ONLY, type=Float
    VltgCtrlTerm
      data Uls_f32: sw-calibration-access=READ-ONLY, type=Float
    Voltage
      data Volt_f32: sw-calibration-access=READ-ONLY, range raw >0..<31, type=Float  # This signal is intended to communicate any type voltage signal measured by the ecu. This signal has a lower limit of 0 which reequires users of the signal to provide divide by 0 protection if it is used as a denominator in a calculation. See Vecu port prototype if a port with a lower limit is desired.
