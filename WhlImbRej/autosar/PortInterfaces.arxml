AUTOSAR XML (schema 314)
package /ModeDclrGroup
  mode declaration group StaMd_Mode: initial-mode=WARMINIT  # EPS System State mode declaration
    4 x mode:
      DISABLE
      OFF
      OPERATE
      WARMINIT
package /PortInterface
  client server interface NxtrDiagMgr
    4 x operation, all with possible-error=E_NOT_OK:
      GetNTCActive
        arg NTC_Cnt_T_enum: type=NTCNumber, direction=IN
        arg NTCActive_Ptr_T_lgc: type=Boolean, direction=OUT
      GetNTCFailed
        arg NTC_Cnt_T_enum: type=NTCNumber, direction=IN
        arg NTCFailed_Ptr_T_lgc: type=Boolean, direction=OUT
      GetNTCStatus
        arg NTC_Cnt_T_enum: type=NTCNumber, direction=IN
        arg Status_Ptr_T_u08: type=UInt8, direction=OUT
      SetNTCStatus
        arg NTC_Cnt_T_enum: type=NTCNumber, direction=IN
        arg Param_Cnt_T_u08: type=UInt8, direction=IN
        arg Status_Cnt_T_enum: type=NxtrDiagMgrStatus, direction=IN
    error E_NOT_OK: error-code=1
  client server interface SystemTime: is-service=true
    6 x operation:
      DtrmnElapsedTime_mS_u16  # MyCompany SystemTime Service
        arg InitialTime: type=UInt32, direction=IN
        arg ElapsedTime: type=UInt16, direction=OUT
      DtrmnElapsedTime_mS_u32
        arg InitialTime: type=UInt32, direction=IN
        arg ElapsedTime: type=UInt32, direction=OUT
      DtrmnElapsedTime_uS_u16
        arg InitialTime: type=UInt32, direction=IN
        arg ElapsedTime: type=UInt16, direction=OUT
      DtrmnElapsedTime_uS_u32
        arg InitialTime: type=UInt32, direction=IN
        arg ElapsedTime: type=UInt32, direction=OUT
      GetSystemTime_mS_u32
        arg CurrentTime: type=UInt32, direction=OUT
      GetSystemTime_uS_u32
        arg CurrentTime: type=UInt32, direction=OUT
  client server interface WhlImbRej_SCom
    operation GetWIRInfo
      5 x arg, all with direction=OUT:
        WIRCmpActRng{1..3}Ptr_Cnt_u32: type=UInt32
        AlgFltStatusPtr_Cnt_b16: type=UInt16
        WIRMaxCompPtr_Pct_f32: type=Float
  7 x sender receiver interface:
    BoolStatusFlag_Cnt_lgc
      data Cnt_lgc: sw-calibration-access=READ-ONLY, type=Boolean
    Enable_Cnt_lgc
      data Cnt_lgc: sw-calibration-access=READ-ONLY, type=Boolean
    Frequency_Hz_f32
      data Hz_f32: sw-calibration-access=READ-ONLY, type=Float
    HwTrq_HwNm_f32
      data HwNm_f32: sw-calibration-access=READ-ONLY, type=Float
    MtrTrq_MtrNm_f32
      data MtrNm_f32: sw-calibration-access=READ-ONLY, type=Float
    SystemState
      mode declaration group prototype Mode: type=StaMd_Mode
    VehSpd_Kph_f32
      data Kph_f32: sw-calibration-access=READ-ONLY, type=Float
