AUTOSAR XML (schema 3.1.2)
package /NEXTEER_DEF
  ecu parameter definition AUTOSARParameterDefinition: module=HwPwUp
  module definition HwPwUp [0..1]: variants post-build/pre-compile  # Configuration of the MyCompany HwPwUp module.
    container HwPwUpGeneral  # This container contains the configuration (parameters) of the HwPwUp watchdog checkpoints.
      enumeration HwPwUpCPEnable [0..255]: {HwPwUp_Per1_CP0, HwPwUp_Per1_CP1}, origin=NEXTEER  # This container contains the configuaration (parameters) for the HwPwUp watchdog checkpoints.
      integer HwPwUpPgmSpecMask: 0..65535, set at pre-compile in variant pre-compile+link-time / post-build in variant post-build, origin=Nexteer, default-value=0  # A program specific mask that allows the ability to turn off different parts of the startup sequence as necessary. (ES-13B K_PgmSpecMask)
    container CommonPublishedInformation  # Common container, aggregated by all modules. It contains published information about vendor and versions.
      integer ArMajorVersion: set at published-information, origin=Nexteer, default-value=3  # Major version number of AUTOSAR specification on which the appropriate implementation is based on.
      integer ArMinorVersion: set at published-information, origin=Nexteer, default-value=2  # Minor version number of AUTOSAR specification on which the appropriate implementation is based on.
      integer ArPatchVersion: set at published-information, origin=Nexteer, default-value=0  # Patch level version number of AUTOSAR specification on which the appropriate implementation is based on.
      integer SwMajorVersion: set at published-information, origin=Nexteer, default-value=0  # Major version number of the vendor specific implementation of the module.
      integer SwMinorVersion: set at published-information, origin=BMW GroupNexteer, default-value=0  # Minor version number of the vendor specific implementation of the module. The numbering is vendor specific.
      integer SwPatchVersion: set at published-information, origin=Nexteer, default-value=0  # Patch level version number of the vendor specific implementation of the module. The numbering is vendor specific.
      integer ModuleId: set at published-information, origin=Nexteer, default-value=0  # Module ID of this module from Module List
      integer VendorId: set at published-information, origin=Nexteer, default-value=0  # Vendor ID of the dedicated implementation of this module according to the AUTOSAR vendor list
      string VendorApiInfix [0..1]: set at published-information, origin=Nexteer
