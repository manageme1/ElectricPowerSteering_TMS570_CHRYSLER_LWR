AUTOSAR XML (schema 314)
package /ModeDclrGroup
  mode declaration group StaMd_Mode: initial-mode=WARMINIT  # EPS System State mode declaration
    4 x mode:
      DISABLE
      OFF
      OPERATE
      WARMINIT
package /PortInterface
  8 x client server interface:
    FetDrvCntl
      operation OP_GET: possible-error=FetDrvCntl/E_NOT_OK
        arg signal: type=IoHwAb_BoolType, direction=OUT
      error E_NOT_OK: error-code=1
    NxtrDiagMgr
      4 x operation, all with possible-error=NxtrDiagMgr/E_NOT_OK:
        GetNTCActive
          arg NTC_Cnt_T_enum: type=NTCNumber, direction=IN
          arg NTCActive_Ptr_T_lgc: type=Boolean, direction=OUT
        GetNTCFailed
          arg NTC_Cnt_T_enum: type=NTCNumber, direction=IN
          arg NTCFailed_Ptr_T_lgc: type=Boolean, direction=OUT
        GetNTCStatus
          arg NTC_Cnt_T_enum: type=NTCNumber, direction=IN
          arg Status_Ptr_T_u08: type=UInt8, direction=OUT
        SetNTCStatus
          arg NTC_Cnt_T_enum: type=NTCNumber, direction=IN
          arg Param_Cnt_T_u08: type=UInt8, direction=IN
          arg Status_Cnt_T_enum: type=NxtrDiagMgrStatus, direction=IN
      error E_NOT_OK: error-code=1
    PwrSwitchEn
      operation OP_GET: possible-error=PwrSwitchEn/E_NOT_OK
        arg signal: type=IoHwAb_BoolType, direction=OUT
      error E_NOT_OK: error-code=1
    SysFault2
      operation OP_GET: possible-error=SysFault2/E_NOT_OK
        arg signal: type=IoHwAb_BoolType, direction=OUT
      operation OP_SET: possible-error=SysFault2/E_NOT_OK
        arg signal: type=IoHwAb_BoolType, direction=IN
      error E_NOT_OK: error-code=1
    SysFault3
      operation OP_GET: possible-error=SysFault3/E_NOT_OK
        arg signal: type=IoHwAb_BoolType, direction=OUT
      operation OP_SET: possible-error=SysFault3/E_NOT_OK
        arg signal: type=IoHwAb_BoolType, direction=IN
      error E_NOT_OK: error-code=1
    SystemTime: is-service=true
      6 x operation:
        DtrmnElapsedTime_mS_u16  # MyCompany SystemTime Service
          arg InitialTime: type=UInt32, direction=IN
          arg ElapsedTime: type=UInt16, direction=OUT
        DtrmnElapsedTime_mS_u32
          arg InitialTime: type=UInt32, direction=IN
          arg ElapsedTime: type=UInt32, direction=OUT
        DtrmnElapsedTime_uS_u16
          arg InitialTime: type=UInt32, direction=IN
          arg ElapsedTime: type=UInt16, direction=OUT
        DtrmnElapsedTime_uS_u32
          arg InitialTime: type=UInt32, direction=IN
          arg ElapsedTime: type=UInt32, direction=OUT
        GetSystemTime_mS_u32
          arg CurrentTime: type=UInt32, direction=OUT
        GetSystemTime_uS_u32
          arg CurrentTime: type=UInt32, direction=OUT
    WdMonitor
      operation OP_SET: possible-error=WdMonitor/E_NOT_OK
        arg signal: type=IoHwAb_BoolType, direction=IN
      error E_NOT_OK: error-code=1
    WdReset
      operation OP_SET: possible-error=WdReset/E_NOT_OK
        arg signal: type=IoHwAb_BoolType, direction=IN
      error E_NOT_OK: error-code=1
  sender receiver interface BoolStatusFlag_Cnt_lgc
    data Cnt_lgc: sw-calibration-access=READ-ONLY, type=Boolean
  sender receiver interface Enable_Cnt_lgc
    data Cnt_lgc: sw-calibration-access=READ-ONLY, type=Boolean
  sender receiver interface SystemState
    mode declaration group prototype Mode: type=StaMd_Mode
