AUTOSAR XML (schema 3.1.2)
package /NEXTEER_DEF
  ecu parameter definition AUTOSARParameterDefinition: module=PwrLmtFuncCr
  module definition PwrLmtFuncCr [0..1]: variants post-build/pre-compile  # Configuration of the MyCompany PwrLmtFuncCr module.
    container PwrLmtFuncCrGeneral  # This container contains the configuration (parameters) of the PwrLmtFuncCr watchdog checkpoints.
      enumeration PwrLmtFuncCrCPEnable [0..255]: {PwrLmtFuncCr_Per1_CP0, PwrLmtFuncCr_Per1_CP1, PwrLmtFuncCr_Per2_CP0, PwrLmtFuncCr_Per2_CP1}, origin=NEXTEER  # This container contains the configuaration (parameters) for the PwrLmtFuncCr watchdog checkpoints.
    container CommonPublishedInformation  # Common container, aggregated by all modules. It contains published information about vendor and versions.
      integer ArMajorVersion: set at published-information, origin=Nexteer, default-value=3  # Major version number of AUTOSAR specification on which the appropriate implementation is based on.
      integer ArMinorVersion: set at published-information, origin=Nexteer, default-value=2  # Minor version number of AUTOSAR specification on which the appropriate implementation is based on.
      integer ArPatchVersion: set at published-information, origin=Nexteer, default-value=0  # Patch level version number of AUTOSAR specification on which the appropriate implementation is based on.
      integer SwMajorVersion: set at published-information, origin=Nexteer, default-value=0  # Major version number of the vendor specific implementation of the module.
      integer SwMinorVersion: set at published-information, origin=BMW GroupNexteer, default-value=0  # Minor version number of the vendor specific implementation of the module. The numbering is vendor specific.
      integer SwPatchVersion: set at published-information, origin=Nexteer, default-value=0  # Patch level version number of the vendor specific implementation of the module. The numbering is vendor specific.
      integer ModuleId: set at published-information, origin=Nexteer, default-value=0  # Module ID of this module from Module List
      integer VendorId: set at published-information, origin=Nexteer, default-value=0  # Vendor ID of the dedicated implementation of this module according to the AUTOSAR vendor list
      string VendorApiInfix [0..1]: set at published-information, origin=Nexteer
