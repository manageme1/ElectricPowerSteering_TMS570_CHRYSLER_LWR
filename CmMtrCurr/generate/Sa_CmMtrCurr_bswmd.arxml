AUTOSAR XML (schema 3.1.2)
package /NEXTEER_DEF
  ecu parameter definition AUTOSARParameterDefinition: module=CmMtrCurr
  module definition CmMtrCurr [0..1]: variants post-build/pre-compile  # Configuration of the MyCompany CmMtrCurr module.
    container CmMtrCurrGeneral  # This container contains the configuration (parameters) of the CmMtrCurr watchdog checkpoints.
      enumeration CmMtrCurrCPEnable [0..255]: {CmMtrCurr_Per1_CP0, CmMtrCurr_Per1_CP1, CmMtrCurr_Per2_CP0, CmMtrCurr_Per2_CP1, CmMtrCurr_Per3_CP0, CmMtrCurr_Per3_CP1}, origin=NEXTEER  # This container contains the configuaration (parameters) for the CmMtrCurr watchdog checkpoints.
    container CommonPublishedInformation  # Common container, aggregated by all modules. It contains published information about vendor and versions.
      integer ArMajorVersion: set at published-information, origin=Nexteer, default-value=3  # Major version number of AUTOSAR specification on which the appropriate implementation is based on.
      integer ArMinorVersion: set at published-information, origin=Nexteer, default-value=2  # Minor version number of AUTOSAR specification on which the appropriate implementation is based on.
      integer ArPatchVersion: set at published-information, origin=Nexteer, default-value=0  # Patch level version number of AUTOSAR specification on which the appropriate implementation is based on.
      integer SwMajorVersion: set at published-information, origin=Nexteer, default-value=0  # Major version number of the vendor specific implementation of the module.
      integer SwMinorVersion: set at published-information, origin=BMW GroupNexteer, default-value=0  # Minor version number of the vendor specific implementation of the module. The numbering is vendor specific.
      integer SwPatchVersion: set at published-information, origin=Nexteer, default-value=0  # Patch level version number of the vendor specific implementation of the module. The numbering is vendor specific.
      integer ModuleId: set at published-information, origin=Nexteer, default-value=0  # Module ID of this module from Module List
      integer VendorId: set at published-information, origin=Nexteer, default-value=0  # Vendor ID of the dedicated implementation of this module according to the AUTOSAR vendor list
      string VendorApiInfix [0..1]: set at published-information, origin=Nexteer
    container CmMtrCurrPhaseConfig  # This container contains the configuaration phase(parameters) for the CmMtrCurr.
      enumeration CmMtrCurrConfig: {MTRCURRPHASEBC, MTRCURRPHASECB, MTRCURRPHASECA, MTRCURRPHASEAC, MTRCURRPHASEAB, MTRCURRPHASEBA}, origin=NEXTEER  # This container contains the configuration (parameters) of the CmMtrCurr Phase Configuration. The phase may be BC, CB, AB, BA, AC, CA. Choose the configuration based on program requirements.
