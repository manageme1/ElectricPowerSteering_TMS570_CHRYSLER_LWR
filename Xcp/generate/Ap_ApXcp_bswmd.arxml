AUTOSAR XML (schema 3.1.2)
package /NEXTEER_DEF
  ecu parameter definition AUTOSARParameterDefinition: module=Xcp
  module definition ApXcp [0..1]: variants post-build/pre-compile  # Configuration of the MyCompany Xcp module.
    container XcpGeneral  # This container contains the configuration (parameters) of the Xcp Module
      enumeration ExternalEEPROMAccess: {STD_OFF, STD_ON}, origin=NEXTEER  # This swithces on the direct read/write access to external eeprom via EEP BSW
      string XcpIncludes [0..255]: origin=NEXTEER, set at pre-compile in variant pre-compile+link-time / post-build in variant post-build  # Include list for Xcp.
      string XcpRteEvents [0..255]: origin=NEXTEER, symbolic-name-value=true, set at pre-compile in variant pre-compile+link-time / post-build in variant post-build  # This defines the configured Xcp Events for which an Rte runnable should be generated to allow scheduling of the Xcp Event in the Rte authoring tool. At the moment this is a string type parameter instead of a reference to the Xcp configuration container in the ECUC file because some applications are configuring Xcp via a GENy config file instead of the ECUC because of a non-AUTOSAR Com stack.
    container XcpMemoryAccess [0..1]  # This container contains Memory Regions allowed for XCP access
      container InternalMemoryRng [0..32767]: multiple-configuration-container=true  # This container specifies the start and end addresses for allowed memory accesses.
        integer IntMemRngLow: 0..4294967295, set at pre-compile in variant pre-compile+link-time / post-build in variant post-build, origin=Nexteer  # Lower address boundary for allowed internal memory access region (e.g. RAM, FLASH, Registers).
        integer IntMemRngHigh: 0..4294967295, set at pre-compile in variant pre-compile+link-time / post-build in variant post-build, origin=Nexteer  # Upper address boundary for allowed memory access region.
      container ExternalMemoryRng [0..32767]  # Lower address boundary for allowed external memory access region (e.g. EEPROM).
        integer ExtMemRngLow: 0..4294967295, set at pre-compile in variant pre-compile+link-time / post-build in variant post-build, origin=Nexteer  # Lower address boundary for allowed external memory access region.
        integer ExtMemRngHigh: 0..4294967295, set at pre-compile in variant pre-compile+link-time / post-build in variant post-build, origin=Nexteer  # Upper address boundary for allowed external memory access region.
    container RamCopy  # This container contains information to copy calibration memory from flash to ram
      container CopyRegion [0..32767]: multiple-configuration-container=true  # This container specifies information needed to copy from flash to ram.
        string RAMStartLinkerSymbol: set at pre-compile in variant pre-compile+link-time / post-build in variant post-build, origin=Nexteer
        string FlashStartLinkerSymbol: set at pre-compile in variant pre-compile+link-time / post-build in variant post-build, origin=Nexteer
        string LengthLinkerSymbol: set at pre-compile in variant pre-compile+link-time / post-build in variant post-build, origin=Nexteer
    container TuneOnTheFly  # This container contains information to support the tune on the fly feature.
      enumeration TuneOnTheFlySupport: {STD_OFF, STD_ON}, origin=NEXTEER  # This swithces on XCP support for TuneOnTheFly
      integer RamBlockSize: 0..4294967295, set at pre-compile in variant pre-compile+link-time / post-build in variant post-build, origin=Nexteer  # This value is the size of the RAM block allowed for TOTF. This will also be the size of Segment 16's data array.
      string TuneOnTheFlyIncludes [0..255]: origin=NEXTEER, set at pre-compile in variant pre-compile+link-time / post-build in variant post-build  # Include list for TOTF.
      container Seg0_Pers  # Segment 0 represents a single or multiple tuning personalities to be loaded into RAM.
        enumeration Seg0Enable: {STD_OFF, STD_ON}, origin=NEXTEER  # Enables or Disables Segment 0
        integer MaxPerCopy: 1..255, set at pre-compile in variant pre-compile+link-time / post-build in variant post-build, origin=Nexteer  # Number of personalities to copy to RAM for segment 0.
        string CalConstNumOfPerSymbol: set at pre-compile in variant pre-compile+link-time / post-build in variant post-build, origin=Nexteer  # Symbol name of the constant for the number of personalities in the CalConstants.h file.
        enumeration TuneOnTheFlyPersLkup: {STD_OFF, STD_ON}, origin=NEXTEER  # This allows calling an external function to get the personality index for Tune on the Fly. Note this is ignored if TOTF is turned off
      container Seg1_Sets  # Segment 0 represents a single or multiple tuning sets to be loaded into RAM.
        enumeration Seg1Enable: {STD_OFF, STD_ON}, origin=NEXTEER  # Enables or Disables Segment 1
        integer MaxSetCopy: 1..255, set at pre-compile in variant pre-compile+link-time / post-build in variant post-build, origin=Nexteer  # Number of sets to copy to RAM for segment 1.
        string CalConstNumOfSetSymbol: set at pre-compile in variant pre-compile+link-time / post-build in variant post-build, origin=Nexteer  # Symbol name of the constant for the number of sets in the CalConstants.h file.
        enumeration TuneOnTheFlySetLkup: {STD_OFF, STD_ON}, origin=NEXTEER  # This allows calling an external function to get the tuning set index for Tune on the Fly. Note this is ignored if TOTF is turned off
      container Seg2_Common  # Segment 2 represents the common calibrations to be copied into RAM.
        enumeration Seg2Enable: {STD_OFF, STD_ON}, origin=NEXTEER  # Enables or Disables Segment 2
      container Seg3_SetAndPer  # Segment 3 represents the active tuning set and personality to be copied into RAM.
        enumeration Seg3Enable: {STD_OFF, STD_ON}, origin=NEXTEER  # Enables or Disables Segment 3
      container Seg4_SetAndPerAndCommon  # Segment 4 represents the active tuning set and personality and common cals to be copied into RAM.
        enumeration Seg4Enable: {STD_OFF, STD_ON}, origin=NEXTEER  # Enables or Disables Segment 4
      container Seg16_CustomDefinedMemBlock [0..1]  # Segment 16 is a custom defined memory block that uses a linker symbol for the address and length of the data to be copied into RAM.
        string FlashStartLinkerSymbol: set at pre-compile in variant pre-compile+link-time / post-build in variant post-build, origin=Nexteer
        string LengthLinkerSymbol: set at pre-compile in variant pre-compile+link-time / post-build in variant post-build, origin=Nexteer
    container CommonPublishedInformation  # Common container, aggregated by all modules. It contains published information about vendor and versions.
      integer ArMajorVersion: set at published-information, origin=Nexteer, default-value=3  # Major version number of AUTOSAR specification on which the appropriate implementation is based on.
      integer ArMinorVersion: set at published-information, origin=Nexteer, default-value=2  # Minor version number of AUTOSAR specification on which the appropriate implementation is based on.
      integer ArPatchVersion: set at published-information, origin=Nexteer, default-value=0  # Patch level version number of AUTOSAR specification on which the appropriate implementation is based on.
      integer SwMajorVersion: set at published-information, origin=Nexteer, default-value=0  # Major version number of the vendor specific implementation of the module.
      integer SwMinorVersion: set at published-information, origin=BMW GroupNexteer, default-value=0  # Minor version number of the vendor specific implementation of the module. The numbering is vendor specific.
      integer SwPatchVersion: set at published-information, origin=Nexteer, default-value=0  # Patch level version number of the vendor specific implementation of the module. The numbering is vendor specific.
      integer ModuleId: set at published-information, origin=Nexteer, default-value=0  # Module ID of this module from Module List
      integer VendorId: set at published-information, origin=Nexteer, default-value=0  # Vendor ID of the dedicated implementation of this module according to the AUTOSAR vendor list
      string VendorApiInfix [0..1]: set at published-information, origin=Nexteer
