/*
COPYRIGHT
Copyright (c) 2006-2011 by Vctr Informatik GmbH. All rights reserved.
This software is copyright protected and proprietary to Vctr Informatik GmbH.
Vctr Informatik GmbH grants to you only those rights as set out in the license conditions.
License:  License CBD1010124 valid for CBD1010124 MyCompany  Package: BMW MSR SIP BAC3.0 Micro: TI TMS570 TMS570LS30306  Compiler: Code Composer Studio 4.9.0
*/
/begin MEASUREMENT CDDInterface.SysCCorrectedMtrPos.Rev_f32 "MICROSAR RTE" FLOAT32_IEEE NO_COMPU_METHOD 0 0 1.175494351e-38 3.402823466e+38 ECU_ADDRESS 0 SYMBOL_LINK "Rte_CDDInterface_SysCCorrectedMtrPos_Rev_f32" 0 DISPLAY_IDENTIFIER CDDInterface.SenderPorts.SysCCorrectedMtrPos.Rev_f32 /end MEASUREMENT
/begin MEASUREMENT CDDInterface.SystemState.Mode "MICROSAR RTE" UBYTE RTE_CM_ENUM_StaMd_Mode 0 0 0 255 ECU_ADDRESS 0 SYMBOL_LINK "Rte_ModeMachine_StaMd_SystemState_Mode" 0 DISPLAY_IDENTIFIER CDDInterface.ModeRequirePorts.SystemState.Mode /end MEASUREMENT
/begin MEASUREMENT CDDInterface.TOEOLDisable.Cnt_lgc "MICROSAR RTE" UBYTE RTE_CM_BOOLEAN 0 0 0 255 ECU_ADDRESS 0 SYMBOL_LINK "Rte_CDDInterface_TOEOLDisable_Cnt_lgc" 0 DISPLAY_IDENTIFIER CDDInterface.SenderPorts.TOEOLDisable.Cnt_lgc /end MEASUREMENT
/begin MEASUREMENT CDDInterface.ThermalDCSrlComSvcDft.Cnt_lgc "MICROSAR RTE" UBYTE RTE_CM_BOOLEAN 0 0 0 255 ECU_ADDRESS 0 SYMBOL_LINK "Rte_CDDInterface_ThermalDCSrlComSvcDft_Cnt_lgc" 0 DISPLAY_IDENTIFIER CDDInterface.SenderPorts.ThermalDCSrlComSvcDft.Cnt_lgc /end MEASUREMENT
/begin MEASUREMENT CDDInterface.TrqRmpSrlComSvcDft.Cnt_lgc "MICROSAR RTE" UBYTE RTE_CM_BOOLEAN 0 0 0 255 ECU_ADDRESS 0 SYMBOL_LINK "Rte_CDDInterface_TrqRmpSrlComSvcDft_Cnt_lgc" 0 DISPLAY_IDENTIFIER CDDInterface.SenderPorts.TrqRmpSrlComSvcDft.Cnt_lgc /end MEASUREMENT
/begin MEASUREMENT CDDInterface.Vecu.Volt_f32 "This signal is intended to communicate any type voltage signal measured by the ecu.  This signal has a lower limit of 0 which reequires users of the signal to provide divide by 0 protection if it is used as a denominator in a calculation.  See Vecu port p" FLOAT32_IEEE NO_COMPU_METHOD 0 0 1.175494351e-38 3.402823466e+38 ECU_ADDRESS 0 SYMBOL_LINK "Rte_BatteryVoltage_Vecu_Volt_f32" 0 DISPLAY_IDENTIFIER CDDInterface.ReceiverPorts.Vecu.Volt_f32 /end MEASUREMENT
/begin MEASUREMENT CDDInterface.WIREnabled.Cnt_lgc "MICROSAR RTE" UBYTE RTE_CM_BOOLEAN 0 0 0 255 ECU_ADDRESS 0 SYMBOL_LINK "Rte_CDDInterface_WIREnabled_Cnt_lgc" 0 DISPLAY_IDENTIFIER CDDInterface.SenderPorts.WIREnabled.Cnt_lgc /end MEASUREMENT
/begin MEASUREMENT CDDInterface.WhlImbRejSrlComSvcDft.Cnt_lgc "MICROSAR RTE" UBYTE RTE_CM_BOOLEAN 0 0 0 255 ECU_ADDRESS 0 SYMBOL_LINK "Rte_CDDInterface_WhlImbRejSrlComSvcDft_Cnt_lgc" 0 DISPLAY_IDENTIFIER CDDInterface.SenderPorts.WhlImbRejSrlComSvcDft.Cnt_lgc /end MEASUREMENT
/begin MEASUREMENT CmMtrCurr.ADCMtrCurr1.Volts_f32 "MICROSAR RTE" FLOAT32_IEEE NO_COMPU_METHOD 0 0 1.175494351e-38 3.402823466e+38 ECU_ADDRESS 0 SYMBOL_LINK "Rte_CDDInterface_ADCMtrCurr1_Volts_f32" 0 DISPLAY_IDENTIFIER CmMtrCurr.ReceiverPorts.ADCMtrCurr1.Volts_f32 /end MEASUREMENT
/begin MEASUREMENT CmMtrCurr.ADCMtrCurr2.Volts_f32 "MICROSAR RTE" FLOAT32_IEEE NO_COMPU_METHOD 0 0 1.175494351e-38 3.402823466e+38 ECU_ADDRESS 0 SYMBOL_LINK "Rte_CDDInterface_ADCMtrCurr2_Volts_f32" 0 DISPLAY_IDENTIFIER CmMtrCurr.ReceiverPorts.ADCMtrCurr2.Volts_f32 /end MEASUREMENT
/begin MEASUREMENT CmMtrCurr.ComOffset.Cnt_u16 "MICROSAR RTE" UWORD NO_COMPU_METHOD 0 0 0 65535 ECU_ADDRESS 0 SYMBOL_LINK "Rte_CmMtrCurr_ComOffset_Cnt_u16" 0 DISPLAY_IDENTIFIER CmMtrCurr.SenderPorts.ComOffset.Cnt_u16 /end MEASUREMENT
/begin MEASUREMENT CmMtrCurr.CorrMtrCurrPosition.Rev_f32 "MICROSAR RTE" FLOAT32_IEEE NO_COMPU_METHOD 0 0 1.175494351e-38 3.402823466e+38 ECU_ADDRESS 0 SYMBOL_LINK "Rte_CDDInterface_CorrMtrCurrPosition_Rev_f32" 0 DISPLAY_IDENTIFIER CmMtrCurr.ReceiverPorts.CorrMtrCurrPosition.Rev_f32 /end MEASUREMENT
/begin MEASUREMENT CmMtrCurr.CurrTempOffset.CurrOffsetY1_Volts_s4p11 "MICROSAR RTE" SWORD NO_COMPU_METHOD 0 0 -32768 32767 MATRIX_DIM 16 1 1 ECU_ADDRESS 0 SYMBOL_LINK "Rte_CmMtrCurr_CurrTempOffset.CurrOffsetY1_Volts_s4p11" 0 DISPLAY_IDENTIFIER CmMtrCurr.PerInstanceMemories.CurrTempOffset.CurrOffsetY1_Volts_s4p11 READ_WRITE /end MEASUREMENT
/begin MEASUREMENT CmMtrCurr.CurrTempOffset.CurrOffsetY2_Volts_s4p11 "MICROSAR RTE" SWORD NO_COMPU_METHOD 0 0 -32768 32767 MATRIX_DIM 16 1 1 ECU_ADDRESS 0 SYMBOL_LINK "Rte_CmMtrCurr_CurrTempOffset.CurrOffsetY2_Volts_s4p11" 0 DISPLAY_IDENTIFIER CmMtrCurr.PerInstanceMemories.CurrTempOffset.CurrOffsetY2_Volts_s4p11 READ_WRITE /end MEASUREMENT
/begin MEASUREMENT CmMtrCurr.CurrTempOffset.CurrTempOffsetX_DegC_s10p5 "MICROSAR RTE" SWORD NO_COMPU_METHOD 0 0 -32768 32767 MATRIX_DIM 16 1 1 ECU_ADDRESS 0 SYMBOL_LINK "Rte_CmMtrCurr_CurrTempOffset.CurrTempOffsetX_DegC_s10p5" 0 DISPLAY_IDENTIFIER CmMtrCurr.PerInstanceMemories.CurrTempOffset.CurrTempOffsetX_DegC_s10p5 READ_WRITE /end MEASUREMENT
/begin MEASUREMENT CmMtrCurr.CurrentGainSvc.Cnt_lgc "MICROSAR RTE" UBYTE RTE_CM_BOOLEAN 0 0 0 255 ECU_ADDRESS 0 SYMBOL_LINK "Rte_CmMtrCurr_CurrentGainSvc_Cnt_lgc" 0 DISPLAY_IDENTIFIER CmMtrCurr.SenderPorts.CurrentGainSvc.Cnt_lgc /end MEASUREMENT
/begin MEASUREMENT CmMtrCurr.FiltCntrlTemp.DegC_f32 "MICROSAR RTE" FLOAT32_IEEE NO_COMPU_METHOD 0 0 1.175494351e-38 3.402823466e+38 ECU_ADDRESS 0 SYMBOL_LINK "Rte_CtrlTemp_FiltMeasTemp_DegC_f32" 0 DISPLAY_IDENTIFIER CmMtrCurr.ReceiverPorts.FiltCntrlTemp.DegC_f32 /end MEASUREMENT
/begin MEASUREMENT CmMtrCurr.MEC.Cnt_enum "MICROSAR RTE" UBYTE RTE_CM_ENUM_ManufModeType 0 0 0 2 ECU_ADDRESS 0 SYMBOL_LINK "Rte_CDDInterface_MEC_Cnt_enum" 0 DISPLAY_IDENTIFIER CmMtrCurr.ReceiverPorts.MEC.Cnt_enum /end MEASUREMENT
/begin MEASUREMENT CmMtrCurr.MtrCurr1TempOffset.Volt_f32 "This signal is intended to communicate any type voltage signal measured by the ecu.  This signal has a lower limit of 0 which reequires users of the signal to provide divide by 0 protection if it is used as a denominator in a calculation.  See Vecu port p" FLOAT32_IEEE NO_COMPU_METHOD 0 0 1.175494351e-38 3.402823466e+38 ECU_ADDRESS 0 SYMBOL_LINK "Rte_CmMtrCurr_MtrCurr1TempOffset_Volt_f32" 0 DISPLAY_IDENTIFIER CmMtrCurr.SenderPorts.MtrCurr1TempOffset.Volt_f32 /end MEASUREMENT
/begin MEASUREMENT CmMtrCurr.MtrCurr2TempOffset.Volt_f32 "This signal is intended to communicate any type voltage signal measured by the ecu.  This signal has a lower limit of 0 which reequires users of the signal to provide divide by 0 protection if it is used as a denominator in a calculation.  See Vecu port p" FLOAT32_IEEE NO_COMPU_METHOD 0 0 1.175494351e-38 3.402823466e+38 ECU_ADDRESS 0 SYMBOL_LINK "Rte_CmMtrCurr_MtrCurr2TempOffset_Volt_f32" 0 DISPLAY_IDENTIFIER CmMtrCurr.SenderPorts.MtrCurr2TempOffset.Volt_f32 /end MEASUREMENT
/begin MEASUREMENT CmMtrCurr.MtrCurrAngle.Rev_f32 "MICROSAR RTE" FLOAT32_IEEE NO_COMPU_METHOD 0 0 1.175494351e-38 3.402823466e+38 ECU_ADDRESS 0 SYMBOL_LINK "Rte_CurrCmd_MtrCurrAngle_Rev_f32" 0 DISPLAY_IDENTIFIER CmMtrCurr.ReceiverPorts.MtrCurrAngle.Rev_f32 /end MEASUREMENT
/begin MEASUREMENT CmMtrCurr.MtrCurrK1.Amp_f32 "MICROSAR RTE" FLOAT32_IEEE NO_COMPU_METHOD 0 0 1.175494351e-38 3.402823466e+38 ECU_ADDRESS 0 SYMBOL_LINK "Rte_CDDInterface_MtrCurrK1_Amp_f32" 0 DISPLAY_IDENTIFIER CmMtrCurr.ReceiverPorts.MtrCurrK1.Amp_f32 /end MEASUREMENT
/begin MEASUREMENT CmMtrCurr.MtrCurrK2.Amp_f32 "MICROSAR RTE" FLOAT32_IEEE NO_COMPU_METHOD 0 0 1.175494351e-38 3.402823466e+38 ECU_ADDRESS 0 SYMBOL_LINK "Rte_CDDInterface_MtrCurrK2_Amp_f32" 0 DISPLAY_IDENTIFIER CmMtrCurr.ReceiverPorts.MtrCurrK2.Amp_f32 /end MEASUREMENT
/begin MEASUREMENT CmMtrCurr.MtrVel.MtrRadpS_f32 "MICROSAR RTE" FLOAT32_IEEE NO_COMPU_METHOD 0 0 1.175494351e-38 3.402823466e+38 ECU_ADDRESS 0 SYMBOL_LINK "Rte_MtrVel_MRFMotorVel_MtrRadpS_f32" 0 DISPLAY_IDENTIFIER CmMtrCurr.ReceiverPorts.MtrVel.MtrRadpS_f32 /end MEASUREMENT
/begin MEASUREMENT CmMtrCurr.ShCurrCal.EOLMtrCurr1OffsetDiff_Volts_f32 "MICROSAR RTE" FLOAT32_IEEE NO_COMPU_METHOD 0 0 1.175494351e-38 3.402823466e+38 ECU_ADDRESS 0 SYMBOL_LINK "Rte_CmMtrCurr_ShCurrCal.EOLMtrCurr1OffsetDiff_Volts_f32" 0 DISPLAY_IDENTIFIER CmMtrCurr.PerInstanceMemories.ShCurrCal.EOLMtrCurr1OffsetDiff_Volts_f32 READ_WRITE /end MEASUREMENT
/begin MEASUREMENT CmMtrCurr.ShCurrCal.EOLMtrCurr1OffsetLo_Volts_f32 "MICROSAR RTE" FLOAT32_IEEE NO_COMPU_METHOD 0 0 1.175494351e-38 3.402823466e+38 ECU_ADDRESS 0 SYMBOL_LINK "Rte_CmMtrCurr_ShCurrCal.EOLMtrCurr1OffsetLo_Volts_f32" 0 DISPLAY_IDENTIFIER CmMtrCurr.PerInstanceMemories.ShCurrCal.EOLMtrCurr1OffsetLo_Volts_f32 READ_WRITE /end MEASUREMENT
/begin MEASUREMENT CmMtrCurr.ShCurrCal.EOLMtrCurr2OffsetDiff_Volts_f32 "MICROSAR RTE" FLOAT32_IEEE NO_COMPU_METHOD 0 0 1.175494351e-38 3.402823466e+38 ECU_ADDRESS 0 SYMBOL_LINK "Rte_CmMtrCurr_ShCurrCal.EOLMtrCurr2OffsetDiff_Volts_f32" 0 DISPLAY_IDENTIFIER CmMtrCurr.PerInstanceMemories.ShCurrCal.EOLMtrCurr2OffsetDiff_Volts_f32 READ_WRITE /end MEASUREMENT
/begin MEASUREMENT CmMtrCurr.ShCurrCal.EOLMtrCurr2OffsetLo_Volts_f32 "MICROSAR RTE" FLOAT32_IEEE NO_COMPU_METHOD 0 0 1.175494351e-38 3.402823466e+38 ECU_ADDRESS 0 SYMBOL_LINK "Rte_CmMtrCurr_ShCurrCal.EOLMtrCurr2OffsetLo_Volts_f32" 0 DISPLAY_IDENTIFIER CmMtrCurr.PerInstanceMemories.ShCurrCal.EOLMtrCurr2OffsetLo_Volts_f32 READ_WRITE /end MEASUREMENT
/begin MEASUREMENT CmMtrCurr.ShCurrCal.EOLMtrCurrVcalCmd_VoltCnts_f32 "MICROSAR RTE" FLOAT32_IEEE NO_COMPU_METHOD 0 0 1.175494351e-38 3.402823466e+38 ECU_ADDRESS 0 SYMBOL_LINK "Rte_CmMtrCurr_ShCurrCal.EOLMtrCurrVcalCmd_VoltCnts_f32" 0 DISPLAY_IDENTIFIER CmMtrCurr.PerInstanceMemories.ShCurrCal.EOLMtrCurrVcalCmd_VoltCnts_f32 READ_WRITE /end MEASUREMENT
/begin MEASUREMENT CmMtrCurr.ShCurrCal.EOLPhscurr1Gain_AmpspVolt_f32 "MICROSAR RTE" FLOAT32_IEEE NO_COMPU_METHOD 0 0 1.175494351e-38 3.402823466e+38 ECU_ADDRESS 0 SYMBOL_LINK "Rte_CmMtrCurr_ShCurrCal.EOLPhscurr1Gain_AmpspVolt_f32" 0 DISPLAY_IDENTIFIER CmMtrCurr.PerInstanceMemories.ShCurrCal.EOLPhscurr1Gain_AmpspVolt_f32 READ_WRITE /end MEASUREMENT
/begin MEASUREMENT CmMtrCurr.ShCurrCal.EOLPhscurr2Gain_AmpspVolt_f32 "MICROSAR RTE" FLOAT32_IEEE NO_COMPU_METHOD 0 0 1.175494351e-38 3.402823466e+38 ECU_ADDRESS 0 SYMBOL_LINK "Rte_CmMtrCurr_ShCurrCal.EOLPhscurr2Gain_AmpspVolt_f32" 0 DISPLAY_IDENTIFIER CmMtrCurr.PerInstanceMemories.ShCurrCal.EOLPhscurr2Gain_AmpspVolt_f32 READ_WRITE /end MEASUREMENT
/begin MEASUREMENT CmMtrCurr.SrlComSvcDft.Cnt_b32 "MICROSAR RTE" ULONG NO_COMPU_METHOD 0 0 0 4294967295 ECU_ADDRESS 0 SYMBOL_LINK "Rte_CDDInterface_SrlComSvcDft_Cnt_b32" 0 DISPLAY_IDENTIFIER CmMtrCurr.ReceiverPorts.SrlComSvcDft.Cnt_b32 /end MEASUREMENT
/begin MEASUREMENT CmMtrCurr.SystemState.Mode "MICROSAR RTE" UBYTE RTE_CM_ENUM_StaMd_Mode 0 0 0 255 ECU_ADDRESS 0 SYMBOL_LINK "Rte_ModeMachine_StaMd_SystemState_Mode" 0 DISPLAY_IDENTIFIER CmMtrCurr.ModeRequirePorts.SystemState.Mode /end MEASUREMENT
/begin MEASUREMENT CmMtrCurr.Vecu.Volt_f32 "This port prototype is inteded to communicate voltage signals that represent the ecu supplied voltage.  This signal has a lower limit, which is non-zero, to allow users of the signal to use it as a denominator in an expression without requiring a divide b" FLOAT32_IEEE NO_COMPU_METHOD 0 0 1.175494351e-38 3.402823466e+38 ECU_ADDRESS 0 SYMBOL_LINK "Rte_BatteryVoltage_Vecu_Volt_f32" 0 DISPLAY_IDENTIFIER CmMtrCurr.ReceiverPorts.Vecu.Volt_f32 /end MEASUREMENT
/begin MEASUREMENT CmMtrCurr.VehSpd.Kph_f32 "MICROSAR RTE" FLOAT32_IEEE NO_COMPU_METHOD 0 0 1.175494351e-38 3.402823466e+38 ECU_ADDRESS 0 SYMBOL_LINK "Rte_Ap_SignlCondn_VehicleSpeed_Kph_f32" 0 DISPLAY_IDENTIFIER CmMtrCurr.ReceiverPorts.VehSpd.Kph_f32 /end MEASUREMENT
/begin MEASUREMENT CmMtrCurr.VhSpdValid.Cnt_lgc "MICROSAR RTE" UBYTE RTE_CM_BOOLEAN 0 0 0 255 ECU_ADDRESS 0 SYMBOL_LINK "Rte_SrlComInput_SrlComVehSpdValid_Cnt_lgc" 0 DISPLAY_IDENTIFIER CmMtrCurr.ReceiverPorts.VhSpdValid.Cnt_lgc /end MEASUREMENT
/begin MEASUREMENT CtrlTemp.AmbTemp.DegC_f32 "MICROSAR RTE" FLOAT32_IEEE NO_COMPU_METHOD 0 0 1.175494351e-38 3.402823466e+38 ECU_ADDRESS 0 SYMBOL_LINK "Rte_SrlComInput_AmbTempAvg_DegC_f32" 0 DISPLAY_IDENTIFIER CtrlTemp.ReceiverPorts.AmbTemp.DegC_f32 /end MEASUREMENT
/begin MEASUREMENT CtrlTemp.DiagStsTempRdPrf.Cnt_lgc "MICROSAR RTE" UBYTE RTE_CM_BOOLEAN 0 0 0 255 ECU_ADDRESS 0 SYMBOL_LINK "Rte_DiagMgr_DiagStsDefTemp_Cnt_lgc" 0 DISPLAY_IDENTIFIER CtrlTemp.ReceiverPorts.DiagStsTempRdPrf.Cnt_lgc /end MEASUREMENT
/begin MEASUREMENT CtrlTemp.FiltMeasTemp.DegC_f32 "MICROSAR RTE" FLOAT32_IEEE NO_COMPU_METHOD 0 0 1.175494351e-38 3.402823466e+38 ECU_ADDRESS 0 SYMBOL_LINK "Rte_CtrlTemp_FiltMeasTemp_DegC_f32" 0 DISPLAY_IDENTIFIER CtrlTemp.SenderPorts.FiltMeasTemp.DegC_f32 /end MEASUREMENT
/begin MEASUREMENT CtrlTemp.TemperatureADC.Volt_f32 "This signal is intended to communicate any type voltage signal measured by the ecu.  This signal has a lower limit of 0 which reequires users of the signal to provide divide by 0 protection if it is used as a denominator in a calculation.  See Vecu port p" FLOAT32_IEEE NO_COMPU_METHOD 0 0 1.175494351e-38 3.402823466e+38 ECU_ADDRESS 0 SYMBOL_LINK "Rte_IoHwAbstractionUsr_TemperatureADC_Volt_f32" 0 DISPLAY_IDENTIFIER CtrlTemp.ReceiverPorts.TemperatureADC.Volt_f32 /end MEASUREMENT
/begin MEASUREMENT CtrldDisShtdn.AssistAssyPolarity.Cnt_s08 "MICROSAR RTE" SBYTE NO_COMPU_METHOD 0 0 -128 127 ECU_ADDRESS 0 SYMBOL_LINK "Rte_Polarity_AssistAssyPolarity_Cnt_s08" 0 DISPLAY_IDENTIFIER CtrldDisShtdn.ReceiverPorts.AssistAssyPolarity.Cnt_s08 /end MEASUREMENT
/begin MEASUREMENT CtrldDisShtdn.CRFMtrVel.MtrRadpS_f32 "MICROSAR RTE" FLOAT32_IEEE NO_COMPU_METHOD 0 0 1.175494351e-38 3.402823466e+38 ECU_ADDRESS 0 SYMBOL_LINK "Rte_MtrVel_CRFMotorVel_MtrRadpS_f32" 0 DISPLAY_IDENTIFIER CtrldDisShtdn.ReceiverPorts.CRFMtrVel.MtrRadpS_f32 /end MEASUREMENT
/begin MEASUREMENT CtrldDisShtdn.CntDisMtrTrqCmdCRF.MtrNm_f32 "MICROSAR RTE" FLOAT32_IEEE NO_COMPU_METHOD 0 0 1.175494351e-38 3.402823466e+38 ECU_ADDRESS 0 SYMBOL_LINK "Rte_CtrldDisShtdn_CntDisMtrTrqCmdCRF_MtrNm_f32" 0 DISPLAY_IDENTIFIER CtrldDisShtdn.SenderPorts.CntDisMtrTrqCmdCRF.MtrNm_f32 /end MEASUREMENT
/begin MEASUREMENT CtrldDisShtdn.CntDisMtrTrqCmdMRF.MtrNm_f32 "MICROSAR RTE" FLOAT32_IEEE NO_COMPU_METHOD 0 0 1.175494351e-38 3.402823466e+38 ECU_ADDRESS 0 SYMBOL_LINK "Rte_CtrldDisShtdn_CntDisMtrTrqCmdMRF_MtrNm_f32" 0 DISPLAY_IDENTIFIER CtrldDisShtdn.SenderPorts.CntDisMtrTrqCmdMRF.MtrNm_f32 /end MEASUREMENT
/begin MEASUREMENT CtrldDisShtdn.CtrldDmpStsCmp.Cnt_lgc "MICROSAR RTE" UBYTE RTE_CM_BOOLEAN 0 0 0 255 ECU_ADDRESS 0 SYMBOL_LINK "Rte_CtrldDisShtdn_CtrldDmpStsCmp_Cnt_lgc" 0 DISPLAY_IDENTIFIER CtrldDisShtdn.SenderPorts.CtrldDmpStsCmp.Cnt_lgc /end MEASUREMENT
/begin MEASUREMENT CtrldDisShtdn.DiagStsF2Active.Cnt_lgc "MICROSAR RTE" UBYTE RTE_CM_BOOLEAN 0 0 0 255 ECU_ADDRESS 0 SYMBOL_LINK "Rte_DiagMgr_DiagStsCtrldDisRmpPres_Cnt_lgc" 0 DISPLAY_IDENTIFIER CtrldDisShtdn.ReceiverPorts.DiagStsF2Active.Cnt_lgc /end MEASUREMENT
/begin MEASUREMENT CtrldDisShtdn.SumLimTrqCmd.MtrNm_f32 "MICROSAR RTE" FLOAT32_IEEE NO_COMPU_METHOD 0 0 1.175494351e-38 3.402823466e+38 ECU_ADDRESS 0 SYMBOL_LINK "Rte_Ap_AstLmt_SumLimTrqCmd_MtrNm_f32" 0 DISPLAY_IDENTIFIER CtrldDisShtdn.ReceiverPorts.SumLimTrqCmd.MtrNm_f32 /end MEASUREMENT
/begin MEASUREMENT CtrldDisShtdn.SysC_CRFMtrTrqCmd.MtrNm_f32 "MICROSAR RTE" FLOAT32_IEEE NO_COMPU_METHOD 0 0 1.175494351e-38 3.402823466e+38 ECU_ADDRESS 0 SYMBOL_LINK "Rte_CtrldDisShtdn_SysC_CRFMtrTrqCmd_MtrNm_f32" 0 DISPLAY_IDENTIFIER CtrldDisShtdn.SenderPorts.SysC_CRFMtrTrqCmd.MtrNm_f32 /end MEASUREMENT
/begin MEASUREMENT CtrldDisShtdn.SysC_MRFMtrTrqCmd.MtrNm_f32 "MICROSAR RTE" FLOAT32_IEEE NO_COMPU_METHOD 0 0 1.175494351e-38 3.402823466e+38 ECU_ADDRESS 0 SYMBOL_LINK "Rte_CtrldDisShtdn_SysC_MRFMtrTrqCmd_MtrNm_f32" 0 DISPLAY_IDENTIFIER CtrldDisShtdn.SenderPorts.SysC_MRFMtrTrqCmd.MtrNm_f32 /end MEASUREMENT
/begin MEASUREMENT CtrldDisShtdn.SystemState.Mode "MICROSAR RTE" UBYTE RTE_CM_ENUM_StaMd_Mode 0 0 0 255 ECU_ADDRESS 0 SYMBOL_LINK "Rte_ModeMachine_StaMd_SystemState_Mode" 0 DISPLAY_IDENTIFIER CtrldDisShtdn.ModeRequirePorts.SystemState.Mode /end MEASUREMENT
/begin MEASUREMENT CurrCmd.CurrentGainSvc.Cnt_lgc "MICROSAR RTE" UBYTE RTE_CM_BOOLEAN 0 0 0 255 ECU_ADDRESS 0 SYMBOL_LINK "Rte_CmMtrCurr_CurrentGainSvc_Cnt_lgc" 0 DISPLAY_IDENTIFIER CurrCmd.ReceiverPorts.CurrentGainSvc.Cnt_lgc /end MEASUREMENT
/begin MEASUREMENT CurrCmd.EstKe.VpRadpS_f32 "MICROSAR RTE" FLOAT32_IEEE NO_COMPU_METHOD 0 0 1.175494351e-38 3.402823466e+38 ECU_ADDRESS 0 SYMBOL_LINK "Rte_CurrParamComp_EstKe_VpRadpS_f32" 0 DISPLAY_IDENTIFIER CurrCmd.ReceiverPorts.EstKe.VpRadpS_f32 /end MEASUREMENT
/begin MEASUREMENT CurrCmd.EstLd.Henry_f32 "MICROSAR RTE" FLOAT32_IEEE NO_COMPU_METHOD 0 0 1.175494351e-38 3.402823466e+38 ECU_ADDRESS 0 SYMBOL_LINK "Rte_CurrParamComp_EstLd_Henry_f32" 0 DISPLAY_IDENTIFIER CurrCmd.ReceiverPorts.EstLd.Henry_f32 /end MEASUREMENT
/begin MEASUREMENT CurrCmd.EstLq.Henry_f32 "MICROSAR RTE" FLOAT32_IEEE NO_COMPU_METHOD 0 0 1.175494351e-38 3.402823466e+38 ECU_ADDRESS 0 SYMBOL_LINK "Rte_CurrParamComp_EstLq_Henry_f32" 0 DISPLAY_IDENTIFIER CurrCmd.ReceiverPorts.EstLq.Henry_f32 /end MEASUREMENT
/begin MEASUREMENT CurrCmd.EstR.Ohm_f32 "MICROSAR RTE" FLOAT32_IEEE NO_COMPU_METHOD 0 0 1.175494351e-38 3.402823466e+38 ECU_ADDRESS 0 SYMBOL_LINK "Rte_CurrParamComp_EstR_Ohm_f32" 0 DISPLAY_IDENTIFIER CurrCmd.ReceiverPorts.EstR.Ohm_f32 /end MEASUREMENT
/begin MEASUREMENT CurrCmd.MRFMtrVel.MtrRadpS_f32 "MICROSAR RTE" FLOAT32_IEEE NO_COMPU_METHOD 0 0 1.175494351e-38 3.402823466e+38 ECU_ADDRESS 0 SYMBOL_LINK "Rte_MtrVel_MRFMotorVel_MtrRadpS_f32" 0 DISPLAY_IDENTIFIER CurrCmd.ReceiverPorts.MRFMtrVel.MtrRadpS_f32 /end MEASUREMENT
/begin MEASUREMENT CurrCmd.MRFTrqCmdScl.MtrNm_f32 "MICROSAR RTE" FLOAT32_IEEE NO_COMPU_METHOD 0 0 1.175494351e-38 3.402823466e+38 ECU_ADDRESS 0 SYMBOL_LINK "Rte_TrqCmdScl_MRFMtrTrqCmdScl_MtrNm_f32" 0 DISPLAY_IDENTIFIER CurrCmd.ReceiverPorts.MRFTrqCmdScl.MtrNm_f32 /end MEASUREMENT
/begin MEASUREMENT CurrCmd.MtrCurrAngle.Rev_f32 "MICROSAR RTE" FLOAT32_IEEE NO_COMPU_METHOD 0 0 1.175494351e-38 3.402823466e+38 ECU_ADDRESS 0 SYMBOL_LINK "Rte_CurrCmd_MtrCurrAngle_Rev_f32" 0 DISPLAY_IDENTIFIER CurrCmd.SenderPorts.MtrCurrAngle.Rev_f32 /end MEASUREMENT
/begin MEASUREMENT CurrCmd.MtrCurrDaxRef.Amp_f32 "MICROSAR RTE" FLOAT32_IEEE NO_COMPU_METHOD 0 0 1.175494351e-38 3.402823466e+38 ECU_ADDRESS 0 SYMBOL_LINK "Rte_CurrCmd_MtrCurrDaxRef_Amp_f32" 0 DISPLAY_IDENTIFIER CurrCmd.SenderPorts.MtrCurrDaxRef.Amp_f32 /end MEASUREMENT
/begin MEASUREMENT CurrCmd.MtrCurrQaxRef.Amp_f32 "MICROSAR RTE" FLOAT32_IEEE NO_COMPU_METHOD 0 0 1.175494351e-38 3.402823466e+38 ECU_ADDRESS 0 SYMBOL_LINK "Rte_CurrCmd_MtrCurrQaxRef_Amp_f32" 0 DISPLAY_IDENTIFIER CurrCmd.SenderPorts.MtrCurrQaxRef.Amp_f32 /end MEASUREMENT
/begin MEASUREMENT CurrCmd.MtrQuad.Cnt_u08 "MICROSAR RTE" UBYTE NO_COMPU_METHOD 0 0 0 255 ECU_ADDRESS 0 SYMBOL_LINK "Rte_QuadDet_MtrQuad_Cnt_u08" 0 DISPLAY_IDENTIFIER CurrCmd.ReceiverPorts.MtrQuad.Cnt_u08 /end MEASUREMENT
/begin MEASUREMENT CurrCmd.MtrTrqCmdSign.Cnt_s16 "MICROSAR RTE" SWORD NO_COMPU_METHOD 0 0 -32768 32767 ECU_ADDRESS 0 SYMBOL_LINK "Rte_CurrCmd_MtrTrqCmdSign_Cnt_s16" 0 DISPLAY_IDENTIFIER CurrCmd.SenderPorts.MtrTrqCmdSign.Cnt_s16 /end MEASUREMENT
/begin MEASUREMENT CurrCmd.MtrVoltDaxFF.Volt_f32 "This signal is intended to communicate any type voltage signal measured by the ecu.  This signal has a lower limit of 0 which reequires users of the signal to provide divide by 0 protection if it is used as a denominator in a calculation.  See Vecu port p" FLOAT32_IEEE NO_COMPU_METHOD 0 0 1.175494351e-38 3.402823466e+38 ECU_ADDRESS 0 SYMBOL_LINK "Rte_CurrCmd_MtrVoltDaxFF_Volt_f32" 0 DISPLAY_IDENTIFIER CurrCmd.SenderPorts.MtrVoltDaxFF.Volt_f32 /end MEASUREMENT
/begin MEASUREMENT CurrCmd.MtrVoltQaxFF.Volt_f32 "This signal is intended to communicate any type voltage signal measured by the ecu.  This signal has a lower limit of 0 which reequires users of the signal to provide divide by 0 protection if it is used as a denominator in a calculation.  See Vecu port p" FLOAT32_IEEE NO_COMPU_METHOD 0 0 1.175494351e-38 3.402823466e+38 ECU_ADDRESS 0 SYMBOL_LINK "Rte_CurrCmd_MtrVoltQaxFF_Volt_f32" 0 DISPLAY_IDENTIFIER CurrCmd.SenderPorts.MtrVoltQaxFF.Volt_f32 /end MEASUREMENT
/begin MEASUREMENT CurrCmd.Vecu.Volt_f32 "This port prototype is inteded to communicate voltage signals that represent the ecu supplied voltage.  This signal has a lower limit, which is non-zero, to allow users of the signal to use it as a denominator in an expression without requiring a divide b" FLOAT32_IEEE NO_COMPU_METHOD 0 0 1.175494351e-38 3.402823466e+38 ECU_ADDRESS 0 SYMBOL_LINK "Rte_BatteryVoltage_Vecu_Volt_f32" 0 DISPLAY_IDENTIFIER CurrCmd.ReceiverPorts.Vecu.Volt_f32 /end MEASUREMENT
/begin MEASUREMENT CurrCmd.VehSpd.Kph_f32 "MICROSAR RTE" FLOAT32_IEEE NO_COMPU_METHOD 0 0 1.175494351e-38 3.402823466e+38 ECU_ADDRESS 0 SYMBOL_LINK "Rte_Ap_SignlCondn_VehicleSpeed_Kph_f32" 0 DISPLAY_IDENTIFIER CurrCmd.ReceiverPorts.VehSpd.Kph_f32 /end MEASUREMENT
/begin MEASUREMENT CurrParamComp.CuTempEst.DegC_f32 "MICROSAR RTE" FLOAT32_IEEE NO_COMPU_METHOD 0 0 1.175494351e-38 3.402823466e+38 ECU_ADDRESS 0 SYMBOL_LINK "Rte_Ap_MtrTempEst_CuTempEst_DegC_f32" 0 DISPLAY_IDENTIFIER CurrParamComp.ReceiverPorts.CuTempEst.DegC_f32 /end MEASUREMENT
/begin MEASUREMENT CurrParamComp.EOLNomMtrParam.NomKe_VpRadpS_f32 "MICROSAR RTE" FLOAT32_IEEE NO_COMPU_METHOD 0 0 1.175494351e-38 3.402823466e+38 ECU_ADDRESS 0 SYMBOL_LINK "Rte_CurrParamComp_EOLNomMtrParam.NomKe_VpRadpS_f32" 0 DISPLAY_IDENTIFIER CurrParamComp.PerInstanceMemories.EOLNomMtrParam.NomKe_VpRadpS_f32 READ_WRITE /end MEASUREMENT
/begin MEASUREMENT CurrParamComp.EOLNomMtrParam.NomRmtr_Ohm_f32 "MICROSAR RTE" FLOAT32_IEEE NO_COMPU_METHOD 0 0 1.175494351e-38 3.402823466e+38 ECU_ADDRESS 0 SYMBOL_LINK "Rte_CurrParamComp_EOLNomMtrParam.NomRmtr_Ohm_f32" 0 DISPLAY_IDENTIFIER CurrParamComp.PerInstanceMemories.EOLNomMtrParam.NomRmtr_Ohm_f32 READ_WRITE /end MEASUREMENT
/begin MEASUREMENT CurrParamComp.EstKe.VpRadpS_f32 "MICROSAR RTE" FLOAT32_IEEE NO_COMPU_METHOD 0 0 1.175494351e-38 3.402823466e+38 ECU_ADDRESS 0 SYMBOL_LINK "Rte_CurrParamComp_EstKe_VpRadpS_f32" 0 DISPLAY_IDENTIFIER CurrParamComp.SenderPorts.EstKe.VpRadpS_f32 /end MEASUREMENT
/begin MEASUREMENT CurrParamComp.EstLd.Henry_f32 "MICROSAR RTE" FLOAT32_IEEE NO_COMPU_METHOD 0 0 1.175494351e-38 3.402823466e+38 ECU_ADDRESS 0 SYMBOL_LINK "Rte_CurrParamComp_EstLd_Henry_f32" 0 DISPLAY_IDENTIFIER CurrParamComp.SenderPorts.EstLd.Henry_f32 /end MEASUREMENT
/begin MEASUREMENT CurrParamComp.EstLq.Henry_f32 "MICROSAR RTE" FLOAT32_IEEE NO_COMPU_METHOD 0 0 1.175494351e-38 3.402823466e+38 ECU_ADDRESS 0 SYMBOL_LINK "Rte_CurrParamComp_EstLq_Henry_f32" 0 DISPLAY_IDENTIFIER CurrParamComp.SenderPorts.EstLq.Henry_f32 /end MEASUREMENT
/begin MEASUREMENT CurrParamComp.EstR.Ohm_f32 "MICROSAR RTE" FLOAT32_IEEE NO_COMPU_METHOD 0 0 1.175494351e-38 3.402823466e+38 ECU_ADDRESS 0 SYMBOL_LINK "Rte_CurrParamComp_EstR_Ohm_f32" 0 DISPLAY_IDENTIFIER CurrParamComp.SenderPorts.EstR.Ohm_f32 /end MEASUREMENT
/begin MEASUREMENT CurrParamComp.MagTempEst.DegC_f32 "MICROSAR RTE" FLOAT32_IEEE NO_COMPU_METHOD 0 0 1.175494351e-38 3.402823466e+38 ECU_ADDRESS 0 SYMBOL_LINK "Rte_Ap_MtrTempEst_MagTempEst_DegC_f32" 0 DISPLAY_IDENTIFIER CurrParamComp.ReceiverPorts.MagTempEst.DegC_f32 /end MEASUREMENT
/begin MEASUREMENT CurrParamComp.MtrCurrDaxRef.Amp_f32 "MICROSAR RTE" FLOAT32_IEEE NO_COMPU_METHOD 0 0 1.175494351e-38 3.402823466e+38 ECU_ADDRESS 0 SYMBOL_LINK "Rte_CurrCmd_MtrCurrDaxRef_Amp_f32" 0 DISPLAY_IDENTIFIER CurrParamComp.ReceiverPorts.MtrCurrDaxRef.Amp_f32 /end MEASUREMENT
/begin MEASUREMENT CurrParamComp.MtrCurrQaxRef.Amp_f32 "MICROSAR RTE" FLOAT32_IEEE NO_COMPU_METHOD 0 0 1.175494351e-38 3.402823466e+38 ECU_ADDRESS 0 SYMBOL_LINK "Rte_CurrCmd_MtrCurrQaxRef_Amp_f32" 0 DISPLAY_IDENTIFIER CurrParamComp.ReceiverPorts.MtrCurrQaxRef.Amp_f32 /end MEASUREMENT
/begin MEASUREMENT CurrParamComp.SiTempEst.DegC_f32 "MICROSAR RTE" FLOAT32_IEEE NO_COMPU_METHOD 0 0 1.175494351e-38 3.402823466e+38 ECU_ADDRESS 0 SYMBOL_LINK "Rte_Ap_MtrTempEst_SiTempEst_DegC_f32" 0 DISPLAY_IDENTIFIER CurrParamComp.ReceiverPorts.SiTempEst.DegC_f32 /end MEASUREMENT
/begin MEASUREMENT Damping.AssistCmd.MtrNm_f32 "MICROSAR RTE" FLOAT32_IEEE NO_COMPU_METHOD 0 0 1.175494351e-38 3.402823466e+38 ECU_ADDRESS 0 SYMBOL_LINK "Rte_StabilityComp_AssistCmd_MtrNm_f32" 0 DISPLAY_IDENTIFIER Damping.ReceiverPorts.AssistCmd.MtrNm_f32 /end MEASUREMENT
/begin MEASUREMENT Damping.AssistMechTempEst.DegC_f32 "MICROSAR RTE" FLOAT32_IEEE NO_COMPU_METHOD 0 0 1.175494351e-38 3.402823466e+38 ECU_ADDRESS 0 SYMBOL_LINK "Rte_Ap_MtrTempEst_AssistMechTempEst_DegC_f32" 0 DISPLAY_IDENTIFIER Damping.ReceiverPorts.AssistMechTempEst.DegC_f32 /end MEASUREMENT
/begin MEASUREMENT Damping.DampingCmd.MtrNm_f32 "MICROSAR RTE" FLOAT32_IEEE NO_COMPU_METHOD 0 0 1.175494351e-38 3.402823466e+38 ECU_ADDRESS 0 SYMBOL_LINK "Rte_Damping_DampingCmd_MtrNm_f32" 0 DISPLAY_IDENTIFIER Damping.SenderPorts.DampingCmd.MtrNm_f32 /end MEASUREMENT
/begin MEASUREMENT Damping.DampingDDFactor.Uls_f32 "MICROSAR RTE" FLOAT32_IEEE NO_COMPU_METHOD 0 0 1.175494351e-38 3.402823466e+38 ECU_ADDRESS 0 SYMBOL_LINK "Rte_Damping_DampingDDFactor_Uls_f32" 0 DISPLAY_IDENTIFIER Damping.ReceiverPorts.DampingDDFactor.Uls_f32 /end MEASUREMENT
/begin MEASUREMENT Damping.DefeatDampingSvc.Cnt_lgc "MICROSAR RTE" UBYTE RTE_CM_BOOLEAN 0 0 0 255 ECU_ADDRESS 0 SYMBOL_LINK "Rte_CDDInterface_DampingSrlComSvcDft_Cnt_lgc" 0 DISPLAY_IDENTIFIER Damping.ReceiverPorts.DefeatDampingSvc.Cnt_lgc /end MEASUREMENT
/begin MEASUREMENT Damping.HwTorque.HwNm_f32 "MICROSAR RTE" FLOAT32_IEEE NO_COMPU_METHOD 0 0 1.175494351e-38 3.402823466e+38 ECU_ADDRESS 0 SYMBOL_LINK "Rte_HwTrq_AnaHwTorque_HwNm_f32" 0 DISPLAY_IDENTIFIER Damping.ReceiverPorts.HwTorque.HwNm_f32 /end MEASUREMENT
/begin MEASUREMENT Damping.MotorVelCRF.MtrRadpS_f32 "MICROSAR RTE" FLOAT32_IEEE NO_COMPU_METHOD 0 0 1.175494351e-38 3.402823466e+38 ECU_ADDRESS 0 SYMBOL_LINK "Rte_MtrVel_CRFMotorVel_MtrRadpS_f32" 0 DISPLAY_IDENTIFIER Damping.ReceiverPorts.MotorVelCRF.MtrRadpS_f32 /end MEASUREMENT
/begin MEASUREMENT Damping.VehicleSpeed.Kph_f32 "MICROSAR RTE" FLOAT32_IEEE NO_COMPU_METHOD 0 0 1.175494351e-38 3.402823466e+38 ECU_ADDRESS 0 SYMBOL_LINK "Rte_Ap_SignlCondn_VehicleSpeed_Kph_f32" 0 DISPLAY_IDENTIFIER Damping.ReceiverPorts.VehicleSpeed.Kph_f32 /end MEASUREMENT
/begin MEASUREMENT DemIf.CMDIgnStat.Cnt_u08 "MICROSAR RTE" UBYTE NO_COMPU_METHOD 0 0 0 255 ECU_ADDRESS 0 SYMBOL_LINK "Rte_SrlComInput_CMDIgnStat_Cnt_u08" 0 DISPLAY_IDENTIFIER DemIf.ReceiverPorts.CMDIgnStat.Cnt_u08 /end MEASUREMENT
/begin MEASUREMENT DemIf.DemLocalVoltage.Volt_f32 "This signal is intended to communicate any type voltage signal measured by the ecu.  This signal has a lower limit of 0 which reequires users of the signal to provide divide by 0 protection if it is used as a denominator in a calculation.  See Vecu port p" FLOAT32_IEEE NO_COMPU_METHOD 0 0 1.175494351e-38 3.402823466e+38 ECU_ADDRESS 0 SYMBOL_LINK "Rte_BatteryVoltage_Vecu_Volt_f32" 0 DISPLAY_IDENTIFIER DemIf.ReceiverPorts.DemLocalVoltage.Volt_f32 /end MEASUREMENT
/begin MEASUREMENT DemIf.DemSystemVoltage.Volt_f32 "This signal is intended to communicate any type voltage signal measured by the ecu.  This signal has a lower limit of 0 which reequires users of the signal to provide divide by 0 protection if it is used as a denominator in a calculation.  See Vecu port p" FLOAT32_IEEE NO_COMPU_METHOD 0 0 1.175494351e-38 3.402823466e+38 ECU_ADDRESS 0 SYMBOL_LINK "Rte_BatteryVoltage_Vecu_Volt_f32" 0 DISPLAY_IDENTIFIER DemIf.ReceiverPorts.DemSystemVoltage.Volt_f32 /end MEASUREMENT
/begin MEASUREMENT DemIf.NET_CFG_STAT_PT.Cnt_u16 "MICROSAR RTE" UWORD NO_COMPU_METHOD 0 0 0 65535 ECU_ADDRESS 0 SYMBOL_LINK "Rte_SrlComInput_NET_CFG_STAT_PT_Cnt_u16" 0 DISPLAY_IDENTIFIER DemIf.ReceiverPorts.NET_CFG_STAT_PT.Cnt_u16 /end MEASUREMENT
/begin MEASUREMENT DiagMgr.DiagRampRate.XpmS_f32 "MICROSAR RTE" FLOAT32_IEEE NO_COMPU_METHOD 0 0 1.175494351e-38 3.402823466e+38 ECU_ADDRESS 0 SYMBOL_LINK "Rte_DiagMgr_DiagRampRate_XpmS_f32" 0 DISPLAY_IDENTIFIER DiagMgr.SenderPorts.DiagRampRate.XpmS_f32 /end MEASUREMENT
/begin MEASUREMENT DiagMgr.DiagRampValue.Uls_f32 "MICROSAR RTE" FLOAT32_IEEE NO_COMPU_METHOD 0 0 1.175494351e-38 3.402823466e+38 ECU_ADDRESS 0 SYMBOL_LINK "Rte_DiagMgr_DiagRampValue_Uls_f32" 0 DISPLAY_IDENTIFIER DiagMgr.SenderPorts.DiagRampValue.Uls_f32 /end MEASUREMENT
/begin MEASUREMENT DiagMgr.DiagRmpToZeroActive.Cnt_lgc "MICROSAR RTE" UBYTE RTE_CM_BOOLEAN 0 0 0 255 ECU_ADDRESS 0 SYMBOL_LINK "Rte_DiagMgr_DiagRmpToZeroActive_Cnt_lgc" 0 DISPLAY_IDENTIFIER DiagMgr.SenderPorts.DiagRmpToZeroActive.Cnt_lgc /end MEASUREMENT
/begin MEASUREMENT DiagMgr.DiagStsCtrldDisRmpPres.Cnt_lgc "MICROSAR RTE" UBYTE RTE_CM_BOOLEAN 0 0 0 255 ECU_ADDRESS 0 SYMBOL_LINK "Rte_DiagMgr_DiagStsCtrldDisRmpPres_Cnt_lgc" 0 DISPLAY_IDENTIFIER DiagMgr.SenderPorts.DiagStsCtrldDisRmpPres.Cnt_lgc /end MEASUREMENT
/begin MEASUREMENT DiagMgr.DiagStsDefTemp.Cnt_lgc "MICROSAR RTE" UBYTE RTE_CM_BOOLEAN 0 0 0 255 ECU_ADDRESS 0 SYMBOL_LINK "Rte_DiagMgr_DiagStsDefTemp_Cnt_lgc" 0 DISPLAY_IDENTIFIER DiagMgr.SenderPorts.DiagStsDefTemp.Cnt_lgc /end MEASUREMENT
/begin MEASUREMENT DiagMgr.DiagStsDefVehSpd.Cnt_lgc "MICROSAR RTE" UBYTE RTE_CM_BOOLEAN 0 0 0 255 ECU_ADDRESS 0 SYMBOL_LINK "Rte_DiagMgr_DiagStsDefVehSpd_Cnt_lgc" 0 DISPLAY_IDENTIFIER DiagMgr.SenderPorts.DiagStsDefVehSpd.Cnt_lgc /end MEASUREMENT
/begin MEASUREMENT DiagMgr.DiagStsHWASbSystmFltPres.Cnt_lgc "MICROSAR RTE" UBYTE RTE_CM_BOOLEAN 0 0 0 255 ECU_ADDRESS 0 SYMBOL_LINK "Rte_DiagMgr_DiagStsHWASbSystmFltPres_Cnt_lgc" 0 DISPLAY_IDENTIFIER DiagMgr.SenderPorts.DiagStsHWASbSystmFltPres.Cnt_lgc /end MEASUREMENT
/begin MEASUREMENT DiagMgr.DiagStsNonRecRmpToZeroFltPres.Cnt_lgc "MICROSAR RTE" UBYTE RTE_CM_BOOLEAN 0 0 0 255 ECU_ADDRESS 0 SYMBOL_LINK "Rte_DiagMgr_DiagStsNonRecRmpToZeroFltPres_Cnt_lgc" 0 DISPLAY_IDENTIFIER DiagMgr.SenderPorts.DiagStsNonRecRmpToZeroFltPres.Cnt_lgc /end MEASUREMENT
/begin MEASUREMENT DiagMgr.DiagStsRecRmpToZeroFltPres.Cnt_lgc "MICROSAR RTE" UBYTE RTE_CM_BOOLEAN 0 0 0 255 ECU_ADDRESS 0 SYMBOL_LINK "Rte_DiagMgr_DiagStsRecRmpToZeroFltPres_Cnt_lgc" 0 DISPLAY_IDENTIFIER DiagMgr.SenderPorts.DiagStsRecRmpToZeroFltPres.Cnt_lgc /end MEASUREMENT
/begin MEASUREMENT DiagMgr.DiagStsScomHWANotValid.Cnt_lgc "MICROSAR RTE" UBYTE RTE_CM_BOOLEAN 0 0 0 255 ECU_ADDRESS 0 SYMBOL_LINK "Rte_DiagMgr_DiagStsScomHWANotValid_Cnt_lgc" 0 DISPLAY_IDENTIFIER DiagMgr.SenderPorts.DiagStsScomHWANotValid.Cnt_lgc /end MEASUREMENT
/begin MEASUREMENT DiagMgr.DiagStsWIRDisable.Cnt_lgc "MICROSAR RTE" UBYTE RTE_CM_BOOLEAN 0 0 0 255 ECU_ADDRESS 0 SYMBOL_LINK "Rte_DiagMgr_DiagStsWIRDisable_Cnt_lgc" 0 DISPLAY_IDENTIFIER DiagMgr.SenderPorts.DiagStsWIRDisable.Cnt_lgc /end MEASUREMENT
/begin MEASUREMENT DiagMgr.HwTrq.HwNm_f32 "MICROSAR RTE" FLOAT32_IEEE NO_COMPU_METHOD 0 0 1.175494351e-38 3.402823466e+38 ECU_ADDRESS 0 SYMBOL_LINK "Rte_HwTrq_AnaHwTorque_HwNm_f32" 0 DISPLAY_IDENTIFIER DiagMgr.ReceiverPorts.HwTrq.HwNm_f32 /end MEASUREMENT
/begin MEASUREMENT DiagMgr.IgnCnt.Cnt_u16 "MICROSAR RTE" UWORD NO_COMPU_METHOD 0 0 0 65535 ECU_ADDRESS 0 SYMBOL_LINK "Rte_CDDInterface_IgnCnt_Cnt_u16" 0 DISPLAY_IDENTIFIER DiagMgr.ReceiverPorts.IgnCnt.Cnt_u16 /end MEASUREMENT
/begin MEASUREMENT DiagMgr.MEC.Cnt_enum "MICROSAR RTE" UBYTE RTE_CM_ENUM_ManufModeType 0 0 0 2 ECU_ADDRESS 0 SYMBOL_LINK "Rte_CDDInterface_MEC_Cnt_enum" 0 DISPLAY_IDENTIFIER DiagMgr.ReceiverPorts.MEC.Cnt_enum /end MEASUREMENT
/begin MEASUREMENT DiagMgr.MfgDiagInhibit.Cnt_lgc "MICROSAR RTE" UBYTE RTE_CM_BOOLEAN 0 0 0 255 ECU_ADDRESS 0 SYMBOL_LINK "Rte_CDDInterface_MfgDiagInhibit_Cnt_lgc" 0 DISPLAY_IDENTIFIER DiagMgr.ReceiverPorts.MfgDiagInhibit.Cnt_lgc /end MEASUREMENT
/begin MEASUREMENT DiagMgr.MtrTrq.MtrNm_f32 "MICROSAR RTE" FLOAT32_IEEE NO_COMPU_METHOD 0 0 1.175494351e-38 3.402823466e+38 ECU_ADDRESS 0 SYMBOL_LINK "Rte_CtrldDisShtdn_CntDisMtrTrqCmdMRF_MtrNm_f32" 0 DISPLAY_IDENTIFIER DiagMgr.ReceiverPorts.MtrTrq.MtrNm_f32 /end MEASUREMENT
/begin MEASUREMENT DiagMgr.SystemState.Mode "MICROSAR RTE" UBYTE RTE_CM_ENUM_StaMd_Mode 0 0 0 255 ECU_ADDRESS 0 SYMBOL_LINK "Rte_ModeMachine_StaMd_SystemState_Mode" 0 DISPLAY_IDENTIFIER DiagMgr.ModeRequirePorts.SystemState.Mode /end MEASUREMENT
/begin MEASUREMENT DiagMgr.VehSpd.Kph_f32 "MICROSAR RTE" FLOAT32_IEEE NO_COMPU_METHOD 0 0 1.175494351e-38 3.402823466e+38 ECU_ADDRESS 0 SYMBOL_LINK "Rte_Ap_SignlCondn_VehicleSpeed_Kph_f32" 0 DISPLAY_IDENTIFIER DiagMgr.ReceiverPorts.VehSpd.Kph_f32 /end MEASUREMENT
/begin MEASUREMENT DigPhsReasDiag.ExpectedOnTimeA.Cnt_u32 "MICROSAR RTE" ULONG NO_COMPU_METHOD 0 0 0 4294967295 ECU_ADDRESS 0 SYMBOL_LINK "Rte_CDDInterface_ExpectedOnTimeA_Cnt_u32" 0 DISPLAY_IDENTIFIER DigPhsReasDiag.ReceiverPorts.ExpectedOnTimeA.Cnt_u32 /end MEASUREMENT
/begin MEASUREMENT DigPhsReasDiag.ExpectedOnTimeB.Cnt_u32 "MICROSAR RTE" ULONG NO_COMPU_METHOD 0 0 0 4294967295 ECU_ADDRESS 0 SYMBOL_LINK "Rte_CDDInterface_ExpectedOnTimeB_Cnt_u32" 0 DISPLAY_IDENTIFIER DigPhsReasDiag.ReceiverPorts.ExpectedOnTimeB.Cnt_u32 /end MEASUREMENT
/begin MEASUREMENT DigPhsReasDiag.ExpectedOnTimeC.Cnt_u32 "MICROSAR RTE" ULONG NO_COMPU_METHOD 0 0 0 4294967295 ECU_ADDRESS 0 SYMBOL_LINK "Rte_CDDInterface_ExpectedOnTimeC_Cnt_u32" 0 DISPLAY_IDENTIFIER DigPhsReasDiag.ReceiverPorts.ExpectedOnTimeC.Cnt_u32 /end MEASUREMENT
/begin MEASUREMENT DigPhsReasDiag.LRPRCorrectedMtrPosCaptured.Rev_f32 "MICROSAR RTE" FLOAT32_IEEE NO_COMPU_METHOD 0 0 1.175494351e-38 3.402823466e+38 ECU_ADDRESS 0 SYMBOL_LINK "Rte_Sa_MtrPos2_CorrectedMtrPos_Rev_f32" 0 DISPLAY_IDENTIFIER DigPhsReasDiag.ReceiverPorts.LRPRCorrectedMtrPosCaptured.Rev_f32 /end MEASUREMENT
/begin MEASUREMENT DigPhsReasDiag.LRPRModulationIndexCaptured.Uls_f32 "MICROSAR RTE" FLOAT32_IEEE NO_COMPU_METHOD 0 0 1.175494351e-38 3.402823466e+38 ECU_ADDRESS 0 SYMBOL_LINK "Rte_CDDInterface_ModIdxFinal_Uls_f32" 0 DISPLAY_IDENTIFIER DigPhsReasDiag.ReceiverPorts.LRPRModulationIndexCaptured.Uls_f32 /end MEASUREMENT
/begin MEASUREMENT DigPhsReasDiag.LRPRPhaseadvanceCaptured.Cnt_s16 "MICROSAR RTE" SWORD NO_COMPU_METHOD 0 0 -32768 32767 ECU_ADDRESS 0 SYMBOL_LINK "Rte_CDDInterface_LRPRPhaseadvanceCaptured_Cnt_s16" 0 DISPLAY_IDENTIFIER DigPhsReasDiag.ReceiverPorts.LRPRPhaseadvanceCaptured.Cnt_s16 /end MEASUREMENT
/begin MEASUREMENT DigPhsReasDiag.MeasuredOnTimeA.Cnt_u32 "MICROSAR RTE" ULONG NO_COMPU_METHOD 0 0 0 4294967295 ECU_ADDRESS 0 SYMBOL_LINK "Rte_CDDInterface_MeasuredOnTimeA_Cnt_u32" 0 DISPLAY_IDENTIFIER DigPhsReasDiag.ReceiverPorts.MeasuredOnTimeA.Cnt_u32 /end MEASUREMENT
/begin MEASUREMENT DigPhsReasDiag.MeasuredOnTimeB.Cnt_u32 "MICROSAR RTE" ULONG NO_COMPU_METHOD 0 0 0 4294967295 ECU_ADDRESS 0 SYMBOL_LINK "Rte_CDDInterface_MeasuredOnTimeB_Cnt_u32" 0 DISPLAY_IDENTIFIER DigPhsReasDiag.ReceiverPorts.MeasuredOnTimeB.Cnt_u32 /end MEASUREMENT
/begin MEASUREMENT DigPhsReasDiag.MeasuredOnTimeC.Cnt_u32 "MICROSAR RTE" ULONG NO_COMPU_METHOD 0 0 0 4294967295 ECU_ADDRESS 0 SYMBOL_LINK "Rte_CDDInterface_MeasuredOnTimeC_Cnt_u32" 0 DISPLAY_IDENTIFIER DigPhsReasDiag.ReceiverPorts.MeasuredOnTimeC.Cnt_u32 /end MEASUREMENT
/begin MEASUREMENT DigPhsReasDiag.MotorVelMRFUnfiltered.MtrRadpS_f32 "MICROSAR RTE" FLOAT32_IEEE NO_COMPU_METHOD 0 0 1.175494351e-38 3.402823466e+38 ECU_ADDRESS 0 SYMBOL_LINK "Rte_MtrVel_MRFMotorVelUnfiltered_MtrRadpS_f32" 0 DISPLAY_IDENTIFIER DigPhsReasDiag.ReceiverPorts.MotorVelMRFUnfiltered.MtrRadpS_f32 /end MEASUREMENT
/begin MEASUREMENT DigPhsReasDiag.MtrElecMechPolarity.Cnt_s08 "MICROSAR RTE" SBYTE NO_COMPU_METHOD 0 0 -128 127 ECU_ADDRESS 0 SYMBOL_LINK "Rte_Polarity_MtrElecMechPolarity_Cnt_s08" 0 DISPLAY_IDENTIFIER DigPhsReasDiag.ReceiverPorts.MtrElecMechPolarity.Cnt_s08 /end MEASUREMENT
/begin MEASUREMENT DigPhsReasDiag.PDActivateTest.Cnt_lgc "MICROSAR RTE" UBYTE RTE_CM_BOOLEAN 0 0 0 255 ECU_ADDRESS 0 SYMBOL_LINK "Rte_DigPhsReasDiag_PDActivateTest_Cnt_lgc" 0 DISPLAY_IDENTIFIER DigPhsReasDiag.ReceiverPorts.PDActivateTest.Cnt_lgc /end MEASUREMENT
/begin MEASUREMENT DigPhsReasDiag.SystemState.Mode "MICROSAR RTE" UBYTE RTE_CM_ENUM_StaMd_Mode 0 0 0 255 ECU_ADDRESS 0 SYMBOL_LINK "Rte_ModeMachine_StaMd_SystemState_Mode" 0 DISPLAY_IDENTIFIER DigPhsReasDiag.ModeRequirePorts.SystemState.Mode /end MEASUREMENT
/begin MEASUREMENT EOTActuatorMng.AssistEOTDamping.MtrNm_f32 "MICROSAR RTE" FLOAT32_IEEE NO_COMPU_METHOD 0 0 1.175494351e-38 3.402823466e+38 ECU_ADDRESS 0 SYMBOL_LINK "Rte_EOTActuatorMng_AssistEOTDamping_MtrNm_f32" 0 DISPLAY_IDENTIFIER EOTActuatorMng.SenderPorts.AssistEOTDamping.MtrNm_f32 /end MEASUREMENT
/begin MEASUREMENT EOTActuatorMng.AssistEOTGain.Uls_f32 "MICROSAR RTE" FLOAT32_IEEE NO_COMPU_METHOD 0 0 1.175494351e-38 3.402823466e+38 ECU_ADDRESS 0 SYMBOL_LINK "Rte_EOTActuatorMng_AssistEOTGain_Uls_f32" 0 DISPLAY_IDENTIFIER EOTActuatorMng.SenderPorts.AssistEOTGain.Uls_f32 /end MEASUREMENT
/begin MEASUREMENT EOTActuatorMng.AssistEOTLimit.MtrNm_f32 "MICROSAR RTE" FLOAT32_IEEE NO_COMPU_METHOD 0 0 1.175494351e-38 3.402823466e+38 ECU_ADDRESS 0 SYMBOL_LINK "Rte_EOTActuatorMng_AssistEOTLimit_MtrNm_f32" 0 DISPLAY_IDENTIFIER EOTActuatorMng.SenderPorts.AssistEOTLimit.MtrNm_f32 /end MEASUREMENT
/begin MEASUREMENT EOTActuatorMng.CcwEOT.HwDeg_f32 "MICROSAR RTE" FLOAT32_IEEE NO_COMPU_METHOD 0 0 1.175494351e-38 3.402823466e+38 ECU_ADDRESS 0 SYMBOL_LINK "Rte_Ap_LrnEOT_CCWPosition_HwDeg_f32" 0 DISPLAY_IDENTIFIER EOTActuatorMng.ReceiverPorts.CcwEOT.HwDeg_f32 /end MEASUREMENT
/begin MEASUREMENT EOTActuatorMng.CcwFound.Cnt_lgc "MICROSAR RTE" UBYTE RTE_CM_BOOLEAN 0 0 0 255 ECU_ADDRESS 0 SYMBOL_LINK "Rte_Ap_LrnEOT_CCWFound_Cnt_lgc" 0 DISPLAY_IDENTIFIER EOTActuatorMng.ReceiverPorts.CcwFound.Cnt_lgc /end MEASUREMENT
/begin MEASUREMENT EOTActuatorMng.CwEOT.HwDeg_f32 "MICROSAR RTE" FLOAT32_IEEE NO_COMPU_METHOD 0 0 1.175494351e-38 3.402823466e+38 ECU_ADDRESS 0 SYMBOL_LINK "Rte_Ap_LrnEOT_CWPosition_HwDeg_f32" 0 DISPLAY_IDENTIFIER EOTActuatorMng.ReceiverPorts.CwEOT.HwDeg_f32 /end MEASUREMENT
/begin MEASUREMENT EOTActuatorMng.CwFound.Cnt_lgc "MICROSAR RTE" UBYTE RTE_CM_BOOLEAN 0 0 0 255 ECU_ADDRESS 0 SYMBOL_LINK "Rte_Ap_LrnEOT_CWFound_Cnt_lgc" 0 DISPLAY_IDENTIFIER EOTActuatorMng.ReceiverPorts.CwFound.Cnt_lgc /end MEASUREMENT
/begin MEASUREMENT EOTActuatorMng.EOTDisable.Cnt_lgc "MICROSAR RTE" UBYTE RTE_CM_BOOLEAN 0 0 0 255 ECU_ADDRESS 0 SYMBOL_LINK "Rte_CDDInterface_EOTImpactSrlComSvcDft_Cnt_lgc" 0 DISPLAY_IDENTIFIER EOTActuatorMng.ReceiverPorts.EOTDisable.Cnt_lgc /end MEASUREMENT
/begin MEASUREMENT EOTActuatorMng.HandWheelAuth.Uls_f32 "MICROSAR RTE" FLOAT32_IEEE NO_COMPU_METHOD 0 0 1.175494351e-38 3.402823466e+38 ECU_ADDRESS 0 SYMBOL_LINK "Rte_Ap_AbsHwPosScom_HwPosAuthority_Uls_f32" 0 DISPLAY_IDENTIFIER EOTActuatorMng.ReceiverPorts.HandWheelAuth.Uls_f32 /end MEASUREMENT
/begin MEASUREMENT EOTActuatorMng.HandWheelPos.HwDeg_f32 "MICROSAR RTE" FLOAT32_IEEE NO_COMPU_METHOD 0 0 1.175494351e-38 3.402823466e+38 ECU_ADDRESS 0 SYMBOL_LINK "Rte_Ap_AbsHwPosScom_HwPos_HwDeg_f32" 0 DISPLAY_IDENTIFIER EOTActuatorMng.ReceiverPorts.HandWheelPos.HwDeg_f32 /end MEASUREMENT
/begin MEASUREMENT EOTActuatorMng.HwTorque.HwNm_f32 "MICROSAR RTE" FLOAT32_IEEE NO_COMPU_METHOD 0 0 1.175494351e-38 3.402823466e+38 ECU_ADDRESS 0 SYMBOL_LINK "Rte_HwTrq_AnaHwTorque_HwNm_f32" 0 DISPLAY_IDENTIFIER EOTActuatorMng.ReceiverPorts.HwTorque.HwNm_f32 /end MEASUREMENT
/begin MEASUREMENT EOTActuatorMng.MotorVel.MtrRadpS_f32 "MICROSAR RTE" FLOAT32_IEEE NO_COMPU_METHOD 0 0 1.175494351e-38 3.402823466e+38 ECU_ADDRESS 0 SYMBOL_LINK "Rte_MtrVel_CRFMotorVel_MtrRadpS_f32" 0 DISPLAY_IDENTIFIER EOTActuatorMng.ReceiverPorts.MotorVel.MtrRadpS_f32 /end MEASUREMENT
/begin MEASUREMENT EOTActuatorMng.PreLimitTorque.MtrNm_f32 "MICROSAR RTE" FLOAT32_IEEE NO_COMPU_METHOD 0 0 1.175494351e-38 3.402823466e+38 ECU_ADDRESS 0 SYMBOL_LINK "Rte_Ap_AstLmt_PreLimitTorque_MtrNm_f32" 0 DISPLAY_IDENTIFIER EOTActuatorMng.ReceiverPorts.PreLimitTorque.MtrNm_f32 /end MEASUREMENT
/begin MEASUREMENT EOTActuatorMng.VehicleSpeed.Kph_f32 "MICROSAR RTE" FLOAT32_IEEE NO_COMPU_METHOD 0 0 1.175494351e-38 3.402823466e+38 ECU_ADDRESS 0 SYMBOL_LINK "Rte_Ap_SignlCondn_VehicleSpeed_Kph_f32" 0 DISPLAY_IDENTIFIER EOTActuatorMng.ReceiverPorts.VehicleSpeed.Kph_f32 /end MEASUREMENT
/begin MEASUREMENT FrqDepDmpnInrtCmp.BaseAssistCmd.MtrNm_f32 "MICROSAR RTE" FLOAT32_IEEE NO_COMPU_METHOD 0 0 1.175494351e-38 3.402823466e+38 ECU_ADDRESS 0 SYMBOL_LINK "Rte_Assist_BaseAssistCmd_MtrNm_f32" 0 DISPLAY_IDENTIFIER FrqDepDmpnInrtCmp.ReceiverPorts.BaseAssistCmd.MtrNm_f32 /end MEASUREMENT
/begin MEASUREMENT FrqDepDmpnInrtCmp.CRFMotorVel.MtrRadpS_f32 "MICROSAR RTE" FLOAT32_IEEE NO_COMPU_METHOD 0 0 1.175494351e-38 3.402823466e+38 ECU_ADDRESS 0 SYMBOL_LINK "Rte_MtrVel_CRFMotorVel_MtrRadpS_f32" 0 DISPLAY_IDENTIFIER FrqDepDmpnInrtCmp.ReceiverPorts.CRFMotorVel.MtrRadpS_f32 /end MEASUREMENT
/begin MEASUREMENT FrqDepDmpnInrtCmp.FreqDepDmpSrlComSvcDft.Cnt_lgc "MICROSAR RTE" UBYTE RTE_CM_BOOLEAN 0 0 0 255 ECU_ADDRESS 0 SYMBOL_LINK "Rte_CDDInterface_FreqDepDmpSrlComSvcDft_Cnt_lgc" 0 DISPLAY_IDENTIFIER FrqDepDmpnInrtCmp.ReceiverPorts.FreqDepDmpSrlComSvcDft.Cnt_lgc /end MEASUREMENT
/begin MEASUREMENT FrqDepDmpnInrtCmp.FrqDepDmpnInrtCmp.MtrNm_f32 "MICROSAR RTE" FLOAT32_IEEE NO_COMPU_METHOD 0 0 1.175494351e-38 3.402823466e+38 ECU_ADDRESS 0 SYMBOL_LINK "Rte_FrqDepDmpnInrtCmp_FrqDepDmpnInrtCmp_MtrNm_f32" 0 DISPLAY_IDENTIFIER FrqDepDmpnInrtCmp.SenderPorts.FrqDepDmpnInrtCmp.MtrNm_f32 /end MEASUREMENT
/begin MEASUREMENT FrqDepDmpnInrtCmp.HwTorque.HwNm_f32 "MICROSAR RTE" FLOAT32_IEEE NO_COMPU_METHOD 0 0 1.175494351e-38 3.402823466e+38 ECU_ADDRESS 0 SYMBOL_LINK "Rte_HwTrq_AnaHwTorque_HwNm_f32" 0 DISPLAY_IDENTIFIER FrqDepDmpnInrtCmp.ReceiverPorts.HwTorque.HwNm_f32 /end MEASUREMENT
/begin MEASUREMENT FrqDepDmpnInrtCmp.SystemState.Mode "MICROSAR RTE" UBYTE RTE_CM_ENUM_StaMd_Mode 0 0 0 255 ECU_ADDRESS 0 SYMBOL_LINK "Rte_ModeMachine_StaMd_SystemState_Mode" 0 DISPLAY_IDENTIFIER FrqDepDmpnInrtCmp.ModeRequirePorts.SystemState.Mode /end MEASUREMENT
/begin MEASUREMENT FrqDepDmpnInrtCmp.VehicleLonAccel.KphpS_f32 "MICROSAR RTE" FLOAT32_IEEE NO_COMPU_METHOD 0 0 1.175494351e-38 3.402823466e+38 ECU_ADDRESS 0 SYMBOL_LINK "Rte_Ap_SignlCondn_Vehicle_LonAccel_KphpS_f32" 0 DISPLAY_IDENTIFIER FrqDepDmpnInrtCmp.ReceiverPorts.VehicleLonAccel.KphpS_f32 /end MEASUREMENT
/begin MEASUREMENT FrqDepDmpnInrtCmp.VehicleSpeed.Kph_f32 "MICROSAR RTE" FLOAT32_IEEE NO_COMPU_METHOD 0 0 1.175494351e-38 3.402823466e+38 ECU_ADDRESS 0 SYMBOL_LINK "Rte_Ap_SignlCondn_VehicleSpeed_Kph_f32" 0 DISPLAY_IDENTIFIER FrqDepDmpnInrtCmp.ReceiverPorts.VehicleSpeed.Kph_f32 /end MEASUREMENT
/begin MEASUREMENT FrqDepDmpnInrtCmp.WIRCmdAmpBlnd.MtrNm_f32 "MICROSAR RTE" FLOAT32_IEEE NO_COMPU_METHOD 0 0 1.175494351e-38 3.402823466e+38 ECU_ADDRESS 0 SYMBOL_LINK "Rte_Ap_WhlImbRej_WIRCmdAmpBlnd_MtrNm_f32" 0 DISPLAY_IDENTIFIER FrqDepDmpnInrtCmp.ReceiverPorts.WIRCmdAmpBlnd.MtrNm_f32 /end MEASUREMENT
/begin MEASUREMENT HiLoadStall.AssistStallLimit.MtrNm_f32 "MICROSAR RTE" FLOAT32_IEEE NO_COMPU_METHOD 0 0 1.175494351e-38 3.402823466e+38 ECU_ADDRESS 0 SYMBOL_LINK "Rte_HiLoadStall_AssistStallLimit_MtrNm_f32" 0 DISPLAY_IDENTIFIER HiLoadStall.SenderPorts.AssistStallLimit.MtrNm_f32 /end MEASUREMENT
/begin MEASUREMENT HiLoadStall.DftStallLimit.Cnt_lgc "MICROSAR RTE" UBYTE RTE_CM_BOOLEAN 0 0 0 255 ECU_ADDRESS 0 SYMBOL_LINK "Rte_CDDInterface_EOTThermalSrlComSvcDft_Cnt_lgc" 0 DISPLAY_IDENTIFIER HiLoadStall.ReceiverPorts.DftStallLimit.Cnt_lgc /end MEASUREMENT
/begin MEASUREMENT HiLoadStall.MtrVelCRF.MtrRadpS_f32 "MICROSAR RTE" FLOAT32_IEEE NO_COMPU_METHOD 0 0 1.175494351e-38 3.402823466e+38 ECU_ADDRESS 0 SYMBOL_LINK "Rte_MtrVel_CRFMotorVel_MtrRadpS_f32" 0 DISPLAY_IDENTIFIER HiLoadStall.ReceiverPorts.MtrVelCRF.MtrRadpS_f32 /end MEASUREMENT
/begin MEASUREMENT HiLoadStall.PreLimitForStall.MtrNm_f32 "MICROSAR RTE" FLOAT32_IEEE NO_COMPU_METHOD 0 0 1.175494351e-38 3.402823466e+38 ECU_ADDRESS 0 SYMBOL_LINK "Rte_Ap_AstLmt_PreLimitForStall_MtrNm_f32" 0 DISPLAY_IDENTIFIER HiLoadStall.ReceiverPorts.PreLimitForStall.MtrNm_f32 /end MEASUREMENT
/begin MEASUREMENT HighFreqAssist.HighFreqAssist.MtrNm_f32 "MICROSAR RTE" FLOAT32_IEEE NO_COMPU_METHOD 0 0 1.175494351e-38 3.402823466e+38 ECU_ADDRESS 0 SYMBOL_LINK "Rte_HighFreqAssist_HighFreqAssist_MtrNm_f32" 0 DISPLAY_IDENTIFIER HighFreqAssist.SenderPorts.HighFreqAssist.MtrNm_f32 /end MEASUREMENT
/begin MEASUREMENT HighFreqAssist.HwTorque.HwNm_f32 "MICROSAR RTE" FLOAT32_IEEE NO_COMPU_METHOD 0 0 1.175494351e-38 3.402823466e+38 ECU_ADDRESS 0 SYMBOL_LINK "Rte_HwTrq_AnaHwTorque_HwNm_f32" 0 DISPLAY_IDENTIFIER HighFreqAssist.ReceiverPorts.HwTorque.HwNm_f32 /end MEASUREMENT
/begin MEASUREMENT HighFreqAssist.VehicleSpeed.Kph_f32 "MICROSAR RTE" FLOAT32_IEEE NO_COMPU_METHOD 0 0 1.175494351e-38 3.402823466e+38 ECU_ADDRESS 0 SYMBOL_LINK "Rte_Ap_SignlCondn_VehicleSpeed_Kph_f32" 0 DISPLAY_IDENTIFIER HighFreqAssist.ReceiverPorts.VehicleSpeed.Kph_f32 /end MEASUREMENT
/begin MEASUREMENT HighFreqAssist.WIRCmdAmpBlnd.MtrNm_f32 "MICROSAR RTE" FLOAT32_IEEE NO_COMPU_METHOD 0 0 1.175494351e-38 3.402823466e+38 ECU_ADDRESS 0 SYMBOL_LINK "Rte_Ap_WhlImbRej_WIRCmdAmpBlnd_MtrNm_f32" 0 DISPLAY_IDENTIFIER HighFreqAssist.ReceiverPorts.WIRCmdAmpBlnd.MtrNm_f32 /end MEASUREMENT
/begin MEASUREMENT HwTrq.AbsPosStepSignal.Cnt_u08 "MICROSAR RTE" UBYTE NO_COMPU_METHOD 0 0 0 255 ECU_ADDRESS 0 SYMBOL_LINK "Rte_HwTrq_AbsPosStepSignal_Cnt_u08" 0 DISPLAY_IDENTIFIER HwTrq.ReceiverPorts.AbsPosStepSignal.Cnt_u08 /end MEASUREMENT
/begin MEASUREMENT HwTrq.AnaDiffHwTrq.Volt_f32 "This signal is intended to communicate any type voltage signal measured by the ecu.  This signal has a lower limit of 0 which reequires users of the signal to provide divide by 0 protection if it is used as a denominator in a calculation.  See Vecu port p" FLOAT32_IEEE NO_COMPU_METHOD 0 0 1.175494351e-38 3.402823466e+38 ECU_ADDRESS 0 SYMBOL_LINK "Rte_HwTrq_AnaDiffHwTrq_Volt_f32" 0 DISPLAY_IDENTIFIER HwTrq.SenderPorts.AnaDiffHwTrq.Volt_f32 /end MEASUREMENT
/begin MEASUREMENT HwTrq.AnaHwTorque.HwNm_f32 "MICROSAR RTE" FLOAT32_IEEE NO_COMPU_METHOD 0 0 1.175494351e-38 3.402823466e+38 ECU_ADDRESS 0 SYMBOL_LINK "Rte_HwTrq_AnaHwTorque_HwNm_f32" 0 DISPLAY_IDENTIFIER HwTrq.SenderPorts.AnaHwTorque.HwNm_f32 /end MEASUREMENT
/begin MEASUREMENT HwTrq.CntrlDisRampComplete.Cnt_lgc "MICROSAR RTE" UBYTE RTE_CM_BOOLEAN 0 0 0 255 ECU_ADDRESS 0 SYMBOL_LINK "Rte_CtrldDisShtdn_CtrldDmpStsCmp_Cnt_lgc" 0 DISPLAY_IDENTIFIER HwTrq.ReceiverPorts.CntrlDisRampComplete.Cnt_lgc /end MEASUREMENT
/begin MEASUREMENT HwTrq.EOLTrqStepData "MICROSAR RTE" FLOAT32_IEEE NO_COMPU_METHOD 0 0 1.175494351e-38 3.402823466e+38 MATRIX_DIM 10 1 1 ECU_ADDRESS 0 SYMBOL_LINK "Rte_HwTrq_EOLTrqStepData" 0 DISPLAY_IDENTIFIER HwTrq.PerInstanceMemories.EOLTrqStepData READ_WRITE /end MEASUREMENT
/begin MEASUREMENT HwTrq.HwTrqScaleData.HwTrqScalePerf_Cnt_lgc "MICROSAR RTE" UBYTE RTE_CM_BOOLEAN 0 0 0 255 ECU_ADDRESS 0 SYMBOL_LINK "Rte_HwTrq_HwTrqScaleData.HwTrqScalePerf_Cnt_lgc" 0 DISPLAY_IDENTIFIER HwTrq.PerInstanceMemories.HwTrqScaleData.HwTrqScalePerf_Cnt_lgc READ_WRITE /end MEASUREMENT
/begin MEASUREMENT HwTrq.HwTrqScaleData.HwTrqScale_VoltsPerDeg_f32 "MICROSAR RTE" FLOAT32_IEEE NO_COMPU_METHOD 0 0 1.175494351e-38 3.402823466e+38 ECU_ADDRESS 0 SYMBOL_LINK "Rte_HwTrq_HwTrqScaleData.HwTrqScale_VoltsPerDeg_f32" 0 DISPLAY_IDENTIFIER HwTrq.PerInstanceMemories.HwTrqScaleData.HwTrqScale_VoltsPerDeg_f32 READ_WRITE /end MEASUREMENT
/begin MEASUREMENT HwTrq.HwTrqScaleVal.VoltsPerDeg_f32 "MICROSAR RTE" FLOAT32_IEEE NO_COMPU_METHOD 0 0 1.175494351e-38 3.402823466e+38 ECU_ADDRESS 0 SYMBOL_LINK "Rte_HwTrq_HwTrqScaleVal_VoltsPerDeg_f32" 0 DISPLAY_IDENTIFIER HwTrq.SenderPorts.HwTrqScaleVal.VoltsPerDeg_f32 /end MEASUREMENT
/begin MEASUREMENT HwTrq.HwTrqTrimData.HwTrqTrimPerf_Cnt_lgc "MICROSAR RTE" UBYTE RTE_CM_BOOLEAN 0 0 0 255 ECU_ADDRESS 0 SYMBOL_LINK "Rte_HwTrq_HwTrqTrimData.HwTrqTrimPerf_Cnt_lgc" 0 DISPLAY_IDENTIFIER HwTrq.PerInstanceMemories.HwTrqTrimData.HwTrqTrimPerf_Cnt_lgc READ_WRITE /end MEASUREMENT
/begin MEASUREMENT HwTrq.HwTrqTrimData.HwTrqTrim_Volts_f32 "MICROSAR RTE" FLOAT32_IEEE NO_COMPU_METHOD 0 0 1.175494351e-38 3.402823466e+38 ECU_ADDRESS 0 SYMBOL_LINK "Rte_HwTrq_HwTrqTrimData.HwTrqTrim_Volts_f32" 0 DISPLAY_IDENTIFIER HwTrq.PerInstanceMemories.HwTrqTrimData.HwTrqTrim_Volts_f32 READ_WRITE /end MEASUREMENT
/begin MEASUREMENT HwTrq.HwTrqTrimData.T1Trim_Volts_f32 "MICROSAR RTE" FLOAT32_IEEE NO_COMPU_METHOD 0 0 1.175494351e-38 3.402823466e+38 ECU_ADDRESS 0 SYMBOL_LINK "Rte_HwTrq_HwTrqTrimData.T1Trim_Volts_f32" 0 DISPLAY_IDENTIFIER HwTrq.PerInstanceMemories.HwTrqTrimData.T1Trim_Volts_f32 READ_WRITE /end MEASUREMENT
/begin MEASUREMENT HwTrq.HwTrqTrimData.T2Trim_Volts_f32 "MICROSAR RTE" FLOAT32_IEEE NO_COMPU_METHOD 0 0 1.175494351e-38 3.402823466e+38 ECU_ADDRESS 0 SYMBOL_LINK "Rte_HwTrq_HwTrqTrimData.T2Trim_Volts_f32" 0 DISPLAY_IDENTIFIER HwTrq.PerInstanceMemories.HwTrqTrimData.T2Trim_Volts_f32 READ_WRITE /end MEASUREMENT
/begin MEASUREMENT HwTrq.MECCounter.Cnt_enum "MICROSAR RTE" UBYTE RTE_CM_ENUM_ManufModeType 0 0 0 2 ECU_ADDRESS 0 SYMBOL_LINK "Rte_CDDInterface_MEC_Cnt_enum" 0 DISPLAY_IDENTIFIER HwTrq.ReceiverPorts.MECCounter.Cnt_enum /end MEASUREMENT
/begin MEASUREMENT HwTrq.SrlComHwTrqValid.Cnt_lgc "MICROSAR RTE" UBYTE RTE_CM_BOOLEAN 0 0 0 255 ECU_ADDRESS 0 SYMBOL_LINK "Rte_HwTrq_SrlComHwTrqValid_Cnt_lgc" 0 DISPLAY_IDENTIFIER HwTrq.SenderPorts.SrlComHwTrqValid.Cnt_lgc /end MEASUREMENT
/begin MEASUREMENT HwTrq.SysCAnaHwTorque.HwNm_f32 "MICROSAR RTE" FLOAT32_IEEE NO_COMPU_METHOD 0 0 1.175494351e-38 3.402823466e+38 ECU_ADDRESS 0 SYMBOL_LINK "Rte_HwTrq_SysCAnaHwTorque_HwNm_f32" 0 DISPLAY_IDENTIFIER HwTrq.SenderPorts.SysCAnaHwTorque.HwNm_f32 /end MEASUREMENT
/begin MEASUREMENT HwTrq.T1ADC.Volt_f32 "This signal is intended to communicate any type voltage signal measured by the ecu.  This signal has a lower limit of 0 which reequires users of the signal to provide divide by 0 protection if it is used as a denominator in a calculation.  See Vecu port p" FLOAT32_IEEE NO_COMPU_METHOD 0 0 1.175494351e-38 3.402823466e+38 ECU_ADDRESS 0 SYMBOL_LINK "Rte_IoHwAbstractionUsr_T1ADC_Volt_f32" 0 DISPLAY_IDENTIFIER HwTrq.ReceiverPorts.T1ADC.Volt_f32 /end MEASUREMENT
/begin MEASUREMENT HwTrq.T1TrimVal.Volt_f32 "This signal is intended to communicate any type voltage signal measured by the ecu.  This signal has a lower limit of 0 which reequires users of the signal to provide divide by 0 protection if it is used as a denominator in a calculation.  See Vecu port p" FLOAT32_IEEE NO_COMPU_METHOD 0 0 1.175494351e-38 3.402823466e+38 ECU_ADDRESS 0 SYMBOL_LINK "Rte_HwTrq_T1TrimVal_Volt_f32" 0 DISPLAY_IDENTIFIER HwTrq.SenderPorts.T1TrimVal.Volt_f32 /end MEASUREMENT
/begin MEASUREMENT HwTrq.T2ADC.Volt_f32 "This signal is intended to communicate any type voltage signal measured by the ecu.  This signal has a lower limit of 0 which reequires users of the signal to provide divide by 0 protection if it is used as a denominator in a calculation.  See Vecu port p" FLOAT32_IEEE NO_COMPU_METHOD 0 0 1.175494351e-38 3.402823466e+38 ECU_ADDRESS 0 SYMBOL_LINK "Rte_IoHwAbstractionUsr_T2ADC_Volt_f32" 0 DISPLAY_IDENTIFIER HwTrq.ReceiverPorts.T2ADC.Volt_f32 /end MEASUREMENT
/begin MEASUREMENT HwTrq.T2TrimVal.Volt_f32 "This signal is intended to communicate any type voltage signal measured by the ecu.  This signal has a lower limit of 0 which reequires users of the signal to provide divide by 0 protection if it is used as a denominator in a calculation.  See Vecu port p" FLOAT32_IEEE NO_COMPU_METHOD 0 0 1.175494351e-38 3.402823466e+38 ECU_ADDRESS 0 SYMBOL_LINK "Rte_HwTrq_T2TrimVal_Volt_f32" 0 DISPLAY_IDENTIFIER HwTrq.SenderPorts.T2TrimVal.Volt_f32 /end MEASUREMENT
/begin MEASUREMENT HystComp.AssistMechTempEst.DegC_f32 "MICROSAR RTE" FLOAT32_IEEE NO_COMPU_METHOD 0 0 1.175494351e-38 3.402823466e+38 ECU_ADDRESS 0 SYMBOL_LINK "Rte_Ap_MtrTempEst_AssistMechTempEst_DegC_f32" 0 DISPLAY_IDENTIFIER HystComp.ReceiverPorts.AssistMechTempEst.DegC_f32 /end MEASUREMENT
/begin MEASUREMENT HystComp.BaseAssistCmd.MtrNm_f32 "MICROSAR RTE" FLOAT32_IEEE NO_COMPU_METHOD 0 0 1.175494351e-38 3.402823466e+38 ECU_ADDRESS 0 SYMBOL_LINK "Rte_Assist_BaseAssistCmd_MtrNm_f32" 0 DISPLAY_IDENTIFIER HystComp.ReceiverPorts.BaseAssistCmd.MtrNm_f32 /end MEASUREMENT
/begin MEASUREMENT HystComp.DefeatHystService.Cnt_lgc "MICROSAR RTE" UBYTE RTE_CM_BOOLEAN 0 0 0 255 ECU_ADDRESS 0 SYMBOL_LINK "Rte_CDDInterface_HystCompSrlComSvcDft_Cnt_lgc" 0 DISPLAY_IDENTIFIER HystComp.ReceiverPorts.DefeatHystService.Cnt_lgc /end MEASUREMENT
/begin MEASUREMENT HystComp.FricOffset.HwNm_f32 "MICROSAR RTE" FLOAT32_IEEE NO_COMPU_METHOD 0 0 1.175494351e-38 3.402823466e+38 ECU_ADDRESS 0 SYMBOL_LINK "Rte_Ap_AvgFricLrn_FricOffset_HwNm_f32" 0 DISPLAY_IDENTIFIER HystComp.ReceiverPorts.FricOffset.HwNm_f32 /end MEASUREMENT
/begin MEASUREMENT HystComp.HwTorque.HwNm_f32 "MICROSAR RTE" FLOAT32_IEEE NO_COMPU_METHOD 0 0 1.175494351e-38 3.402823466e+38 ECU_ADDRESS 0 SYMBOL_LINK "Rte_HwTrq_AnaHwTorque_HwNm_f32" 0 DISPLAY_IDENTIFIER HystComp.ReceiverPorts.HwTorque.HwNm_f32 /end MEASUREMENT
/begin MEASUREMENT HystComp.HysteresisComp.MtrNm_f32 "MICROSAR RTE" FLOAT32_IEEE NO_COMPU_METHOD 0 0 1.175494351e-38 3.402823466e+38 ECU_ADDRESS 0 SYMBOL_LINK "Rte_HystComp_HysteresisComp_MtrNm_f32" 0 DISPLAY_IDENTIFIER HystComp.SenderPorts.HysteresisComp.MtrNm_f32 /end MEASUREMENT
/begin MEASUREMENT HystComp.VehicleSpeed.Kph_f32 "MICROSAR RTE" FLOAT32_IEEE NO_COMPU_METHOD 0 0 1.175494351e-38 3.402823466e+38 ECU_ADDRESS 0 SYMBOL_LINK "Rte_Ap_SignlCondn_VehicleSpeed_Kph_f32" 0 DISPLAY_IDENTIFIER HystComp.ReceiverPorts.VehicleSpeed.Kph_f32 /end MEASUREMENT
/begin MEASUREMENT HystComp.WIRCmdAmpBlnd.MtrNm_f32 "MICROSAR RTE" FLOAT32_IEEE NO_COMPU_METHOD 0 0 1.175494351e-38 3.402823466e+38 ECU_ADDRESS 0 SYMBOL_LINK "Rte_Ap_WhlImbRej_WIRCmdAmpBlnd_MtrNm_f32" 0 DISPLAY_IDENTIFIER HystComp.ReceiverPorts.WIRCmdAmpBlnd.MtrNm_f32 /end MEASUREMENT
/begin MEASUREMENT IoHwAbstractionUsr.Batt.Volt_f32 "This signal is intended to communicate any type voltage signal measured by the ecu.  This signal has a lower limit of 0 which reequires users of the signal to provide divide by 0 protection if it is used as a denominator in a calculation.  See Vecu port p" FLOAT32_IEEE NO_COMPU_METHOD 0 0 1.175494351e-38 3.402823466e+38 ECU_ADDRESS 0 SYMBOL_LINK "Rte_IoHwAbstractionUsr_Batt_Volt_f32" 0 DISPLAY_IDENTIFIER IoHwAbstractionUsr.SenderPorts.Batt.Volt_f32 /end MEASUREMENT
/begin MEASUREMENT IoHwAbstractionUsr.BattSwitched.Volt_f32 "This signal is intended to communicate any type voltage signal measured by the ecu.  This signal has a lower limit of 0 which reequires users of the signal to provide divide by 0 protection if it is used as a denominator in a calculation.  See Vecu port p" FLOAT32_IEEE NO_COMPU_METHOD 0 0 1.175494351e-38 3.402823466e+38 ECU_ADDRESS 0 SYMBOL_LINK "Rte_IoHwAbstractionUsr_BattSwitched_Volt_f32" 0 DISPLAY_IDENTIFIER IoHwAbstractionUsr.SenderPorts.BattSwitched.Volt_f32 /end MEASUREMENT
/begin MEASUREMENT IoHwAbstractionUsr.InvCos2Scaled.Volt_f32 "This signal is intended to communicate any type voltage signal measured by the ecu.  This signal has a lower limit of 0 which reequires users of the signal to provide divide by 0 protection if it is used as a denominator in a calculation.  See Vecu port p" FLOAT32_IEEE NO_COMPU_METHOD 0 0 1.175494351e-38 3.402823466e+38 ECU_ADDRESS 0 SYMBOL_LINK "Rte_IoHwAbstractionUsr_InvCos2Scaled_Volt_f32" 0 DISPLAY_IDENTIFIER IoHwAbstractionUsr.SenderPorts.InvCos2Scaled.Volt_f32 /end MEASUREMENT
/begin MEASUREMENT IoHwAbstractionUsr.InvSin2Scaled.Volt_f32 "This signal is intended to communicate any type voltage signal measured by the ecu.  This signal has a lower limit of 0 which reequires users of the signal to provide divide by 0 protection if it is used as a denominator in a calculation.  See Vecu port p" FLOAT32_IEEE NO_COMPU_METHOD 0 0 1.175494351e-38 3.402823466e+38 ECU_ADDRESS 0 SYMBOL_LINK "Rte_IoHwAbstractionUsr_InvSin2Scaled_Volt_f32" 0 DISPLAY_IDENTIFIER IoHwAbstractionUsr.SenderPorts.InvSin2Scaled.Volt_f32 /end MEASUREMENT
/begin MEASUREMENT IoHwAbstractionUsr.SysCT1ADC.Volt_f32 "This signal is intended to communicate any type voltage signal measured by the ecu.  This signal has a lower limit of 0 which reequires users of the signal to provide divide by 0 protection if it is used as a denominator in a calculation.  See Vecu port p" FLOAT32_IEEE NO_COMPU_METHOD 0 0 1.175494351e-38 3.402823466e+38 ECU_ADDRESS 0 SYMBOL_LINK "Rte_IoHwAbstractionUsr_SysCT1ADC_Volt_f32" 0 DISPLAY_IDENTIFIER IoHwAbstractionUsr.SenderPorts.SysCT1ADC.Volt_f32 /end MEASUREMENT
/begin MEASUREMENT IoHwAbstractionUsr.SysCT2ADC.Volt_f32 "This signal is intended to communicate any type voltage signal measured by the ecu.  This signal has a lower limit of 0 which reequires users of the signal to provide divide by 0 protection if it is used as a denominator in a calculation.  See Vecu port p" FLOAT32_IEEE NO_COMPU_METHOD 0 0 1.175494351e-38 3.402823466e+38 ECU_ADDRESS 0 SYMBOL_LINK "Rte_IoHwAbstractionUsr_SysCT2ADC_Volt_f32" 0 DISPLAY_IDENTIFIER IoHwAbstractionUsr.SenderPorts.SysCT2ADC.Volt_f32 /end MEASUREMENT
/begin MEASUREMENT IoHwAbstractionUsr.SysCVSwitch.Volt_f32 "This signal is intended to communicate any type voltage signal measured by the ecu.  This signal has a lower limit of 0 which reequires users of the signal to provide divide by 0 protection if it is used as a denominator in a calculation.  See Vecu port p" FLOAT32_IEEE NO_COMPU_METHOD 0 0 1.175494351e-38 3.402823466e+38 ECU_ADDRESS 0 SYMBOL_LINK "Rte_IoHwAbstractionUsr_SysCVSwitch_Volt_f32" 0 DISPLAY_IDENTIFIER IoHwAbstractionUsr.SenderPorts.SysCVSwitch.Volt_f32 /end MEASUREMENT
/begin MEASUREMENT IoHwAbstractionUsr.T1ADC.Volt_f32 "This signal is intended to communicate any type voltage signal measured by the ecu.  This signal has a lower limit of 0 which reequires users of the signal to provide divide by 0 protection if it is used as a denominator in a calculation.  See Vecu port p" FLOAT32_IEEE NO_COMPU_METHOD 0 0 1.175494351e-38 3.402823466e+38 ECU_ADDRESS 0 SYMBOL_LINK "Rte_IoHwAbstractionUsr_T1ADC_Volt_f32" 0 DISPLAY_IDENTIFIER IoHwAbstractionUsr.SenderPorts.T1ADC.Volt_f32 /end MEASUREMENT
/begin MEASUREMENT IoHwAbstractionUsr.T2ADC.Volt_f32 "This signal is intended to communicate any type voltage signal measured by the ecu.  This signal has a lower limit of 0 which reequires users of the signal to provide divide by 0 protection if it is used as a denominator in a calculation.  See Vecu port p" FLOAT32_IEEE NO_COMPU_METHOD 0 0 1.175494351e-38 3.402823466e+38 ECU_ADDRESS 0 SYMBOL_LINK "Rte_IoHwAbstractionUsr_T2ADC_Volt_f32" 0 DISPLAY_IDENTIFIER IoHwAbstractionUsr.SenderPorts.T2ADC.Volt_f32 /end MEASUREMENT
/begin MEASUREMENT IoHwAbstractionUsr.TemperatureADC.Volt_f32 "This signal is intended to communicate any type voltage signal measured by the ecu.  This signal has a lower limit of 0 which reequires users of the signal to provide divide by 0 protection if it is used as a denominator in a calculation.  See Vecu port p" FLOAT32_IEEE NO_COMPU_METHOD 0 0 1.175494351e-38 3.402823466e+38 ECU_ADDRESS 0 SYMBOL_LINK "Rte_IoHwAbstractionUsr_TemperatureADC_Volt_f32" 0 DISPLAY_IDENTIFIER IoHwAbstractionUsr.SenderPorts.TemperatureADC.Volt_f32 /end MEASUREMENT
/begin MEASUREMENT MtrDrvDiag.FETFaultPhase.Cnt_enum "MICROSAR RTE" UBYTE RTE_CM_ENUM_FETPHASETYPE_ENUM 0 0 0 255 ECU_ADDRESS 0 SYMBOL_LINK "Rte_MtrDrvDiag_FETFaultPhase_Cnt_enum" 0 DISPLAY_IDENTIFIER MtrDrvDiag.SenderPorts.FETFaultPhase.Cnt_enum /end MEASUREMENT
/begin MEASUREMENT MtrDrvDiag.FETFaultType.Cnt_enum "MICROSAR RTE" UBYTE RTE_CM_ENUM_FETFAULTTYPE_ENUM 0 0 0 255 ECU_ADDRESS 0 SYMBOL_LINK "Rte_MtrDrvDiag_FETFaultType_Cnt_enum" 0 DISPLAY_IDENTIFIER MtrDrvDiag.SenderPorts.FETFaultType.Cnt_enum /end MEASUREMENT
/begin MEASUREMENT MtrDrvDiag.MtrDrvrInitComplete.Cnt_lgc "MICROSAR RTE" UBYTE RTE_CM_BOOLEAN 0 0 0 255 ECU_ADDRESS 0 SYMBOL_LINK "Rte_MtrDrvDiag_MtrDrvrInitComplete_Cnt_lgc" 0 DISPLAY_IDENTIFIER MtrDrvDiag.SenderPorts.MtrDrvrInitComplete.Cnt_lgc /end MEASUREMENT
/begin MEASUREMENT MtrDrvDiag.MtrDrvrInitStart.Cnt_lgc "MICROSAR RTE" UBYTE RTE_CM_BOOLEAN 0 0 0 255 ECU_ADDRESS 0 SYMBOL_LINK "Rte_Ap_HwPwUp_MtrDrvrInitStart_Cnt_lgc" 0 DISPLAY_IDENTIFIER MtrDrvDiag.ReceiverPorts.MtrDrvrInitStart.Cnt_lgc /end MEASUREMENT
/begin MEASUREMENT MtrDrvDiag.SystemState.Mode "MICROSAR RTE" UBYTE RTE_CM_ENUM_StaMd_Mode 0 0 0 255 ECU_ADDRESS 0 SYMBOL_LINK "Rte_ModeMachine_StaMd_SystemState_Mode" 0 DISPLAY_IDENTIFIER MtrDrvDiag.ModeRequirePorts.SystemState.Mode /end MEASUREMENT
/begin MEASUREMENT MtrDrvDiag.VswitchClosed.Cnt_lgc "MICROSAR RTE" UBYTE RTE_CM_BOOLEAN 0 0 0 255 ECU_ADDRESS 0 SYMBOL_LINK "Rte_BatteryVoltage_VswitchClosed_Cnt_lgc" 0 DISPLAY_IDENTIFIER MtrDrvDiag.ReceiverPorts.VswitchClosed.Cnt_lgc /end MEASUREMENT
/begin MEASUREMENT MtrPos.AlignedCumMtrPosMRF.Deg_f32 "MICROSAR RTE" FLOAT32_IEEE NO_COMPU_METHOD 0 0 1.175494351e-38 3.402823466e+38 ECU_ADDRESS 0 SYMBOL_LINK "Rte_MtrPos_AlignedCumMtrPosMRF_Deg_f32" 0 DISPLAY_IDENTIFIER MtrPos.SenderPorts.AlignedCumMtrPosMRF.Deg_f32 /end MEASUREMENT
/begin MEASUREMENT MtrPos.AssistAssemblyPolarity.Cnt_s08 "MICROSAR RTE" SBYTE NO_COMPU_METHOD 0 0 -128 127 ECU_ADDRESS 0 SYMBOL_LINK "Rte_Polarity_AssistAssyPolarity_Cnt_s08" 0 DISPLAY_IDENTIFIER MtrPos.ReceiverPorts.AssistAssemblyPolarity.Cnt_s08 /end MEASUREMENT
/begin MEASUREMENT MtrPos.CumMtrPosCRF.Deg_f32 "MICROSAR RTE" FLOAT32_IEEE NO_COMPU_METHOD 0 0 1.175494351e-38 3.402823466e+38 ECU_ADDRESS 0 SYMBOL_LINK "Rte_MtrPos_CumMtrPosCRF_Deg_f32" 0 DISPLAY_IDENTIFIER MtrPos.SenderPorts.CumMtrPosCRF.Deg_f32 /end MEASUREMENT
/begin MEASUREMENT MtrPos.CumMtrPosMRF.Deg_f32 "MICROSAR RTE" FLOAT32_IEEE NO_COMPU_METHOD 0 0 1.175494351e-38 3.402823466e+38 ECU_ADDRESS 0 SYMBOL_LINK "Rte_MtrPos_CumMtrPosMRF_Deg_f32" 0 DISPLAY_IDENTIFIER MtrPos.SenderPorts.CumMtrPosMRF.Deg_f32 /end MEASUREMENT
/begin MEASUREMENT MtrPos.MtrPosSnsr_EOLData.BEMFCal_Rev_u0p16 "MICROSAR RTE" UWORD NO_COMPU_METHOD 0 0 0 65535 ECU_ADDRESS 0 SYMBOL_LINK "Rte_MtrPos_MtrPosSnsr_EOLData.BEMFCal_Rev_u0p16" 0 DISPLAY_IDENTIFIER MtrPos.PerInstanceMemories.MtrPosSnsr_EOLData.BEMFCal_Rev_u0p16 READ_WRITE /end MEASUREMENT
/begin MEASUREMENT MtrPos.MtrPosSnsr_EOLData.Cos1AmpRec_Uls_u3p13 "MICROSAR RTE" UWORD NO_COMPU_METHOD 0 0 0 65535 ECU_ADDRESS 0 SYMBOL_LINK "Rte_MtrPos_MtrPosSnsr_EOLData.Cos1AmpRec_Uls_u3p13" 0 DISPLAY_IDENTIFIER MtrPos.PerInstanceMemories.MtrPosSnsr_EOLData.Cos1AmpRec_Uls_u3p13 READ_WRITE /end MEASUREMENT
/begin MEASUREMENT MtrPos.MtrPosSnsr_EOLData.Cos1GainCorr_Uls_u1p15 "MICROSAR RTE" UWORD NO_COMPU_METHOD 0 0 0 65535 ECU_ADDRESS 0 SYMBOL_LINK "Rte_MtrPos_MtrPosSnsr_EOLData.Cos1GainCorr_Uls_u1p15" 0 DISPLAY_IDENTIFIER MtrPos.PerInstanceMemories.MtrPosSnsr_EOLData.Cos1GainCorr_Uls_u1p15 READ_WRITE /end MEASUREMENT
/begin MEASUREMENT MtrPos.MtrPosSnsr_EOLData.Cos1OffCorr_Volts_s2p13 "MICROSAR RTE" SWORD NO_COMPU_METHOD 0 0 -32768 32767 ECU_ADDRESS 0 SYMBOL_LINK "Rte_MtrPos_MtrPosSnsr_EOLData.Cos1OffCorr_Volts_s2p13" 0 DISPLAY_IDENTIFIER MtrPos.PerInstanceMemories.MtrPosSnsr_EOLData.Cos1OffCorr_Volts_s2p13 READ_WRITE /end MEASUREMENT
/begin MEASUREMENT MtrPos.MtrPosSnsr_EOLData.Cos1Offset_Volts_u3p13 "MICROSAR RTE" UWORD NO_COMPU_METHOD 0 0 0 65535 ECU_ADDRESS 0 SYMBOL_LINK "Rte_MtrPos_MtrPosSnsr_EOLData.Cos1Offset_Volts_u3p13" 0 DISPLAY_IDENTIFIER MtrPos.PerInstanceMemories.MtrPosSnsr_EOLData.Cos1Offset_Volts_u3p13 READ_WRITE /end MEASUREMENT
/begin MEASUREMENT MtrPos.MtrPosSnsr_EOLData.CosDelta1Rec_Uls_u3p13 "MICROSAR RTE" UWORD NO_COMPU_METHOD 0 0 0 65535 ECU_ADDRESS 0 SYMBOL_LINK "Rte_MtrPos_MtrPosSnsr_EOLData.CosDelta1Rec_Uls_u3p13" 0 DISPLAY_IDENTIFIER MtrPos.PerInstanceMemories.MtrPosSnsr_EOLData.CosDelta1Rec_Uls_u3p13 READ_WRITE /end MEASUREMENT
/begin MEASUREMENT MtrPos.MtrPosSnsr_EOLData.CosHarTbl_Cnt_sm6p13 "MICROSAR RTE" SBYTE NO_COMPU_METHOD 0 0 -128 127 MATRIX_DIM 144 1 1 ECU_ADDRESS 0 SYMBOL_LINK "Rte_MtrPos_MtrPosSnsr_EOLData.CosHarTbl_Cnt_sm6p13" 0 DISPLAY_IDENTIFIER MtrPos.PerInstanceMemories.MtrPosSnsr_EOLData.CosHarTbl_Cnt_sm6p13 READ_WRITE /end MEASUREMENT
/begin MEASUREMENT MtrPos.MtrPosSnsr_EOLData.R_BEMFCal_Rev_u0p16 "MICROSAR RTE" UWORD NO_COMPU_METHOD 0 0 0 65535 ECU_ADDRESS 0 SYMBOL_LINK "Rte_MtrPos_MtrPosSnsr_EOLData.R_BEMFCal_Rev_u0p16" 0 DISPLAY_IDENTIFIER MtrPos.PerInstanceMemories.MtrPosSnsr_EOLData.R_BEMFCal_Rev_u0p16 READ_WRITE /end MEASUREMENT
/begin MEASUREMENT MtrPos.MtrPosSnsr_EOLData.Sin1AmpRec_Uls_u3p13 "MICROSAR RTE" UWORD NO_COMPU_METHOD 0 0 0 65535 ECU_ADDRESS 0 SYMBOL_LINK "Rte_MtrPos_MtrPosSnsr_EOLData.Sin1AmpRec_Uls_u3p13" 0 DISPLAY_IDENTIFIER MtrPos.PerInstanceMemories.MtrPosSnsr_EOLData.Sin1AmpRec_Uls_u3p13 READ_WRITE /end MEASUREMENT
/begin MEASUREMENT MtrPos.MtrPosSnsr_EOLData.Sin1GainCorr_Uls_u1p15 "MICROSAR RTE" UWORD NO_COMPU_METHOD 0 0 0 65535 ECU_ADDRESS 0 SYMBOL_LINK "Rte_MtrPos_MtrPosSnsr_EOLData.Sin1GainCorr_Uls_u1p15" 0 DISPLAY_IDENTIFIER MtrPos.PerInstanceMemories.MtrPosSnsr_EOLData.Sin1GainCorr_Uls_u1p15 READ_WRITE /end MEASUREMENT
/begin MEASUREMENT MtrPos.MtrPosSnsr_EOLData.Sin1OffCorr_Volts_s2p13 "MICROSAR RTE" SWORD NO_COMPU_METHOD 0 0 -32768 32767 ECU_ADDRESS 0 SYMBOL_LINK "Rte_MtrPos_MtrPosSnsr_EOLData.Sin1OffCorr_Volts_s2p13" 0 DISPLAY_IDENTIFIER MtrPos.PerInstanceMemories.MtrPosSnsr_EOLData.Sin1OffCorr_Volts_s2p13 READ_WRITE /end MEASUREMENT
/begin MEASUREMENT MtrPos.MtrPosSnsr_EOLData.Sin1Offset_Volts_u3p13 "MICROSAR RTE" UWORD NO_COMPU_METHOD 0 0 0 65535 ECU_ADDRESS 0 SYMBOL_LINK "Rte_MtrPos_MtrPosSnsr_EOLData.Sin1Offset_Volts_u3p13" 0 DISPLAY_IDENTIFIER MtrPos.PerInstanceMemories.MtrPosSnsr_EOLData.Sin1Offset_Volts_u3p13 READ_WRITE /end MEASUREMENT
/begin MEASUREMENT MtrPos.MtrPosSnsr_EOLData.SinDelta1_Uls_s2p13 "MICROSAR RTE" SWORD NO_COMPU_METHOD 0 0 -32768 32767 ECU_ADDRESS 0 SYMBOL_LINK "Rte_MtrPos_MtrPosSnsr_EOLData.SinDelta1_Uls_s2p13" 0 DISPLAY_IDENTIFIER MtrPos.PerInstanceMemories.MtrPosSnsr_EOLData.SinDelta1_Uls_s2p13 READ_WRITE /end MEASUREMENT
/begin MEASUREMENT MtrPos.MtrPosSnsr_EOLData.SinHarTbl_Cnt_sm6p13 "MICROSAR RTE" SBYTE NO_COMPU_METHOD 0 0 -128 127 MATRIX_DIM 144 1 1 ECU_ADDRESS 0 SYMBOL_LINK "Rte_MtrPos_MtrPosSnsr_EOLData.SinHarTbl_Cnt_sm6p13" 0 DISPLAY_IDENTIFIER MtrPos.PerInstanceMemories.MtrPosSnsr_EOLData.SinHarTbl_Cnt_sm6p13 READ_WRITE /end MEASUREMENT
/begin MEASUREMENT MtrPos.SysCCumMtrPosCRF.Deg_f32 "MICROSAR RTE" FLOAT32_IEEE NO_COMPU_METHOD 0 0 1.175494351e-38 3.402823466e+38 ECU_ADDRESS 0 SYMBOL_LINK "Rte_MtrPos_SysCCumMtrPosCRF_Deg_f32" 0 DISPLAY_IDENTIFIER MtrPos.SenderPorts.SysCCumMtrPosCRF.Deg_f32 /end MEASUREMENT
/begin MEASUREMENT MtrPos.SysCCumMtrPosMRF.Deg_f32 "MICROSAR RTE" FLOAT32_IEEE NO_COMPU_METHOD 0 0 1.175494351e-38 3.402823466e+38 ECU_ADDRESS 0 SYMBOL_LINK "Rte_MtrPos_SysCCumMtrPosMRF_Deg_f32" 0 DISPLAY_IDENTIFIER MtrPos.SenderPorts.SysCCumMtrPosMRF.Deg_f32 /end MEASUREMENT
/begin MEASUREMENT MtrVel.AsstAssemPol.Cnt_s08 "MICROSAR RTE" SBYTE NO_COMPU_METHOD 0 0 -128 127 ECU_ADDRESS 0 SYMBOL_LINK "Rte_Polarity_AssistAssyPolarity_Cnt_s08" 0 DISPLAY_IDENTIFIER MtrVel.ReceiverPorts.AsstAssemPol.Cnt_s08 /end MEASUREMENT
/begin MEASUREMENT MtrVel.CRFMotorVel.MtrRadpS_f32 "MICROSAR RTE" FLOAT32_IEEE NO_COMPU_METHOD 0 0 1.175494351e-38 3.402823466e+38 ECU_ADDRESS 0 SYMBOL_LINK "Rte_MtrVel_CRFMotorVel_MtrRadpS_f32" 0 DISPLAY_IDENTIFIER MtrVel.SenderPorts.CRFMotorVel.MtrRadpS_f32 /end MEASUREMENT
/begin MEASUREMENT MtrVel.HandwheelVel.HwRadpS_f32 "MICROSAR RTE" FLOAT32_IEEE NO_COMPU_METHOD 0 0 1.175494351e-38 3.402823466e+38 ECU_ADDRESS 0 SYMBOL_LINK "Rte_MtrVel_HandwheelVel_HwRadpS_f32" 0 DISPLAY_IDENTIFIER MtrVel.SenderPorts.HandwheelVel.HwRadpS_f32 /end MEASUREMENT
/begin MEASUREMENT MtrVel.HwVelValid.Cnt_lgc "MICROSAR RTE" UBYTE RTE_CM_BOOLEAN 0 0 0 255 ECU_ADDRESS 0 SYMBOL_LINK "Rte_MtrVel_HwVelValid_Cnt_lgc" 0 DISPLAY_IDENTIFIER MtrVel.SenderPorts.HwVelValid.Cnt_lgc /end MEASUREMENT
/begin MEASUREMENT MtrVel.MRFMotorVel.MtrRadpS_f32 "MICROSAR RTE" FLOAT32_IEEE NO_COMPU_METHOD 0 0 1.175494351e-38 3.402823466e+38 ECU_ADDRESS 0 SYMBOL_LINK "Rte_MtrVel_MRFMotorVel_MtrRadpS_f32" 0 DISPLAY_IDENTIFIER MtrVel.SenderPorts.MRFMotorVel.MtrRadpS_f32 /end MEASUREMENT
/begin MEASUREMENT MtrVel.MRFMotorVelUnfiltered.MtrRadpS_f32 "MICROSAR RTE" FLOAT32_IEEE NO_COMPU_METHOD 0 0 1.175494351e-38 3.402823466e+38 ECU_ADDRESS 0 SYMBOL_LINK "Rte_MtrVel_MRFMotorVelUnfiltered_MtrRadpS_f32" 0 DISPLAY_IDENTIFIER MtrVel.SenderPorts.MRFMotorVelUnfiltered.MtrRadpS_f32 /end MEASUREMENT
/begin MEASUREMENT MtrVel.SysCDiagHandWheelVel.HwRadpS_f32 "MICROSAR RTE" FLOAT32_IEEE NO_COMPU_METHOD 0 0 1.175494351e-38 3.402823466e+38 ECU_ADDRESS 0 SYMBOL_LINK "Rte_Sa_MtrVel2_SysCDiagHandWheelVel_HwRadpS_f32" 0 DISPLAY_IDENTIFIER MtrVel.ReceiverPorts.SysCDiagHandWheelVel.HwRadpS_f32 /end MEASUREMENT
/begin MEASUREMENT MtrVel.SysCDiagMtrVelMRF.MtrRadpS_f32 "MICROSAR RTE" FLOAT32_IEEE NO_COMPU_METHOD 0 0 1.175494351e-38 3.402823466e+38 ECU_ADDRESS 0 SYMBOL_LINK "Rte_Sa_MtrVel2_SysCDiagMtrVelMRF_MtrRadpS_f32" 0 DISPLAY_IDENTIFIER MtrVel.ReceiverPorts.SysCDiagMtrVelMRF.MtrRadpS_f32 /end MEASUREMENT
/begin MEASUREMENT MtrVel.SysCHandwheelVel.HwRadpS_f32 "MICROSAR RTE" FLOAT32_IEEE NO_COMPU_METHOD 0 0 1.175494351e-38 3.402823466e+38 ECU_ADDRESS 0 SYMBOL_LINK "Rte_MtrVel_SysCHandwheelVel_HwRadpS_f32" 0 DISPLAY_IDENTIFIER MtrVel.SenderPorts.SysCHandwheelVel.HwRadpS_f32 /end MEASUREMENT
/begin MEASUREMENT MtrVel.SysCMotorVelMRF.MtrRadpS_f32 "MICROSAR RTE" FLOAT32_IEEE NO_COMPU_METHOD 0 0 1.175494351e-38 3.402823466e+38 ECU_ADDRESS 0 SYMBOL_LINK "Rte_MtrVel_SysCMotorVelMRF_MtrRadpS_f32" 0 DISPLAY_IDENTIFIER MtrVel.SenderPorts.SysCMotorVelMRF.MtrRadpS_f32 /end MEASUREMENT
/begin MEASUREMENT MtrVel.VehicleSpeed.Kph_f32 "MICROSAR RTE" FLOAT32_IEEE NO_COMPU_METHOD 0 0 1.175494351e-38 3.402823466e+38 ECU_ADDRESS 0 SYMBOL_LINK "Rte_Ap_SignlCondn_VehicleSpeed_Kph_f32" 0 DISPLAY_IDENTIFIER MtrVel.ReceiverPorts.VehicleSpeed.Kph_f32 /end MEASUREMENT
/begin MEASUREMENT PeakCurrEst.EstPkCurr.AmpSq_f32 "MICROSAR RTE" FLOAT32_IEEE NO_COMPU_METHOD 0 0 1.175494351e-38 3.402823466e+38 ECU_ADDRESS 0 SYMBOL_LINK "Rte_PeakCurrEst_EstPkCurr_AmpSq_f32" 0 DISPLAY_IDENTIFIER PeakCurrEst.SenderPorts.EstPkCurr.AmpSq_f32 /end MEASUREMENT
/begin MEASUREMENT PeakCurrEst.FiltEstPkCurr.AmpSq_f32 "MICROSAR RTE" FLOAT32_IEEE NO_COMPU_METHOD 0 0 1.175494351e-38 3.402823466e+38 ECU_ADDRESS 0 SYMBOL_LINK "Rte_PeakCurrEst_FiltEstPkCurr_AmpSq_f32" 0 DISPLAY_IDENTIFIER PeakCurrEst.SenderPorts.FiltEstPkCurr.AmpSq_f32 /end MEASUREMENT
/begin MEASUREMENT PeakCurrEst.MtrCurrDax.Amp_f32 "MICROSAR RTE" FLOAT32_IEEE NO_COMPU_METHOD 0 0 1.175494351e-38 3.402823466e+38 ECU_ADDRESS 0 SYMBOL_LINK "Rte_CDDInterface_MtrCurrDax_Amp_f32" 0 DISPLAY_IDENTIFIER PeakCurrEst.ReceiverPorts.MtrCurrDax.Amp_f32 /end MEASUREMENT
/begin MEASUREMENT PeakCurrEst.MtrCurrQax.Amp_f32 "MICROSAR RTE" FLOAT32_IEEE NO_COMPU_METHOD 0 0 1.175494351e-38 3.402823466e+38 ECU_ADDRESS 0 SYMBOL_LINK "Rte_CDDInterface_MtrCurrQax_Amp_f32" 0 DISPLAY_IDENTIFIER PeakCurrEst.ReceiverPorts.MtrCurrQax.Amp_f32 /end MEASUREMENT
/begin MEASUREMENT PeakCurrEst.SystemState.Mode "MICROSAR RTE" UBYTE RTE_CM_ENUM_StaMd_Mode 0 0 0 255 ECU_ADDRESS 0 SYMBOL_LINK "Rte_ModeMachine_StaMd_SystemState_Mode" 0 DISPLAY_IDENTIFIER PeakCurrEst.ModeRequirePorts.SystemState.Mode /end MEASUREMENT
/begin GROUP CDDInterface.SysCCorrectedMtrPos.Rev_f32 "MICROSAR RTE" /begin SUB_GROUP /end SUB_GROUP /begin FUNCTION_LIST /end FUNCTION_LIST /begin REF_CHARACTERISTIC /end REF_CHARACTERISTIC /begin REF_MEASUREMENT CDDInterface.SysCCorrectedMtrPos.Rev_f32 /end REF_MEASUREMENT /end GROUP
/begin GROUP CDDInterface.SystemState.Mode "MICROSAR RTE" /begin SUB_GROUP /end SUB_GROUP /begin FUNCTION_LIST /end FUNCTION_LIST /begin REF_CHARACTERISTIC /end REF_CHARACTERISTIC /begin REF_MEASUREMENT CDDInterface.SystemState.Mode /end REF_MEASUREMENT /end GROUP
/begin GROUP CDDInterface.TOEOLDisable.Cnt_lgc "MICROSAR RTE" /begin SUB_GROUP /end SUB_GROUP /begin FUNCTION_LIST /end FUNCTION_LIST /begin REF_CHARACTERISTIC /end REF_CHARACTERISTIC /begin REF_MEASUREMENT CDDInterface.TOEOLDisable.Cnt_lgc /end REF_MEASUREMENT /end GROUP
/begin GROUP CDDInterface.ThermalDCSrlComSvcDft.Cnt_lgc "MICROSAR RTE" /begin SUB_GROUP /end SUB_GROUP /begin FUNCTION_LIST /end FUNCTION_LIST /begin REF_CHARACTERISTIC /end REF_CHARACTERISTIC /begin REF_MEASUREMENT CDDInterface.ThermalDCSrlComSvcDft.Cnt_lgc /end REF_MEASUREMENT /end GROUP
/begin GROUP CDDInterface.TrqRmpSrlComSvcDft.Cnt_lgc "MICROSAR RTE" /begin SUB_GROUP /end SUB_GROUP /begin FUNCTION_LIST /end FUNCTION_LIST /begin REF_CHARACTERISTIC /end REF_CHARACTERISTIC /begin REF_MEASUREMENT CDDInterface.TrqRmpSrlComSvcDft.Cnt_lgc /end REF_MEASUREMENT /end GROUP
/begin GROUP CDDInterface.Vecu.Volt_f32 "MICROSAR RTE" /begin SUB_GROUP /end SUB_GROUP /begin FUNCTION_LIST /end FUNCTION_LIST /begin REF_CHARACTERISTIC /end REF_CHARACTERISTIC /begin REF_MEASUREMENT CDDInterface.Vecu.Volt_f32 /end REF_MEASUREMENT /end GROUP
/begin GROUP CDDInterface.WIREnabled.Cnt_lgc "MICROSAR RTE" /begin SUB_GROUP /end SUB_GROUP /begin FUNCTION_LIST /end FUNCTION_LIST /begin REF_CHARACTERISTIC /end REF_CHARACTERISTIC /begin REF_MEASUREMENT CDDInterface.WIREnabled.Cnt_lgc /end REF_MEASUREMENT /end GROUP
/begin GROUP CDDInterface.WhlImbRejSrlComSvcDft.Cnt_lgc "MICROSAR RTE" /begin SUB_GROUP /end SUB_GROUP /begin FUNCTION_LIST /end FUNCTION_LIST /begin REF_CHARACTERISTIC /end REF_CHARACTERISTIC /begin REF_MEASUREMENT CDDInterface.WhlImbRejSrlComSvcDft.Cnt_lgc /end REF_MEASUREMENT /end GROUP
/begin GROUP CmMtrCurr "MICROSAR RTE"
 /begin SUB_GROUP CmMtrCurr.ModeRequirePorts CmMtrCurr.PerInstanceMemories CmMtrCurr.ReceiverPorts CmMtrCurr.SenderPorts /end SUB_GROUP
 /begin FUNCTION_LIST /end FUNCTION_LIST
 /begin REF_CHARACTERISTIC /end REF_CHARACTERISTIC
 /begin REF_MEASUREMENT /end REF_MEASUREMENT
/end GROUP
/begin GROUP CmMtrCurr.ADCMtrCurr1.Volts_f32 "MICROSAR RTE" /begin SUB_GROUP /end SUB_GROUP /begin FUNCTION_LIST /end FUNCTION_LIST /begin REF_CHARACTERISTIC /end REF_CHARACTERISTIC /begin REF_MEASUREMENT CmMtrCurr.ADCMtrCurr1.Volts_f32 /end REF_MEASUREMENT /end GROUP
/begin GROUP CmMtrCurr.ADCMtrCurr2.Volts_f32 "MICROSAR RTE" /begin SUB_GROUP /end SUB_GROUP /begin FUNCTION_LIST /end FUNCTION_LIST /begin REF_CHARACTERISTIC /end REF_CHARACTERISTIC /begin REF_MEASUREMENT CmMtrCurr.ADCMtrCurr2.Volts_f32 /end REF_MEASUREMENT /end GROUP
/begin GROUP CmMtrCurr.ComOffset.Cnt_u16 "MICROSAR RTE" /begin SUB_GROUP /end SUB_GROUP /begin FUNCTION_LIST /end FUNCTION_LIST /begin REF_CHARACTERISTIC /end REF_CHARACTERISTIC /begin REF_MEASUREMENT CmMtrCurr.ComOffset.Cnt_u16 /end REF_MEASUREMENT /end GROUP
/begin GROUP CmMtrCurr.CorrMtrCurrPosition.Rev_f32 "MICROSAR RTE" /begin SUB_GROUP /end SUB_GROUP /begin FUNCTION_LIST /end FUNCTION_LIST /begin REF_CHARACTERISTIC /end REF_CHARACTERISTIC /begin REF_MEASUREMENT CmMtrCurr.CorrMtrCurrPosition.Rev_f32 /end REF_MEASUREMENT /end GROUP
/begin GROUP CmMtrCurr.CurrTempOffset "MICROSAR RTE" /begin SUB_GROUP /end SUB_GROUP /begin FUNCTION_LIST /end FUNCTION_LIST /begin REF_CHARACTERISTIC /end REF_CHARACTERISTIC
 /begin REF_MEASUREMENT CmMtrCurr.CurrTempOffset.CurrOffsetY1_Volts_s4p11 CmMtrCurr.CurrTempOffset.CurrOffsetY2_Volts_s4p11 CmMtrCurr.CurrTempOffset.CurrTempOffsetX_DegC_s10p5 /end REF_MEASUREMENT
/end GROUP
/begin GROUP CmMtrCurr.CurrentGainSvc.Cnt_lgc "MICROSAR RTE" /begin SUB_GROUP /end SUB_GROUP /begin FUNCTION_LIST /end FUNCTION_LIST /begin REF_CHARACTERISTIC /end REF_CHARACTERISTIC /begin REF_MEASUREMENT CmMtrCurr.CurrentGainSvc.Cnt_lgc /end REF_MEASUREMENT /end GROUP
/begin GROUP CmMtrCurr.FiltCntrlTemp.DegC_f32 "MICROSAR RTE" /begin SUB_GROUP /end SUB_GROUP /begin FUNCTION_LIST /end FUNCTION_LIST /begin REF_CHARACTERISTIC /end REF_CHARACTERISTIC /begin REF_MEASUREMENT CmMtrCurr.FiltCntrlTemp.DegC_f32 /end REF_MEASUREMENT /end GROUP
/begin GROUP CmMtrCurr.MEC.Cnt_enum "MICROSAR RTE" /begin SUB_GROUP /end SUB_GROUP /begin FUNCTION_LIST /end FUNCTION_LIST /begin REF_CHARACTERISTIC /end REF_CHARACTERISTIC /begin REF_MEASUREMENT CmMtrCurr.MEC.Cnt_enum /end REF_MEASUREMENT /end GROUP
/begin GROUP CmMtrCurr.ModeRequirePorts "MICROSAR RTE" /begin SUB_GROUP CmMtrCurr.SystemState.Mode /end SUB_GROUP /begin FUNCTION_LIST /end FUNCTION_LIST /begin REF_CHARACTERISTIC /end REF_CHARACTERISTIC /begin REF_MEASUREMENT /end REF_MEASUREMENT /end GROUP
/begin GROUP CmMtrCurr.MtrCurr1TempOffset.Volt_f32 "MICROSAR RTE" /begin SUB_GROUP /end SUB_GROUP /begin FUNCTION_LIST /end FUNCTION_LIST /begin REF_CHARACTERISTIC /end REF_CHARACTERISTIC /begin REF_MEASUREMENT CmMtrCurr.MtrCurr1TempOffset.Volt_f32 /end REF_MEASUREMENT /end GROUP
/begin GROUP CmMtrCurr.MtrCurr2TempOffset.Volt_f32 "MICROSAR RTE" /begin SUB_GROUP /end SUB_GROUP /begin FUNCTION_LIST /end FUNCTION_LIST /begin REF_CHARACTERISTIC /end REF_CHARACTERISTIC /begin REF_MEASUREMENT CmMtrCurr.MtrCurr2TempOffset.Volt_f32 /end REF_MEASUREMENT /end GROUP
/begin GROUP CmMtrCurr.MtrCurrAngle.Rev_f32 "MICROSAR RTE" /begin SUB_GROUP /end SUB_GROUP /begin FUNCTION_LIST /end FUNCTION_LIST /begin REF_CHARACTERISTIC /end REF_CHARACTERISTIC /begin REF_MEASUREMENT CmMtrCurr.MtrCurrAngle.Rev_f32 /end REF_MEASUREMENT /end GROUP
/begin GROUP CmMtrCurr.MtrCurrK1.Amp_f32 "MICROSAR RTE" /begin SUB_GROUP /end SUB_GROUP /begin FUNCTION_LIST /end FUNCTION_LIST /begin REF_CHARACTERISTIC /end REF_CHARACTERISTIC /begin REF_MEASUREMENT CmMtrCurr.MtrCurrK1.Amp_f32 /end REF_MEASUREMENT /end GROUP
/begin GROUP CmMtrCurr.MtrCurrK2.Amp_f32 "MICROSAR RTE" /begin SUB_GROUP /end SUB_GROUP /begin FUNCTION_LIST /end FUNCTION_LIST /begin REF_CHARACTERISTIC /end REF_CHARACTERISTIC /begin REF_MEASUREMENT CmMtrCurr.MtrCurrK2.Amp_f32 /end REF_MEASUREMENT /end GROUP
/begin GROUP CmMtrCurr.MtrVel.MtrRadpS_f32 "MICROSAR RTE" /begin SUB_GROUP /end SUB_GROUP /begin FUNCTION_LIST /end FUNCTION_LIST /begin REF_CHARACTERISTIC /end REF_CHARACTERISTIC /begin REF_MEASUREMENT CmMtrCurr.MtrVel.MtrRadpS_f32 /end REF_MEASUREMENT /end GROUP
/begin GROUP CmMtrCurr.PerInstanceMemories "MICROSAR RTE" /begin SUB_GROUP CmMtrCurr.CurrTempOffset CmMtrCurr.ShCurrCal /end SUB_GROUP /begin FUNCTION_LIST /end FUNCTION_LIST /begin REF_CHARACTERISTIC /end REF_CHARACTERISTIC /begin REF_MEASUREMENT /end REF_MEASUREMENT /end GROUP
/begin GROUP CmMtrCurr.ReceiverPorts "MICROSAR RTE"
 /begin SUB_GROUP CmMtrCurr.ADCMtrCurr1.Volts_f32 CmMtrCurr.ADCMtrCurr2.Volts_f32 CmMtrCurr.CorrMtrCurrPosition.Rev_f32 CmMtrCurr.FiltCntrlTemp.DegC_f32 CmMtrCurr.MEC.Cnt_enum CmMtrCurr.MtrCurrAngle.Rev_f32 CmMtrCurr.MtrCurrK1.Amp_f32 CmMtrCurr.MtrCurrK2.Amp_f32 CmMtrCurr.MtrVel.MtrRadpS_f32 CmMtrCurr.SrlComSvcDft.Cnt_b32 CmMtrCurr.Vecu.Volt_f32 CmMtrCurr.VehSpd.Kph_f32 CmMtrCurr.VhSpdValid.Cnt_lgc /end SUB_GROUP
 /begin FUNCTION_LIST /end FUNCTION_LIST
 /begin REF_CHARACTERISTIC /end REF_CHARACTERISTIC
 /begin REF_MEASUREMENT /end REF_MEASUREMENT
/end GROUP
/begin GROUP CmMtrCurr.SenderPorts "MICROSAR RTE"
 /begin SUB_GROUP CmMtrCurr.ComOffset.Cnt_u16 CmMtrCurr.CurrentGainSvc.Cnt_lgc CmMtrCurr.MtrCurr1TempOffset.Volt_f32 CmMtrCurr.MtrCurr2TempOffset.Volt_f32 /end SUB_GROUP
 /begin FUNCTION_LIST /end FUNCTION_LIST
 /begin REF_CHARACTERISTIC /end REF_CHARACTERISTIC
 /begin REF_MEASUREMENT /end REF_MEASUREMENT
/end GROUP
/begin GROUP CmMtrCurr.ShCurrCal "MICROSAR RTE" /begin SUB_GROUP /end SUB_GROUP /begin FUNCTION_LIST /end FUNCTION_LIST /begin REF_CHARACTERISTIC /end REF_CHARACTERISTIC
 /begin REF_MEASUREMENT CmMtrCurr.ShCurrCal.EOLMtrCurr1OffsetDiff_Volts_f32 CmMtrCurr.ShCurrCal.EOLMtrCurr1OffsetLo_Volts_f32 CmMtrCurr.ShCurrCal.EOLMtrCurr2OffsetDiff_Volts_f32 CmMtrCurr.ShCurrCal.EOLMtrCurr2OffsetLo_Volts_f32 CmMtrCurr.ShCurrCal.EOLMtrCurrVcalCmd_VoltCnts_f32 CmMtrCurr.ShCurrCal.EOLPhscurr1Gain_AmpspVolt_f32 CmMtrCurr.ShCurrCal.EOLPhscurr2Gain_AmpspVolt_f32 /end REF_MEASUREMENT
/end GROUP
/begin GROUP CmMtrCurr.SrlComSvcDft.Cnt_b32 "MICROSAR RTE" /begin SUB_GROUP /end SUB_GROUP /begin FUNCTION_LIST /end FUNCTION_LIST /begin REF_CHARACTERISTIC /end REF_CHARACTERISTIC /begin REF_MEASUREMENT CmMtrCurr.SrlComSvcDft.Cnt_b32 /end REF_MEASUREMENT /end GROUP
/begin GROUP CmMtrCurr.SystemState.Mode "MICROSAR RTE" /begin SUB_GROUP /end SUB_GROUP /begin FUNCTION_LIST /end FUNCTION_LIST /begin REF_CHARACTERISTIC /end REF_CHARACTERISTIC /begin REF_MEASUREMENT CmMtrCurr.SystemState.Mode /end REF_MEASUREMENT /end GROUP
/begin GROUP CmMtrCurr.Vecu.Volt_f32 "MICROSAR RTE" /begin SUB_GROUP /end SUB_GROUP /begin FUNCTION_LIST /end FUNCTION_LIST /begin REF_CHARACTERISTIC /end REF_CHARACTERISTIC /begin REF_MEASUREMENT CmMtrCurr.Vecu.Volt_f32 /end REF_MEASUREMENT /end GROUP
/begin GROUP CmMtrCurr.VehSpd.Kph_f32 "MICROSAR RTE" /begin SUB_GROUP /end SUB_GROUP /begin FUNCTION_LIST /end FUNCTION_LIST /begin REF_CHARACTERISTIC /end REF_CHARACTERISTIC /begin REF_MEASUREMENT CmMtrCurr.VehSpd.Kph_f32 /end REF_MEASUREMENT /end GROUP
/begin GROUP CmMtrCurr.VhSpdValid.Cnt_lgc "MICROSAR RTE" /begin SUB_GROUP /end SUB_GROUP /begin FUNCTION_LIST /end FUNCTION_LIST /begin REF_CHARACTERISTIC /end REF_CHARACTERISTIC /begin REF_MEASUREMENT CmMtrCurr.VhSpdValid.Cnt_lgc /end REF_MEASUREMENT /end GROUP
/begin GROUP CtrlTemp "MICROSAR RTE" /begin SUB_GROUP CtrlTemp.ReceiverPorts CtrlTemp.SenderPorts /end SUB_GROUP /begin FUNCTION_LIST /end FUNCTION_LIST /begin REF_CHARACTERISTIC /end REF_CHARACTERISTIC /begin REF_MEASUREMENT /end REF_MEASUREMENT /end GROUP
/begin GROUP CtrlTemp.AmbTemp.DegC_f32 "MICROSAR RTE" /begin SUB_GROUP /end SUB_GROUP /begin FUNCTION_LIST /end FUNCTION_LIST /begin REF_CHARACTERISTIC /end REF_CHARACTERISTIC /begin REF_MEASUREMENT CtrlTemp.AmbTemp.DegC_f32 /end REF_MEASUREMENT /end GROUP
/begin GROUP CtrlTemp.DiagStsTempRdPrf.Cnt_lgc "MICROSAR RTE" /begin SUB_GROUP /end SUB_GROUP /begin FUNCTION_LIST /end FUNCTION_LIST /begin REF_CHARACTERISTIC /end REF_CHARACTERISTIC /begin REF_MEASUREMENT CtrlTemp.DiagStsTempRdPrf.Cnt_lgc /end REF_MEASUREMENT /end GROUP
/begin GROUP CtrlTemp.FiltMeasTemp.DegC_f32 "MICROSAR RTE" /begin SUB_GROUP /end SUB_GROUP /begin FUNCTION_LIST /end FUNCTION_LIST /begin REF_CHARACTERISTIC /end REF_CHARACTERISTIC /begin REF_MEASUREMENT CtrlTemp.FiltMeasTemp.DegC_f32 /end REF_MEASUREMENT /end GROUP
/begin GROUP CtrlTemp.ReceiverPorts "MICROSAR RTE"
 /begin SUB_GROUP CtrlTemp.AmbTemp.DegC_f32 CtrlTemp.DiagStsTempRdPrf.Cnt_lgc CtrlTemp.TemperatureADC.Volt_f32 /end SUB_GROUP
 /begin FUNCTION_LIST /end FUNCTION_LIST
 /begin REF_CHARACTERISTIC /end REF_CHARACTERISTIC
 /begin REF_MEASUREMENT /end REF_MEASUREMENT
/end GROUP
/begin GROUP CtrlTemp.SenderPorts "MICROSAR RTE" /begin SUB_GROUP CtrlTemp.FiltMeasTemp.DegC_f32 /end SUB_GROUP /begin FUNCTION_LIST /end FUNCTION_LIST /begin REF_CHARACTERISTIC /end REF_CHARACTERISTIC /begin REF_MEASUREMENT /end REF_MEASUREMENT /end GROUP
/begin GROUP CtrlTemp.TemperatureADC.Volt_f32 "MICROSAR RTE" /begin SUB_GROUP /end SUB_GROUP /begin FUNCTION_LIST /end FUNCTION_LIST /begin REF_CHARACTERISTIC /end REF_CHARACTERISTIC /begin REF_MEASUREMENT CtrlTemp.TemperatureADC.Volt_f32 /end REF_MEASUREMENT /end GROUP
/begin GROUP CtrldDisShtdn "MICROSAR RTE"
 /begin SUB_GROUP CtrldDisShtdn.ModeRequirePorts CtrldDisShtdn.ReceiverPorts CtrldDisShtdn.SenderPorts /end SUB_GROUP
 /begin FUNCTION_LIST /end FUNCTION_LIST
 /begin REF_CHARACTERISTIC /end REF_CHARACTERISTIC
 /begin REF_MEASUREMENT /end REF_MEASUREMENT
/end GROUP
/begin GROUP CtrldDisShtdn.AssistAssyPolarity.Cnt_s08 "MICROSAR RTE" /begin SUB_GROUP /end SUB_GROUP /begin FUNCTION_LIST /end FUNCTION_LIST /begin REF_CHARACTERISTIC /end REF_CHARACTERISTIC /begin REF_MEASUREMENT CtrldDisShtdn.AssistAssyPolarity.Cnt_s08 /end REF_MEASUREMENT /end GROUP
/begin GROUP CtrldDisShtdn.CRFMtrVel.MtrRadpS_f32 "MICROSAR RTE" /begin SUB_GROUP /end SUB_GROUP /begin FUNCTION_LIST /end FUNCTION_LIST /begin REF_CHARACTERISTIC /end REF_CHARACTERISTIC /begin REF_MEASUREMENT CtrldDisShtdn.CRFMtrVel.MtrRadpS_f32 /end REF_MEASUREMENT /end GROUP
/begin GROUP CtrldDisShtdn.CntDisMtrTrqCmdCRF.MtrNm_f32 "MICROSAR RTE" /begin SUB_GROUP /end SUB_GROUP /begin FUNCTION_LIST /end FUNCTION_LIST /begin REF_CHARACTERISTIC /end REF_CHARACTERISTIC /begin REF_MEASUREMENT CtrldDisShtdn.CntDisMtrTrqCmdCRF.MtrNm_f32 /end REF_MEASUREMENT /end GROUP
/begin GROUP CtrldDisShtdn.CntDisMtrTrqCmdMRF.MtrNm_f32 "MICROSAR RTE" /begin SUB_GROUP /end SUB_GROUP /begin FUNCTION_LIST /end FUNCTION_LIST /begin REF_CHARACTERISTIC /end REF_CHARACTERISTIC /begin REF_MEASUREMENT CtrldDisShtdn.CntDisMtrTrqCmdMRF.MtrNm_f32 /end REF_MEASUREMENT /end GROUP
/begin GROUP CtrldDisShtdn.CtrldDmpStsCmp.Cnt_lgc "MICROSAR RTE" /begin SUB_GROUP /end SUB_GROUP /begin FUNCTION_LIST /end FUNCTION_LIST /begin REF_CHARACTERISTIC /end REF_CHARACTERISTIC /begin REF_MEASUREMENT CtrldDisShtdn.CtrldDmpStsCmp.Cnt_lgc /end REF_MEASUREMENT /end GROUP
/begin GROUP CtrldDisShtdn.DiagStsF2Active.Cnt_lgc "MICROSAR RTE" /begin SUB_GROUP /end SUB_GROUP /begin FUNCTION_LIST /end FUNCTION_LIST /begin REF_CHARACTERISTIC /end REF_CHARACTERISTIC /begin REF_MEASUREMENT CtrldDisShtdn.DiagStsF2Active.Cnt_lgc /end REF_MEASUREMENT /end GROUP
/begin GROUP CtrldDisShtdn.ModeRequirePorts "MICROSAR RTE" /begin SUB_GROUP CtrldDisShtdn.SystemState.Mode /end SUB_GROUP /begin FUNCTION_LIST /end FUNCTION_LIST /begin REF_CHARACTERISTIC /end REF_CHARACTERISTIC /begin REF_MEASUREMENT /end REF_MEASUREMENT /end GROUP
/begin GROUP CtrldDisShtdn.ReceiverPorts "MICROSAR RTE"
 /begin SUB_GROUP CtrldDisShtdn.AssistAssyPolarity.Cnt_s08 CtrldDisShtdn.CRFMtrVel.MtrRadpS_f32 CtrldDisShtdn.DiagStsF2Active.Cnt_lgc CtrldDisShtdn.SumLimTrqCmd.MtrNm_f32 /end SUB_GROUP
 /begin FUNCTION_LIST /end FUNCTION_LIST
 /begin REF_CHARACTERISTIC /end REF_CHARACTERISTIC
 /begin REF_MEASUREMENT /end REF_MEASUREMENT
/end GROUP
/begin GROUP CtrldDisShtdn.SenderPorts "MICROSAR RTE"
 /begin SUB_GROUP CtrldDisShtdn.CntDisMtrTrqCmdCRF.MtrNm_f32 CtrldDisShtdn.CntDisMtrTrqCmdMRF.MtrNm_f32 CtrldDisShtdn.CtrldDmpStsCmp.Cnt_lgc CtrldDisShtdn.SysC_CRFMtrTrqCmd.MtrNm_f32 CtrldDisShtdn.SysC_MRFMtrTrqCmd.MtrNm_f32 /end SUB_GROUP
 /begin FUNCTION_LIST /end FUNCTION_LIST
 /begin REF_CHARACTERISTIC /end REF_CHARACTERISTIC
 /begin REF_MEASUREMENT /end REF_MEASUREMENT
/end GROUP
/begin GROUP CtrldDisShtdn.SumLimTrqCmd.MtrNm_f32 "MICROSAR RTE" /begin SUB_GROUP /end SUB_GROUP /begin FUNCTION_LIST /end FUNCTION_LIST /begin REF_CHARACTERISTIC /end REF_CHARACTERISTIC /begin REF_MEASUREMENT CtrldDisShtdn.SumLimTrqCmd.MtrNm_f32 /end REF_MEASUREMENT /end GROUP
/begin GROUP CtrldDisShtdn.SysC_CRFMtrTrqCmd.MtrNm_f32 "MICROSAR RTE" /begin SUB_GROUP /end SUB_GROUP /begin FUNCTION_LIST /end FUNCTION_LIST /begin REF_CHARACTERISTIC /end REF_CHARACTERISTIC /begin REF_MEASUREMENT CtrldDisShtdn.SysC_CRFMtrTrqCmd.MtrNm_f32 /end REF_MEASUREMENT /end GROUP
/begin GROUP CtrldDisShtdn.SysC_MRFMtrTrqCmd.MtrNm_f32 "MICROSAR RTE" /begin SUB_GROUP /end SUB_GROUP /begin FUNCTION_LIST /end FUNCTION_LIST /begin REF_CHARACTERISTIC /end REF_CHARACTERISTIC /begin REF_MEASUREMENT CtrldDisShtdn.SysC_MRFMtrTrqCmd.MtrNm_f32 /end REF_MEASUREMENT /end GROUP
/begin GROUP CtrldDisShtdn.SystemState.Mode "MICROSAR RTE" /begin SUB_GROUP /end SUB_GROUP /begin FUNCTION_LIST /end FUNCTION_LIST /begin REF_CHARACTERISTIC /end REF_CHARACTERISTIC /begin REF_MEASUREMENT CtrldDisShtdn.SystemState.Mode /end REF_MEASUREMENT /end GROUP
/begin GROUP CurrCmd "MICROSAR RTE" /begin SUB_GROUP CurrCmd.ReceiverPorts CurrCmd.SenderPorts /end SUB_GROUP /begin FUNCTION_LIST /end FUNCTION_LIST /begin REF_CHARACTERISTIC /end REF_CHARACTERISTIC /begin REF_MEASUREMENT /end REF_MEASUREMENT /end GROUP
/begin GROUP CurrCmd.CurrentGainSvc.Cnt_lgc "MICROSAR RTE" /begin SUB_GROUP /end SUB_GROUP /begin FUNCTION_LIST /end FUNCTION_LIST /begin REF_CHARACTERISTIC /end REF_CHARACTERISTIC /begin REF_MEASUREMENT CurrCmd.CurrentGainSvc.Cnt_lgc /end REF_MEASUREMENT /end GROUP
/begin GROUP CurrCmd.EstKe.VpRadpS_f32 "MICROSAR RTE" /begin SUB_GROUP /end SUB_GROUP /begin FUNCTION_LIST /end FUNCTION_LIST /begin REF_CHARACTERISTIC /end REF_CHARACTERISTIC /begin REF_MEASUREMENT CurrCmd.EstKe.VpRadpS_f32 /end REF_MEASUREMENT /end GROUP
/begin GROUP CurrCmd.EstLd.Henry_f32 "MICROSAR RTE" /begin SUB_GROUP /end SUB_GROUP /begin FUNCTION_LIST /end FUNCTION_LIST /begin REF_CHARACTERISTIC /end REF_CHARACTERISTIC /begin REF_MEASUREMENT CurrCmd.EstLd.Henry_f32 /end REF_MEASUREMENT /end GROUP
/begin GROUP CurrCmd.EstLq.Henry_f32 "MICROSAR RTE" /begin SUB_GROUP /end SUB_GROUP /begin FUNCTION_LIST /end FUNCTION_LIST /begin REF_CHARACTERISTIC /end REF_CHARACTERISTIC /begin REF_MEASUREMENT CurrCmd.EstLq.Henry_f32 /end REF_MEASUREMENT /end GROUP
/begin GROUP CurrCmd.EstR.Ohm_f32 "MICROSAR RTE" /begin SUB_GROUP /end SUB_GROUP /begin FUNCTION_LIST /end FUNCTION_LIST /begin REF_CHARACTERISTIC /end REF_CHARACTERISTIC /begin REF_MEASUREMENT CurrCmd.EstR.Ohm_f32 /end REF_MEASUREMENT /end GROUP
/begin GROUP CurrCmd.MRFMtrVel.MtrRadpS_f32 "MICROSAR RTE" /begin SUB_GROUP /end SUB_GROUP /begin FUNCTION_LIST /end FUNCTION_LIST /begin REF_CHARACTERISTIC /end REF_CHARACTERISTIC /begin REF_MEASUREMENT CurrCmd.MRFMtrVel.MtrRadpS_f32 /end REF_MEASUREMENT /end GROUP
/begin GROUP CurrCmd.MRFTrqCmdScl.MtrNm_f32 "MICROSAR RTE" /begin SUB_GROUP /end SUB_GROUP /begin FUNCTION_LIST /end FUNCTION_LIST /begin REF_CHARACTERISTIC /end REF_CHARACTERISTIC /begin REF_MEASUREMENT CurrCmd.MRFTrqCmdScl.MtrNm_f32 /end REF_MEASUREMENT /end GROUP
/begin GROUP CurrCmd.MtrCurrAngle.Rev_f32 "MICROSAR RTE" /begin SUB_GROUP /end SUB_GROUP /begin FUNCTION_LIST /end FUNCTION_LIST /begin REF_CHARACTERISTIC /end REF_CHARACTERISTIC /begin REF_MEASUREMENT CurrCmd.MtrCurrAngle.Rev_f32 /end REF_MEASUREMENT /end GROUP
/begin GROUP CurrCmd.MtrCurrDaxRef.Amp_f32 "MICROSAR RTE" /begin SUB_GROUP /end SUB_GROUP /begin FUNCTION_LIST /end FUNCTION_LIST /begin REF_CHARACTERISTIC /end REF_CHARACTERISTIC /begin REF_MEASUREMENT CurrCmd.MtrCurrDaxRef.Amp_f32 /end REF_MEASUREMENT /end GROUP
/begin GROUP CurrCmd.MtrCurrQaxRef.Amp_f32 "MICROSAR RTE" /begin SUB_GROUP /end SUB_GROUP /begin FUNCTION_LIST /end FUNCTION_LIST /begin REF_CHARACTERISTIC /end REF_CHARACTERISTIC /begin REF_MEASUREMENT CurrCmd.MtrCurrQaxRef.Amp_f32 /end REF_MEASUREMENT /end GROUP
/begin GROUP CurrCmd.MtrQuad.Cnt_u08 "MICROSAR RTE" /begin SUB_GROUP /end SUB_GROUP /begin FUNCTION_LIST /end FUNCTION_LIST /begin REF_CHARACTERISTIC /end REF_CHARACTERISTIC /begin REF_MEASUREMENT CurrCmd.MtrQuad.Cnt_u08 /end REF_MEASUREMENT /end GROUP
/begin GROUP CurrCmd.MtrTrqCmdSign.Cnt_s16 "MICROSAR RTE" /begin SUB_GROUP /end SUB_GROUP /begin FUNCTION_LIST /end FUNCTION_LIST /begin REF_CHARACTERISTIC /end REF_CHARACTERISTIC /begin REF_MEASUREMENT CurrCmd.MtrTrqCmdSign.Cnt_s16 /end REF_MEASUREMENT /end GROUP
/begin GROUP CurrCmd.MtrVoltDaxFF.Volt_f32 "MICROSAR RTE" /begin SUB_GROUP /end SUB_GROUP /begin FUNCTION_LIST /end FUNCTION_LIST /begin REF_CHARACTERISTIC /end REF_CHARACTERISTIC /begin REF_MEASUREMENT CurrCmd.MtrVoltDaxFF.Volt_f32 /end REF_MEASUREMENT /end GROUP
/begin GROUP CurrCmd.MtrVoltQaxFF.Volt_f32 "MICROSAR RTE" /begin SUB_GROUP /end SUB_GROUP /begin FUNCTION_LIST /end FUNCTION_LIST /begin REF_CHARACTERISTIC /end REF_CHARACTERISTIC /begin REF_MEASUREMENT CurrCmd.MtrVoltQaxFF.Volt_f32 /end REF_MEASUREMENT /end GROUP
/begin GROUP CurrCmd.ReceiverPorts "MICROSAR RTE"
 /begin SUB_GROUP CurrCmd.CurrentGainSvc.Cnt_lgc CurrCmd.EstKe.VpRadpS_f32 CurrCmd.EstLd.Henry_f32 CurrCmd.EstLq.Henry_f32 CurrCmd.EstR.Ohm_f32 CurrCmd.MRFMtrVel.MtrRadpS_f32 CurrCmd.MRFTrqCmdScl.MtrNm_f32 CurrCmd.MtrQuad.Cnt_u08 CurrCmd.Vecu.Volt_f32 CurrCmd.VehSpd.Kph_f32 /end SUB_GROUP
 /begin FUNCTION_LIST /end FUNCTION_LIST
 /begin REF_CHARACTERISTIC /end REF_CHARACTERISTIC
 /begin REF_MEASUREMENT /end REF_MEASUREMENT
/end GROUP
/begin GROUP CurrCmd.SenderPorts "MICROSAR RTE"
 /begin SUB_GROUP CurrCmd.MtrCurrAngle.Rev_f32 CurrCmd.MtrCurrDaxRef.Amp_f32 CurrCmd.MtrCurrQaxRef.Amp_f32 CurrCmd.MtrTrqCmdSign.Cnt_s16 CurrCmd.MtrVoltDaxFF.Volt_f32 CurrCmd.MtrVoltQaxFF.Volt_f32 /end SUB_GROUP
 /begin FUNCTION_LIST /end FUNCTION_LIST
 /begin REF_CHARACTERISTIC /end REF_CHARACTERISTIC
 /begin REF_MEASUREMENT /end REF_MEASUREMENT
/end GROUP
/begin GROUP CurrCmd.Vecu.Volt_f32 "MICROSAR RTE" /begin SUB_GROUP /end SUB_GROUP /begin FUNCTION_LIST /end FUNCTION_LIST /begin REF_CHARACTERISTIC /end REF_CHARACTERISTIC /begin REF_MEASUREMENT CurrCmd.Vecu.Volt_f32 /end REF_MEASUREMENT /end GROUP
/begin GROUP CurrCmd.VehSpd.Kph_f32 "MICROSAR RTE" /begin SUB_GROUP /end SUB_GROUP /begin FUNCTION_LIST /end FUNCTION_LIST /begin REF_CHARACTERISTIC /end REF_CHARACTERISTIC /begin REF_MEASUREMENT CurrCmd.VehSpd.Kph_f32 /end REF_MEASUREMENT /end GROUP
/begin GROUP CurrParamComp "MICROSAR RTE"
 /begin SUB_GROUP CurrParamComp.PerInstanceMemories CurrParamComp.ReceiverPorts CurrParamComp.SenderPorts /end SUB_GROUP
 /begin FUNCTION_LIST /end FUNCTION_LIST
 /begin REF_CHARACTERISTIC /end REF_CHARACTERISTIC
 /begin REF_MEASUREMENT /end REF_MEASUREMENT
/end GROUP
/begin GROUP CurrParamComp.CuTempEst.DegC_f32 "MICROSAR RTE" /begin SUB_GROUP /end SUB_GROUP /begin FUNCTION_LIST /end FUNCTION_LIST /begin REF_CHARACTERISTIC /end REF_CHARACTERISTIC /begin REF_MEASUREMENT CurrParamComp.CuTempEst.DegC_f32 /end REF_MEASUREMENT /end GROUP
/begin GROUP CurrParamComp.EOLNomMtrParam "MICROSAR RTE" /begin SUB_GROUP /end SUB_GROUP /begin FUNCTION_LIST /end FUNCTION_LIST /begin REF_CHARACTERISTIC /end REF_CHARACTERISTIC
 /begin REF_MEASUREMENT CurrParamComp.EOLNomMtrParam.NomKe_VpRadpS_f32 CurrParamComp.EOLNomMtrParam.NomRmtr_Ohm_f32 /end REF_MEASUREMENT
/end GROUP
/begin GROUP CurrParamComp.EstKe.VpRadpS_f32 "MICROSAR RTE" /begin SUB_GROUP /end SUB_GROUP /begin FUNCTION_LIST /end FUNCTION_LIST /begin REF_CHARACTERISTIC /end REF_CHARACTERISTIC /begin REF_MEASUREMENT CurrParamComp.EstKe.VpRadpS_f32 /end REF_MEASUREMENT /end GROUP
/begin GROUP CurrParamComp.EstLd.Henry_f32 "MICROSAR RTE" /begin SUB_GROUP /end SUB_GROUP /begin FUNCTION_LIST /end FUNCTION_LIST /begin REF_CHARACTERISTIC /end REF_CHARACTERISTIC /begin REF_MEASUREMENT CurrParamComp.EstLd.Henry_f32 /end REF_MEASUREMENT /end GROUP
/begin GROUP CurrParamComp.EstLq.Henry_f32 "MICROSAR RTE" /begin SUB_GROUP /end SUB_GROUP /begin FUNCTION_LIST /end FUNCTION_LIST /begin REF_CHARACTERISTIC /end REF_CHARACTERISTIC /begin REF_MEASUREMENT CurrParamComp.EstLq.Henry_f32 /end REF_MEASUREMENT /end GROUP
/begin GROUP CurrParamComp.EstR.Ohm_f32 "MICROSAR RTE" /begin SUB_GROUP /end SUB_GROUP /begin FUNCTION_LIST /end FUNCTION_LIST /begin REF_CHARACTERISTIC /end REF_CHARACTERISTIC /begin REF_MEASUREMENT CurrParamComp.EstR.Ohm_f32 /end REF_MEASUREMENT /end GROUP
/begin GROUP CurrParamComp.MagTempEst.DegC_f32 "MICROSAR RTE" /begin SUB_GROUP /end SUB_GROUP /begin FUNCTION_LIST /end FUNCTION_LIST /begin REF_CHARACTERISTIC /end REF_CHARACTERISTIC /begin REF_MEASUREMENT CurrParamComp.MagTempEst.DegC_f32 /end REF_MEASUREMENT /end GROUP
/begin GROUP CurrParamComp.MtrCurrDaxRef.Amp_f32 "MICROSAR RTE" /begin SUB_GROUP /end SUB_GROUP /begin FUNCTION_LIST /end FUNCTION_LIST /begin REF_CHARACTERISTIC /end REF_CHARACTERISTIC /begin REF_MEASUREMENT CurrParamComp.MtrCurrDaxRef.Amp_f32 /end REF_MEASUREMENT /end GROUP
/begin GROUP CurrParamComp.MtrCurrQaxRef.Amp_f32 "MICROSAR RTE" /begin SUB_GROUP /end SUB_GROUP /begin FUNCTION_LIST /end FUNCTION_LIST /begin REF_CHARACTERISTIC /end REF_CHARACTERISTIC /begin REF_MEASUREMENT CurrParamComp.MtrCurrQaxRef.Amp_f32 /end REF_MEASUREMENT /end GROUP
/begin GROUP CurrParamComp.PerInstanceMemories "MICROSAR RTE" /begin SUB_GROUP CurrParamComp.EOLNomMtrParam /end SUB_GROUP /begin FUNCTION_LIST /end FUNCTION_LIST /begin REF_CHARACTERISTIC /end REF_CHARACTERISTIC /begin REF_MEASUREMENT /end REF_MEASUREMENT /end GROUP
/begin GROUP CurrParamComp.ReceiverPorts "MICROSAR RTE"
 /begin SUB_GROUP CurrParamComp.CuTempEst.DegC_f32 CurrParamComp.MagTempEst.DegC_f32 CurrParamComp.MtrCurrDaxRef.Amp_f32 CurrParamComp.MtrCurrQaxRef.Amp_f32 CurrParamComp.SiTempEst.DegC_f32 /end SUB_GROUP
 /begin FUNCTION_LIST /end FUNCTION_LIST
 /begin REF_CHARACTERISTIC /end REF_CHARACTERISTIC
 /begin REF_MEASUREMENT /end REF_MEASUREMENT
/end GROUP
/begin GROUP CurrParamComp.SenderPorts "MICROSAR RTE"
 /begin SUB_GROUP CurrParamComp.EstKe.VpRadpS_f32 CurrParamComp.EstLd.Henry_f32 CurrParamComp.EstLq.Henry_f32 CurrParamComp.EstR.Ohm_f32 /end SUB_GROUP
 /begin FUNCTION_LIST /end FUNCTION_LIST
 /begin REF_CHARACTERISTIC /end REF_CHARACTERISTIC
 /begin REF_MEASUREMENT /end REF_MEASUREMENT
/end GROUP
/begin GROUP CurrParamComp.SiTempEst.DegC_f32 "MICROSAR RTE" /begin SUB_GROUP /end SUB_GROUP /begin FUNCTION_LIST /end FUNCTION_LIST /begin REF_CHARACTERISTIC /end REF_CHARACTERISTIC /begin REF_MEASUREMENT CurrParamComp.SiTempEst.DegC_f32 /end REF_MEASUREMENT /end GROUP
/begin GROUP Damping "MICROSAR RTE" /begin SUB_GROUP Damping.ReceiverPorts Damping.SenderPorts /end SUB_GROUP /begin FUNCTION_LIST /end FUNCTION_LIST /begin REF_CHARACTERISTIC /end REF_CHARACTERISTIC /begin REF_MEASUREMENT /end REF_MEASUREMENT /end GROUP
/begin GROUP Damping.AssistCmd.MtrNm_f32 "MICROSAR RTE" /begin SUB_GROUP /end SUB_GROUP /begin FUNCTION_LIST /end FUNCTION_LIST /begin REF_CHARACTERISTIC /end REF_CHARACTERISTIC /begin REF_MEASUREMENT Damping.AssistCmd.MtrNm_f32 /end REF_MEASUREMENT /end GROUP
/begin GROUP Damping.AssistMechTempEst.DegC_f32 "MICROSAR RTE" /begin SUB_GROUP /end SUB_GROUP /begin FUNCTION_LIST /end FUNCTION_LIST /begin REF_CHARACTERISTIC /end REF_CHARACTERISTIC /begin REF_MEASUREMENT Damping.AssistMechTempEst.DegC_f32 /end REF_MEASUREMENT /end GROUP
/begin GROUP Damping.DampingCmd.MtrNm_f32 "MICROSAR RTE" /begin SUB_GROUP /end SUB_GROUP /begin FUNCTION_LIST /end FUNCTION_LIST /begin REF_CHARACTERISTIC /end REF_CHARACTERISTIC /begin REF_MEASUREMENT Damping.DampingCmd.MtrNm_f32 /end REF_MEASUREMENT /end GROUP
/begin GROUP Damping.DampingDDFactor.Uls_f32 "MICROSAR RTE" /begin SUB_GROUP /end SUB_GROUP /begin FUNCTION_LIST /end FUNCTION_LIST /begin REF_CHARACTERISTIC /end REF_CHARACTERISTIC /begin REF_MEASUREMENT Damping.DampingDDFactor.Uls_f32 /end REF_MEASUREMENT /end GROUP
/begin GROUP Damping.DefeatDampingSvc.Cnt_lgc "MICROSAR RTE" /begin SUB_GROUP /end SUB_GROUP /begin FUNCTION_LIST /end FUNCTION_LIST /begin REF_CHARACTERISTIC /end REF_CHARACTERISTIC /begin REF_MEASUREMENT Damping.DefeatDampingSvc.Cnt_lgc /end REF_MEASUREMENT /end GROUP
/begin GROUP Damping.HwTorque.HwNm_f32 "MICROSAR RTE" /begin SUB_GROUP /end SUB_GROUP /begin FUNCTION_LIST /end FUNCTION_LIST /begin REF_CHARACTERISTIC /end REF_CHARACTERISTIC /begin REF_MEASUREMENT Damping.HwTorque.HwNm_f32 /end REF_MEASUREMENT /end GROUP
/begin GROUP Damping.MotorVelCRF.MtrRadpS_f32 "MICROSAR RTE" /begin SUB_GROUP /end SUB_GROUP /begin FUNCTION_LIST /end FUNCTION_LIST /begin REF_CHARACTERISTIC /end REF_CHARACTERISTIC /begin REF_MEASUREMENT Damping.MotorVelCRF.MtrRadpS_f32 /end REF_MEASUREMENT /end GROUP
/begin GROUP Damping.ReceiverPorts "MICROSAR RTE"
 /begin SUB_GROUP Damping.AssistCmd.MtrNm_f32 Damping.AssistMechTempEst.DegC_f32 Damping.DampingDDFactor.Uls_f32 Damping.DefeatDampingSvc.Cnt_lgc Damping.HwTorque.HwNm_f32 Damping.MotorVelCRF.MtrRadpS_f32 Damping.VehicleSpeed.Kph_f32 /end SUB_GROUP
 /begin FUNCTION_LIST /end FUNCTION_LIST
 /begin REF_CHARACTERISTIC /end REF_CHARACTERISTIC
 /begin REF_MEASUREMENT /end REF_MEASUREMENT
/end GROUP
/begin GROUP Damping.SenderPorts "MICROSAR RTE" /begin SUB_GROUP Damping.DampingCmd.MtrNm_f32 /end SUB_GROUP /begin FUNCTION_LIST /end FUNCTION_LIST /begin REF_CHARACTERISTIC /end REF_CHARACTERISTIC /begin REF_MEASUREMENT /end REF_MEASUREMENT /end GROUP
/begin GROUP Damping.VehicleSpeed.Kph_f32 "MICROSAR RTE" /begin SUB_GROUP /end SUB_GROUP /begin FUNCTION_LIST /end FUNCTION_LIST /begin REF_CHARACTERISTIC /end REF_CHARACTERISTIC /begin REF_MEASUREMENT Damping.VehicleSpeed.Kph_f32 /end REF_MEASUREMENT /end GROUP
/begin GROUP DemIf "MICROSAR RTE" /begin SUB_GROUP DemIf.ReceiverPorts /end SUB_GROUP /begin FUNCTION_LIST /end FUNCTION_LIST /begin REF_CHARACTERISTIC /end REF_CHARACTERISTIC /begin REF_MEASUREMENT /end REF_MEASUREMENT /end GROUP
/begin GROUP DemIf.CMDIgnStat.Cnt_u08 "MICROSAR RTE" /begin SUB_GROUP /end SUB_GROUP /begin FUNCTION_LIST /end FUNCTION_LIST /begin REF_CHARACTERISTIC /end REF_CHARACTERISTIC /begin REF_MEASUREMENT DemIf.CMDIgnStat.Cnt_u08 /end REF_MEASUREMENT /end GROUP
/begin GROUP DemIf.DemLocalVoltage.Volt_f32 "MICROSAR RTE" /begin SUB_GROUP /end SUB_GROUP /begin FUNCTION_LIST /end FUNCTION_LIST /begin REF_CHARACTERISTIC /end REF_CHARACTERISTIC /begin REF_MEASUREMENT DemIf.DemLocalVoltage.Volt_f32 /end REF_MEASUREMENT /end GROUP
/begin GROUP DemIf.DemSystemVoltage.Volt_f32 "MICROSAR RTE" /begin SUB_GROUP /end SUB_GROUP /begin FUNCTION_LIST /end FUNCTION_LIST /begin REF_CHARACTERISTIC /end REF_CHARACTERISTIC /begin REF_MEASUREMENT DemIf.DemSystemVoltage.Volt_f32 /end REF_MEASUREMENT /end GROUP
/begin GROUP DemIf.NET_CFG_STAT_PT.Cnt_u16 "MICROSAR RTE" /begin SUB_GROUP /end SUB_GROUP /begin FUNCTION_LIST /end FUNCTION_LIST /begin REF_CHARACTERISTIC /end REF_CHARACTERISTIC /begin REF_MEASUREMENT DemIf.NET_CFG_STAT_PT.Cnt_u16 /end REF_MEASUREMENT /end GROUP
/begin GROUP DemIf.ReceiverPorts "MICROSAR RTE"
 /begin SUB_GROUP DemIf.CMDIgnStat.Cnt_u08 DemIf.DemLocalVoltage.Volt_f32 DemIf.DemSystemVoltage.Volt_f32 DemIf.NET_CFG_STAT_PT.Cnt_u16 /end SUB_GROUP
 /begin FUNCTION_LIST /end FUNCTION_LIST
 /begin REF_CHARACTERISTIC /end REF_CHARACTERISTIC
 /begin REF_MEASUREMENT /end REF_MEASUREMENT
/end GROUP
/begin GROUP DiagMgr "MICROSAR RTE"
 /begin SUB_GROUP DiagMgr.ModeRequirePorts DiagMgr.ReceiverPorts DiagMgr.SenderPorts /end SUB_GROUP
 /begin FUNCTION_LIST /end FUNCTION_LIST
 /begin REF_CHARACTERISTIC /end REF_CHARACTERISTIC
 /begin REF_MEASUREMENT /end REF_MEASUREMENT
/end GROUP
/begin GROUP DiagMgr.DiagRampRate.XpmS_f32 "MICROSAR RTE" /begin SUB_GROUP /end SUB_GROUP /begin FUNCTION_LIST /end FUNCTION_LIST /begin REF_CHARACTERISTIC /end REF_CHARACTERISTIC /begin REF_MEASUREMENT DiagMgr.DiagRampRate.XpmS_f32 /end REF_MEASUREMENT /end GROUP
/begin GROUP DiagMgr.DiagRampValue.Uls_f32 "MICROSAR RTE" /begin SUB_GROUP /end SUB_GROUP /begin FUNCTION_LIST /end FUNCTION_LIST /begin REF_CHARACTERISTIC /end REF_CHARACTERISTIC /begin REF_MEASUREMENT DiagMgr.DiagRampValue.Uls_f32 /end REF_MEASUREMENT /end GROUP
/begin GROUP DiagMgr.DiagRmpToZeroActive.Cnt_lgc "MICROSAR RTE" /begin SUB_GROUP /end SUB_GROUP /begin FUNCTION_LIST /end FUNCTION_LIST /begin REF_CHARACTERISTIC /end REF_CHARACTERISTIC /begin REF_MEASUREMENT DiagMgr.DiagRmpToZeroActive.Cnt_lgc /end REF_MEASUREMENT /end GROUP
/begin GROUP DiagMgr.DiagStsCtrldDisRmpPres.Cnt_lgc "MICROSAR RTE" /begin SUB_GROUP /end SUB_GROUP /begin FUNCTION_LIST /end FUNCTION_LIST /begin REF_CHARACTERISTIC /end REF_CHARACTERISTIC /begin REF_MEASUREMENT DiagMgr.DiagStsCtrldDisRmpPres.Cnt_lgc /end REF_MEASUREMENT /end GROUP
/begin GROUP DiagMgr.DiagStsDefTemp.Cnt_lgc "MICROSAR RTE" /begin SUB_GROUP /end SUB_GROUP /begin FUNCTION_LIST /end FUNCTION_LIST /begin REF_CHARACTERISTIC /end REF_CHARACTERISTIC /begin REF_MEASUREMENT DiagMgr.DiagStsDefTemp.Cnt_lgc /end REF_MEASUREMENT /end GROUP
/begin GROUP DiagMgr.DiagStsDefVehSpd.Cnt_lgc "MICROSAR RTE" /begin SUB_GROUP /end SUB_GROUP /begin FUNCTION_LIST /end FUNCTION_LIST /begin REF_CHARACTERISTIC /end REF_CHARACTERISTIC /begin REF_MEASUREMENT DiagMgr.DiagStsDefVehSpd.Cnt_lgc /end REF_MEASUREMENT /end GROUP
/begin GROUP DiagMgr.DiagStsHWASbSystmFltPres.Cnt_lgc "MICROSAR RTE" /begin SUB_GROUP /end SUB_GROUP /begin FUNCTION_LIST /end FUNCTION_LIST /begin REF_CHARACTERISTIC /end REF_CHARACTERISTIC /begin REF_MEASUREMENT DiagMgr.DiagStsHWASbSystmFltPres.Cnt_lgc /end REF_MEASUREMENT /end GROUP
/begin GROUP DiagMgr.DiagStsNonRecRmpToZeroFltPres.Cnt_lgc "MICROSAR RTE" /begin SUB_GROUP /end SUB_GROUP /begin FUNCTION_LIST /end FUNCTION_LIST /begin REF_CHARACTERISTIC /end REF_CHARACTERISTIC /begin REF_MEASUREMENT DiagMgr.DiagStsNonRecRmpToZeroFltPres.Cnt_lgc /end REF_MEASUREMENT /end GROUP
/begin GROUP DiagMgr.DiagStsRecRmpToZeroFltPres.Cnt_lgc "MICROSAR RTE" /begin SUB_GROUP /end SUB_GROUP /begin FUNCTION_LIST /end FUNCTION_LIST /begin REF_CHARACTERISTIC /end REF_CHARACTERISTIC /begin REF_MEASUREMENT DiagMgr.DiagStsRecRmpToZeroFltPres.Cnt_lgc /end REF_MEASUREMENT /end GROUP
/begin GROUP DiagMgr.DiagStsScomHWANotValid.Cnt_lgc "MICROSAR RTE" /begin SUB_GROUP /end SUB_GROUP /begin FUNCTION_LIST /end FUNCTION_LIST /begin REF_CHARACTERISTIC /end REF_CHARACTERISTIC /begin REF_MEASUREMENT DiagMgr.DiagStsScomHWANotValid.Cnt_lgc /end REF_MEASUREMENT /end GROUP
/begin GROUP DiagMgr.DiagStsWIRDisable.Cnt_lgc "MICROSAR RTE" /begin SUB_GROUP /end SUB_GROUP /begin FUNCTION_LIST /end FUNCTION_LIST /begin REF_CHARACTERISTIC /end REF_CHARACTERISTIC /begin REF_MEASUREMENT DiagMgr.DiagStsWIRDisable.Cnt_lgc /end REF_MEASUREMENT /end GROUP
/begin GROUP DiagMgr.HwTrq.HwNm_f32 "MICROSAR RTE" /begin SUB_GROUP /end SUB_GROUP /begin FUNCTION_LIST /end FUNCTION_LIST /begin REF_CHARACTERISTIC /end REF_CHARACTERISTIC /begin REF_MEASUREMENT DiagMgr.HwTrq.HwNm_f32 /end REF_MEASUREMENT /end GROUP
/begin GROUP DiagMgr.IgnCnt.Cnt_u16 "MICROSAR RTE" /begin SUB_GROUP /end SUB_GROUP /begin FUNCTION_LIST /end FUNCTION_LIST /begin REF_CHARACTERISTIC /end REF_CHARACTERISTIC /begin REF_MEASUREMENT DiagMgr.IgnCnt.Cnt_u16 /end REF_MEASUREMENT /end GROUP
/begin GROUP DiagMgr.MEC.Cnt_enum "MICROSAR RTE" /begin SUB_GROUP /end SUB_GROUP /begin FUNCTION_LIST /end FUNCTION_LIST /begin REF_CHARACTERISTIC /end REF_CHARACTERISTIC /begin REF_MEASUREMENT DiagMgr.MEC.Cnt_enum /end REF_MEASUREMENT /end GROUP
/begin GROUP DiagMgr.MfgDiagInhibit.Cnt_lgc "MICROSAR RTE" /begin SUB_GROUP /end SUB_GROUP /begin FUNCTION_LIST /end FUNCTION_LIST /begin REF_CHARACTERISTIC /end REF_CHARACTERISTIC /begin REF_MEASUREMENT DiagMgr.MfgDiagInhibit.Cnt_lgc /end REF_MEASUREMENT /end GROUP
/begin GROUP DiagMgr.ModeRequirePorts "MICROSAR RTE" /begin SUB_GROUP DiagMgr.SystemState.Mode /end SUB_GROUP /begin FUNCTION_LIST /end FUNCTION_LIST /begin REF_CHARACTERISTIC /end REF_CHARACTERISTIC /begin REF_MEASUREMENT /end REF_MEASUREMENT /end GROUP
/begin GROUP DiagMgr.MtrTrq.MtrNm_f32 "MICROSAR RTE" /begin SUB_GROUP /end SUB_GROUP /begin FUNCTION_LIST /end FUNCTION_LIST /begin REF_CHARACTERISTIC /end REF_CHARACTERISTIC /begin REF_MEASUREMENT DiagMgr.MtrTrq.MtrNm_f32 /end REF_MEASUREMENT /end GROUP
/begin GROUP DiagMgr.ReceiverPorts "MICROSAR RTE"
 /begin SUB_GROUP DiagMgr.HwTrq.HwNm_f32 DiagMgr.IgnCnt.Cnt_u16 DiagMgr.MEC.Cnt_enum DiagMgr.MfgDiagInhibit.Cnt_lgc DiagMgr.MtrTrq.MtrNm_f32 DiagMgr.VehSpd.Kph_f32 /end SUB_GROUP
 /begin FUNCTION_LIST /end FUNCTION_LIST
 /begin REF_CHARACTERISTIC /end REF_CHARACTERISTIC
 /begin REF_MEASUREMENT /end REF_MEASUREMENT
/end GROUP
/begin GROUP DiagMgr.SenderPorts "MICROSAR RTE"
 /begin SUB_GROUP DiagMgr.DiagRampRate.XpmS_f32 DiagMgr.DiagRampValue.Uls_f32 DiagMgr.DiagRmpToZeroActive.Cnt_lgc DiagMgr.DiagStsCtrldDisRmpPres.Cnt_lgc DiagMgr.DiagStsDefTemp.Cnt_lgc DiagMgr.DiagStsDefVehSpd.Cnt_lgc DiagMgr.DiagStsHWASbSystmFltPres.Cnt_lgc DiagMgr.DiagStsNonRecRmpToZeroFltPres.Cnt_lgc DiagMgr.DiagStsRecRmpToZeroFltPres.Cnt_lgc DiagMgr.DiagStsScomHWANotValid.Cnt_lgc DiagMgr.DiagStsWIRDisable.Cnt_lgc /end SUB_GROUP
 /begin FUNCTION_LIST /end FUNCTION_LIST
 /begin REF_CHARACTERISTIC /end REF_CHARACTERISTIC
 /begin REF_MEASUREMENT /end REF_MEASUREMENT
/end GROUP
/begin GROUP DiagMgr.SystemState.Mode "MICROSAR RTE" /begin SUB_GROUP /end SUB_GROUP /begin FUNCTION_LIST /end FUNCTION_LIST /begin REF_CHARACTERISTIC /end REF_CHARACTERISTIC /begin REF_MEASUREMENT DiagMgr.SystemState.Mode /end REF_MEASUREMENT /end GROUP
/begin GROUP DiagMgr.VehSpd.Kph_f32 "MICROSAR RTE" /begin SUB_GROUP /end SUB_GROUP /begin FUNCTION_LIST /end FUNCTION_LIST /begin REF_CHARACTERISTIC /end REF_CHARACTERISTIC /begin REF_MEASUREMENT DiagMgr.VehSpd.Kph_f32 /end REF_MEASUREMENT /end GROUP
/begin GROUP DigPhsReasDiag "MICROSAR RTE"
 /begin SUB_GROUP DigPhsReasDiag.ModeRequirePorts DigPhsReasDiag.ReceiverPorts /end SUB_GROUP
 /begin FUNCTION_LIST /end FUNCTION_LIST
 /begin REF_CHARACTERISTIC /end REF_CHARACTERISTIC
 /begin REF_MEASUREMENT /end REF_MEASUREMENT
/end GROUP
/begin GROUP DigPhsReasDiag.ExpectedOnTimeA.Cnt_u32 "MICROSAR RTE" /begin SUB_GROUP /end SUB_GROUP /begin FUNCTION_LIST /end FUNCTION_LIST /begin REF_CHARACTERISTIC /end REF_CHARACTERISTIC /begin REF_MEASUREMENT DigPhsReasDiag.ExpectedOnTimeA.Cnt_u32 /end REF_MEASUREMENT /end GROUP
/begin GROUP DigPhsReasDiag.ExpectedOnTimeB.Cnt_u32 "MICROSAR RTE" /begin SUB_GROUP /end SUB_GROUP /begin FUNCTION_LIST /end FUNCTION_LIST /begin REF_CHARACTERISTIC /end REF_CHARACTERISTIC /begin REF_MEASUREMENT DigPhsReasDiag.ExpectedOnTimeB.Cnt_u32 /end REF_MEASUREMENT /end GROUP
/begin GROUP DigPhsReasDiag.ExpectedOnTimeC.Cnt_u32 "MICROSAR RTE" /begin SUB_GROUP /end SUB_GROUP /begin FUNCTION_LIST /end FUNCTION_LIST /begin REF_CHARACTERISTIC /end REF_CHARACTERISTIC /begin REF_MEASUREMENT DigPhsReasDiag.ExpectedOnTimeC.Cnt_u32 /end REF_MEASUREMENT /end GROUP
/begin GROUP DigPhsReasDiag.LRPRCorrectedMtrPosCaptured.Rev_f32 "MICROSAR RTE" /begin SUB_GROUP /end SUB_GROUP /begin FUNCTION_LIST /end FUNCTION_LIST /begin REF_CHARACTERISTIC /end REF_CHARACTERISTIC /begin REF_MEASUREMENT DigPhsReasDiag.LRPRCorrectedMtrPosCaptured.Rev_f32 /end REF_MEASUREMENT /end GROUP
/begin GROUP DigPhsReasDiag.LRPRModulationIndexCaptured.Uls_f32 "MICROSAR RTE" /begin SUB_GROUP /end SUB_GROUP /begin FUNCTION_LIST /end FUNCTION_LIST /begin REF_CHARACTERISTIC /end REF_CHARACTERISTIC /begin REF_MEASUREMENT DigPhsReasDiag.LRPRModulationIndexCaptured.Uls_f32 /end REF_MEASUREMENT /end GROUP
/begin GROUP DigPhsReasDiag.LRPRPhaseadvanceCaptured.Cnt_s16 "MICROSAR RTE" /begin SUB_GROUP /end SUB_GROUP /begin FUNCTION_LIST /end FUNCTION_LIST /begin REF_CHARACTERISTIC /end REF_CHARACTERISTIC /begin REF_MEASUREMENT DigPhsReasDiag.LRPRPhaseadvanceCaptured.Cnt_s16 /end REF_MEASUREMENT /end GROUP
/begin GROUP DigPhsReasDiag.MeasuredOnTimeA.Cnt_u32 "MICROSAR RTE" /begin SUB_GROUP /end SUB_GROUP /begin FUNCTION_LIST /end FUNCTION_LIST /begin REF_CHARACTERISTIC /end REF_CHARACTERISTIC /begin REF_MEASUREMENT DigPhsReasDiag.MeasuredOnTimeA.Cnt_u32 /end REF_MEASUREMENT /end GROUP
/begin GROUP DigPhsReasDiag.MeasuredOnTimeB.Cnt_u32 "MICROSAR RTE" /begin SUB_GROUP /end SUB_GROUP /begin FUNCTION_LIST /end FUNCTION_LIST /begin REF_CHARACTERISTIC /end REF_CHARACTERISTIC /begin REF_MEASUREMENT DigPhsReasDiag.MeasuredOnTimeB.Cnt_u32 /end REF_MEASUREMENT /end GROUP
/begin GROUP DigPhsReasDiag.MeasuredOnTimeC.Cnt_u32 "MICROSAR RTE" /begin SUB_GROUP /end SUB_GROUP /begin FUNCTION_LIST /end FUNCTION_LIST /begin REF_CHARACTERISTIC /end REF_CHARACTERISTIC /begin REF_MEASUREMENT DigPhsReasDiag.MeasuredOnTimeC.Cnt_u32 /end REF_MEASUREMENT /end GROUP
/begin GROUP DigPhsReasDiag.ModeRequirePorts "MICROSAR RTE" /begin SUB_GROUP DigPhsReasDiag.SystemState.Mode /end SUB_GROUP /begin FUNCTION_LIST /end FUNCTION_LIST /begin REF_CHARACTERISTIC /end REF_CHARACTERISTIC /begin REF_MEASUREMENT /end REF_MEASUREMENT /end GROUP
/begin GROUP DigPhsReasDiag.MotorVelMRFUnfiltered.MtrRadpS_f32 "MICROSAR RTE" /begin SUB_GROUP /end SUB_GROUP /begin FUNCTION_LIST /end FUNCTION_LIST /begin REF_CHARACTERISTIC /end REF_CHARACTERISTIC /begin REF_MEASUREMENT DigPhsReasDiag.MotorVelMRFUnfiltered.MtrRadpS_f32 /end REF_MEASUREMENT /end GROUP
/begin GROUP DigPhsReasDiag.MtrElecMechPolarity.Cnt_s08 "MICROSAR RTE" /begin SUB_GROUP /end SUB_GROUP /begin FUNCTION_LIST /end FUNCTION_LIST /begin REF_CHARACTERISTIC /end REF_CHARACTERISTIC /begin REF_MEASUREMENT DigPhsReasDiag.MtrElecMechPolarity.Cnt_s08 /end REF_MEASUREMENT /end GROUP
/begin GROUP DigPhsReasDiag.PDActivateTest.Cnt_lgc "MICROSAR RTE" /begin SUB_GROUP /end SUB_GROUP /begin FUNCTION_LIST /end FUNCTION_LIST /begin REF_CHARACTERISTIC /end REF_CHARACTERISTIC /begin REF_MEASUREMENT DigPhsReasDiag.PDActivateTest.Cnt_lgc /end REF_MEASUREMENT /end GROUP
/begin GROUP DigPhsReasDiag.ReceiverPorts "MICROSAR RTE"
 /begin SUB_GROUP DigPhsReasDiag.ExpectedOnTimeA.Cnt_u32 DigPhsReasDiag.ExpectedOnTimeB.Cnt_u32 DigPhsReasDiag.ExpectedOnTimeC.Cnt_u32 DigPhsReasDiag.LRPRCorrectedMtrPosCaptured.Rev_f32 DigPhsReasDiag.LRPRModulationIndexCaptured.Uls_f32 DigPhsReasDiag.LRPRPhaseadvanceCaptured.Cnt_s16 DigPhsReasDiag.MeasuredOnTimeA.Cnt_u32 DigPhsReasDiag.MeasuredOnTimeB.Cnt_u32 DigPhsReasDiag.MeasuredOnTimeC.Cnt_u32 DigPhsReasDiag.MotorVelMRFUnfiltered.MtrRadpS_f32 DigPhsReasDiag.MtrElecMechPolarity.Cnt_s08 DigPhsReasDiag.PDActivateTest.Cnt_lgc /end SUB_GROUP
 /begin FUNCTION_LIST /end FUNCTION_LIST
 /begin REF_CHARACTERISTIC /end REF_CHARACTERISTIC
 /begin REF_MEASUREMENT /end REF_MEASUREMENT
/end GROUP
/begin GROUP DigPhsReasDiag.SystemState.Mode "MICROSAR RTE" /begin SUB_GROUP /end SUB_GROUP /begin FUNCTION_LIST /end FUNCTION_LIST /begin REF_CHARACTERISTIC /end REF_CHARACTERISTIC /begin REF_MEASUREMENT DigPhsReasDiag.SystemState.Mode /end REF_MEASUREMENT /end GROUP
/begin GROUP EOTActuatorMng "MICROSAR RTE" /begin SUB_GROUP EOTActuatorMng.ReceiverPorts EOTActuatorMng.SenderPorts /end SUB_GROUP /begin FUNCTION_LIST /end FUNCTION_LIST /begin REF_CHARACTERISTIC /end REF_CHARACTERISTIC /begin REF_MEASUREMENT /end REF_MEASUREMENT /end GROUP
/begin GROUP EOTActuatorMng.AssistEOTDamping.MtrNm_f32 "MICROSAR RTE" /begin SUB_GROUP /end SUB_GROUP /begin FUNCTION_LIST /end FUNCTION_LIST /begin REF_CHARACTERISTIC /end REF_CHARACTERISTIC /begin REF_MEASUREMENT EOTActuatorMng.AssistEOTDamping.MtrNm_f32 /end REF_MEASUREMENT /end GROUP
/begin GROUP EOTActuatorMng.AssistEOTGain.Uls_f32 "MICROSAR RTE" /begin SUB_GROUP /end SUB_GROUP /begin FUNCTION_LIST /end FUNCTION_LIST /begin REF_CHARACTERISTIC /end REF_CHARACTERISTIC /begin REF_MEASUREMENT EOTActuatorMng.AssistEOTGain.Uls_f32 /end REF_MEASUREMENT /end GROUP
/begin GROUP EOTActuatorMng.AssistEOTLimit.MtrNm_f32 "MICROSAR RTE" /begin SUB_GROUP /end SUB_GROUP /begin FUNCTION_LIST /end FUNCTION_LIST /begin REF_CHARACTERISTIC /end REF_CHARACTERISTIC /begin REF_MEASUREMENT EOTActuatorMng.AssistEOTLimit.MtrNm_f32 /end REF_MEASUREMENT /end GROUP
/begin GROUP EOTActuatorMng.CcwEOT.HwDeg_f32 "MICROSAR RTE" /begin SUB_GROUP /end SUB_GROUP /begin FUNCTION_LIST /end FUNCTION_LIST /begin REF_CHARACTERISTIC /end REF_CHARACTERISTIC /begin REF_MEASUREMENT EOTActuatorMng.CcwEOT.HwDeg_f32 /end REF_MEASUREMENT /end GROUP
/begin GROUP EOTActuatorMng.CcwFound.Cnt_lgc "MICROSAR RTE" /begin SUB_GROUP /end SUB_GROUP /begin FUNCTION_LIST /end FUNCTION_LIST /begin REF_CHARACTERISTIC /end REF_CHARACTERISTIC /begin REF_MEASUREMENT EOTActuatorMng.CcwFound.Cnt_lgc /end REF_MEASUREMENT /end GROUP
/begin GROUP EOTActuatorMng.CwEOT.HwDeg_f32 "MICROSAR RTE" /begin SUB_GROUP /end SUB_GROUP /begin FUNCTION_LIST /end FUNCTION_LIST /begin REF_CHARACTERISTIC /end REF_CHARACTERISTIC /begin REF_MEASUREMENT EOTActuatorMng.CwEOT.HwDeg_f32 /end REF_MEASUREMENT /end GROUP
/begin GROUP EOTActuatorMng.CwFound.Cnt_lgc "MICROSAR RTE" /begin SUB_GROUP /end SUB_GROUP /begin FUNCTION_LIST /end FUNCTION_LIST /begin REF_CHARACTERISTIC /end REF_CHARACTERISTIC /begin REF_MEASUREMENT EOTActuatorMng.CwFound.Cnt_lgc /end REF_MEASUREMENT /end GROUP
/begin GROUP EOTActuatorMng.EOTDisable.Cnt_lgc "MICROSAR RTE" /begin SUB_GROUP /end SUB_GROUP /begin FUNCTION_LIST /end FUNCTION_LIST /begin REF_CHARACTERISTIC /end REF_CHARACTERISTIC /begin REF_MEASUREMENT EOTActuatorMng.EOTDisable.Cnt_lgc /end REF_MEASUREMENT /end GROUP
/begin GROUP EOTActuatorMng.HandWheelAuth.Uls_f32 "MICROSAR RTE" /begin SUB_GROUP /end SUB_GROUP /begin FUNCTION_LIST /end FUNCTION_LIST /begin REF_CHARACTERISTIC /end REF_CHARACTERISTIC /begin REF_MEASUREMENT EOTActuatorMng.HandWheelAuth.Uls_f32 /end REF_MEASUREMENT /end GROUP
/begin GROUP EOTActuatorMng.HandWheelPos.HwDeg_f32 "MICROSAR RTE" /begin SUB_GROUP /end SUB_GROUP /begin FUNCTION_LIST /end FUNCTION_LIST /begin REF_CHARACTERISTIC /end REF_CHARACTERISTIC /begin REF_MEASUREMENT EOTActuatorMng.HandWheelPos.HwDeg_f32 /end REF_MEASUREMENT /end GROUP
/begin GROUP EOTActuatorMng.HwTorque.HwNm_f32 "MICROSAR RTE" /begin SUB_GROUP /end SUB_GROUP /begin FUNCTION_LIST /end FUNCTION_LIST /begin REF_CHARACTERISTIC /end REF_CHARACTERISTIC /begin REF_MEASUREMENT EOTActuatorMng.HwTorque.HwNm_f32 /end REF_MEASUREMENT /end GROUP
/begin GROUP EOTActuatorMng.MotorVel.MtrRadpS_f32 "MICROSAR RTE" /begin SUB_GROUP /end SUB_GROUP /begin FUNCTION_LIST /end FUNCTION_LIST /begin REF_CHARACTERISTIC /end REF_CHARACTERISTIC /begin REF_MEASUREMENT EOTActuatorMng.MotorVel.MtrRadpS_f32 /end REF_MEASUREMENT /end GROUP
/begin GROUP EOTActuatorMng.PreLimitTorque.MtrNm_f32 "MICROSAR RTE" /begin SUB_GROUP /end SUB_GROUP /begin FUNCTION_LIST /end FUNCTION_LIST /begin REF_CHARACTERISTIC /end REF_CHARACTERISTIC /begin REF_MEASUREMENT EOTActuatorMng.PreLimitTorque.MtrNm_f32 /end REF_MEASUREMENT /end GROUP
/begin GROUP EOTActuatorMng.ReceiverPorts "MICROSAR RTE"
 /begin SUB_GROUP EOTActuatorMng.CcwEOT.HwDeg_f32 EOTActuatorMng.CcwFound.Cnt_lgc EOTActuatorMng.CwEOT.HwDeg_f32 EOTActuatorMng.CwFound.Cnt_lgc EOTActuatorMng.EOTDisable.Cnt_lgc EOTActuatorMng.HandWheelAuth.Uls_f32 EOTActuatorMng.HandWheelPos.HwDeg_f32 EOTActuatorMng.HwTorque.HwNm_f32 EOTActuatorMng.MotorVel.MtrRadpS_f32 EOTActuatorMng.PreLimitTorque.MtrNm_f32 EOTActuatorMng.VehicleSpeed.Kph_f32 /end SUB_GROUP
 /begin FUNCTION_LIST /end FUNCTION_LIST
 /begin REF_CHARACTERISTIC /end REF_CHARACTERISTIC
 /begin REF_MEASUREMENT /end REF_MEASUREMENT
/end GROUP
/begin GROUP EOTActuatorMng.SenderPorts "MICROSAR RTE"
 /begin SUB_GROUP EOTActuatorMng.AssistEOTDamping.MtrNm_f32 EOTActuatorMng.AssistEOTGain.Uls_f32 EOTActuatorMng.AssistEOTLimit.MtrNm_f32 /end SUB_GROUP
 /begin FUNCTION_LIST /end FUNCTION_LIST
 /begin REF_CHARACTERISTIC /end REF_CHARACTERISTIC
 /begin REF_MEASUREMENT /end REF_MEASUREMENT
/end GROUP
/begin GROUP EOTActuatorMng.VehicleSpeed.Kph_f32 "MICROSAR RTE" /begin SUB_GROUP /end SUB_GROUP /begin FUNCTION_LIST /end FUNCTION_LIST /begin REF_CHARACTERISTIC /end REF_CHARACTERISTIC /begin REF_MEASUREMENT EOTActuatorMng.VehicleSpeed.Kph_f32 /end REF_MEASUREMENT /end GROUP
/begin GROUP FrqDepDmpnInrtCmp "MICROSAR RTE"
 /begin SUB_GROUP FrqDepDmpnInrtCmp.ModeRequirePorts FrqDepDmpnInrtCmp.ReceiverPorts FrqDepDmpnInrtCmp.SenderPorts /end SUB_GROUP
 /begin FUNCTION_LIST /end FUNCTION_LIST
 /begin REF_CHARACTERISTIC /end REF_CHARACTERISTIC
 /begin REF_MEASUREMENT /end REF_MEASUREMENT
/end GROUP
/begin GROUP FrqDepDmpnInrtCmp.BaseAssistCmd.MtrNm_f32 "MICROSAR RTE" /begin SUB_GROUP /end SUB_GROUP /begin FUNCTION_LIST /end FUNCTION_LIST /begin REF_CHARACTERISTIC /end REF_CHARACTERISTIC /begin REF_MEASUREMENT FrqDepDmpnInrtCmp.BaseAssistCmd.MtrNm_f32 /end REF_MEASUREMENT /end GROUP
/begin GROUP FrqDepDmpnInrtCmp.CRFMotorVel.MtrRadpS_f32 "MICROSAR RTE" /begin SUB_GROUP /end SUB_GROUP /begin FUNCTION_LIST /end FUNCTION_LIST /begin REF_CHARACTERISTIC /end REF_CHARACTERISTIC /begin REF_MEASUREMENT FrqDepDmpnInrtCmp.CRFMotorVel.MtrRadpS_f32 /end REF_MEASUREMENT /end GROUP
/begin GROUP FrqDepDmpnInrtCmp.FreqDepDmpSrlComSvcDft.Cnt_lgc "MICROSAR RTE" /begin SUB_GROUP /end SUB_GROUP /begin FUNCTION_LIST /end FUNCTION_LIST /begin REF_CHARACTERISTIC /end REF_CHARACTERISTIC /begin REF_MEASUREMENT FrqDepDmpnInrtCmp.FreqDepDmpSrlComSvcDft.Cnt_lgc /end REF_MEASUREMENT /end GROUP
/begin GROUP FrqDepDmpnInrtCmp.FrqDepDmpnInrtCmp.MtrNm_f32 "MICROSAR RTE" /begin SUB_GROUP /end SUB_GROUP /begin FUNCTION_LIST /end FUNCTION_LIST /begin REF_CHARACTERISTIC /end REF_CHARACTERISTIC /begin REF_MEASUREMENT FrqDepDmpnInrtCmp.FrqDepDmpnInrtCmp.MtrNm_f32 /end REF_MEASUREMENT /end GROUP
/begin GROUP FrqDepDmpnInrtCmp.HwTorque.HwNm_f32 "MICROSAR RTE" /begin SUB_GROUP /end SUB_GROUP /begin FUNCTION_LIST /end FUNCTION_LIST /begin REF_CHARACTERISTIC /end REF_CHARACTERISTIC /begin REF_MEASUREMENT FrqDepDmpnInrtCmp.HwTorque.HwNm_f32 /end REF_MEASUREMENT /end GROUP
/begin GROUP FrqDepDmpnInrtCmp.ModeRequirePorts "MICROSAR RTE" /begin SUB_GROUP FrqDepDmpnInrtCmp.SystemState.Mode /end SUB_GROUP /begin FUNCTION_LIST /end FUNCTION_LIST /begin REF_CHARACTERISTIC /end REF_CHARACTERISTIC /begin REF_MEASUREMENT /end REF_MEASUREMENT /end GROUP
/begin GROUP FrqDepDmpnInrtCmp.ReceiverPorts "MICROSAR RTE"
 /begin SUB_GROUP FrqDepDmpnInrtCmp.BaseAssistCmd.MtrNm_f32 FrqDepDmpnInrtCmp.CRFMotorVel.MtrRadpS_f32 FrqDepDmpnInrtCmp.FreqDepDmpSrlComSvcDft.Cnt_lgc FrqDepDmpnInrtCmp.HwTorque.HwNm_f32 FrqDepDmpnInrtCmp.VehicleLonAccel.KphpS_f32 FrqDepDmpnInrtCmp.VehicleSpeed.Kph_f32 FrqDepDmpnInrtCmp.WIRCmdAmpBlnd.MtrNm_f32 /end SUB_GROUP
 /begin FUNCTION_LIST /end FUNCTION_LIST
 /begin REF_CHARACTERISTIC /end REF_CHARACTERISTIC
 /begin REF_MEASUREMENT /end REF_MEASUREMENT
/end GROUP
/begin GROUP FrqDepDmpnInrtCmp.SenderPorts "MICROSAR RTE" /begin SUB_GROUP FrqDepDmpnInrtCmp.FrqDepDmpnInrtCmp.MtrNm_f32 /end SUB_GROUP /begin FUNCTION_LIST /end FUNCTION_LIST /begin REF_CHARACTERISTIC /end REF_CHARACTERISTIC /begin REF_MEASUREMENT /end REF_MEASUREMENT /end GROUP
/begin GROUP FrqDepDmpnInrtCmp.SystemState.Mode "MICROSAR RTE" /begin SUB_GROUP /end SUB_GROUP /begin FUNCTION_LIST /end FUNCTION_LIST /begin REF_CHARACTERISTIC /end REF_CHARACTERISTIC /begin REF_MEASUREMENT FrqDepDmpnInrtCmp.SystemState.Mode /end REF_MEASUREMENT /end GROUP
/begin GROUP FrqDepDmpnInrtCmp.VehicleLonAccel.KphpS_f32 "MICROSAR RTE" /begin SUB_GROUP /end SUB_GROUP /begin FUNCTION_LIST /end FUNCTION_LIST /begin REF_CHARACTERISTIC /end REF_CHARACTERISTIC /begin REF_MEASUREMENT FrqDepDmpnInrtCmp.VehicleLonAccel.KphpS_f32 /end REF_MEASUREMENT /end GROUP
/begin GROUP FrqDepDmpnInrtCmp.VehicleSpeed.Kph_f32 "MICROSAR RTE" /begin SUB_GROUP /end SUB_GROUP /begin FUNCTION_LIST /end FUNCTION_LIST /begin REF_CHARACTERISTIC /end REF_CHARACTERISTIC /begin REF_MEASUREMENT FrqDepDmpnInrtCmp.VehicleSpeed.Kph_f32 /end REF_MEASUREMENT /end GROUP
/begin GROUP FrqDepDmpnInrtCmp.WIRCmdAmpBlnd.MtrNm_f32 "MICROSAR RTE" /begin SUB_GROUP /end SUB_GROUP /begin FUNCTION_LIST /end FUNCTION_LIST /begin REF_CHARACTERISTIC /end REF_CHARACTERISTIC /begin REF_MEASUREMENT FrqDepDmpnInrtCmp.WIRCmdAmpBlnd.MtrNm_f32 /end REF_MEASUREMENT /end GROUP
/begin GROUP HiLoadStall "MICROSAR RTE" /begin SUB_GROUP HiLoadStall.ReceiverPorts HiLoadStall.SenderPorts /end SUB_GROUP /begin FUNCTION_LIST /end FUNCTION_LIST /begin REF_CHARACTERISTIC /end REF_CHARACTERISTIC /begin REF_MEASUREMENT /end REF_MEASUREMENT /end GROUP
/begin GROUP HiLoadStall.AssistStallLimit.MtrNm_f32 "MICROSAR RTE" /begin SUB_GROUP /end SUB_GROUP /begin FUNCTION_LIST /end FUNCTION_LIST /begin REF_CHARACTERISTIC /end REF_CHARACTERISTIC /begin REF_MEASUREMENT HiLoadStall.AssistStallLimit.MtrNm_f32 /end REF_MEASUREMENT /end GROUP
/begin GROUP HiLoadStall.DftStallLimit.Cnt_lgc "MICROSAR RTE" /begin SUB_GROUP /end SUB_GROUP /begin FUNCTION_LIST /end FUNCTION_LIST /begin REF_CHARACTERISTIC /end REF_CHARACTERISTIC /begin REF_MEASUREMENT HiLoadStall.DftStallLimit.Cnt_lgc /end REF_MEASUREMENT /end GROUP
/begin GROUP HiLoadStall.MtrVelCRF.MtrRadpS_f32 "MICROSAR RTE" /begin SUB_GROUP /end SUB_GROUP /begin FUNCTION_LIST /end FUNCTION_LIST /begin REF_CHARACTERISTIC /end REF_CHARACTERISTIC /begin REF_MEASUREMENT HiLoadStall.MtrVelCRF.MtrRadpS_f32 /end REF_MEASUREMENT /end GROUP
/begin GROUP HiLoadStall.PreLimitForStall.MtrNm_f32 "MICROSAR RTE" /begin SUB_GROUP /end SUB_GROUP /begin FUNCTION_LIST /end FUNCTION_LIST /begin REF_CHARACTERISTIC /end REF_CHARACTERISTIC /begin REF_MEASUREMENT HiLoadStall.PreLimitForStall.MtrNm_f32 /end REF_MEASUREMENT /end GROUP
/begin GROUP HiLoadStall.ReceiverPorts "MICROSAR RTE"
 /begin SUB_GROUP HiLoadStall.DftStallLimit.Cnt_lgc HiLoadStall.MtrVelCRF.MtrRadpS_f32 HiLoadStall.PreLimitForStall.MtrNm_f32 /end SUB_GROUP
 /begin FUNCTION_LIST /end FUNCTION_LIST
 /begin REF_CHARACTERISTIC /end REF_CHARACTERISTIC
 /begin REF_MEASUREMENT /end REF_MEASUREMENT
/end GROUP
/begin GROUP HiLoadStall.SenderPorts "MICROSAR RTE" /begin SUB_GROUP HiLoadStall.AssistStallLimit.MtrNm_f32 /end SUB_GROUP /begin FUNCTION_LIST /end FUNCTION_LIST /begin REF_CHARACTERISTIC /end REF_CHARACTERISTIC /begin REF_MEASUREMENT /end REF_MEASUREMENT /end GROUP
/begin GROUP HighFreqAssist "MICROSAR RTE" /begin SUB_GROUP HighFreqAssist.ReceiverPorts HighFreqAssist.SenderPorts /end SUB_GROUP /begin FUNCTION_LIST /end FUNCTION_LIST /begin REF_CHARACTERISTIC /end REF_CHARACTERISTIC /begin REF_MEASUREMENT /end REF_MEASUREMENT /end GROUP
/begin GROUP HighFreqAssist.HighFreqAssist.MtrNm_f32 "MICROSAR RTE" /begin SUB_GROUP /end SUB_GROUP /begin FUNCTION_LIST /end FUNCTION_LIST /begin REF_CHARACTERISTIC /end REF_CHARACTERISTIC /begin REF_MEASUREMENT HighFreqAssist.HighFreqAssist.MtrNm_f32 /end REF_MEASUREMENT /end GROUP
/begin GROUP HighFreqAssist.HwTorque.HwNm_f32 "MICROSAR RTE" /begin SUB_GROUP /end SUB_GROUP /begin FUNCTION_LIST /end FUNCTION_LIST /begin REF_CHARACTERISTIC /end REF_CHARACTERISTIC /begin REF_MEASUREMENT HighFreqAssist.HwTorque.HwNm_f32 /end REF_MEASUREMENT /end GROUP
/begin GROUP HighFreqAssist.ReceiverPorts "MICROSAR RTE"
 /begin SUB_GROUP HighFreqAssist.HwTorque.HwNm_f32 HighFreqAssist.VehicleSpeed.Kph_f32 HighFreqAssist.WIRCmdAmpBlnd.MtrNm_f32 /end SUB_GROUP
 /begin FUNCTION_LIST /end FUNCTION_LIST
 /begin REF_CHARACTERISTIC /end REF_CHARACTERISTIC
 /begin REF_MEASUREMENT /end REF_MEASUREMENT
/end GROUP
/begin GROUP HighFreqAssist.SenderPorts "MICROSAR RTE" /begin SUB_GROUP HighFreqAssist.HighFreqAssist.MtrNm_f32 /end SUB_GROUP /begin FUNCTION_LIST /end FUNCTION_LIST /begin REF_CHARACTERISTIC /end REF_CHARACTERISTIC /begin REF_MEASUREMENT /end REF_MEASUREMENT /end GROUP
/begin GROUP HighFreqAssist.VehicleSpeed.Kph_f32 "MICROSAR RTE" /begin SUB_GROUP /end SUB_GROUP /begin FUNCTION_LIST /end FUNCTION_LIST /begin REF_CHARACTERISTIC /end REF_CHARACTERISTIC /begin REF_MEASUREMENT HighFreqAssist.VehicleSpeed.Kph_f32 /end REF_MEASUREMENT /end GROUP
/begin GROUP HighFreqAssist.WIRCmdAmpBlnd.MtrNm_f32 "MICROSAR RTE" /begin SUB_GROUP /end SUB_GROUP /begin FUNCTION_LIST /end FUNCTION_LIST /begin REF_CHARACTERISTIC /end REF_CHARACTERISTIC /begin REF_MEASUREMENT HighFreqAssist.WIRCmdAmpBlnd.MtrNm_f32 /end REF_MEASUREMENT /end GROUP
/begin GROUP HwTrq "MICROSAR RTE"
 /begin SUB_GROUP HwTrq.PerInstanceMemories HwTrq.ReceiverPorts HwTrq.SenderPorts /end SUB_GROUP
 /begin FUNCTION_LIST /end FUNCTION_LIST
 /begin REF_CHARACTERISTIC /end REF_CHARACTERISTIC
 /begin REF_MEASUREMENT /end REF_MEASUREMENT
/end GROUP
/begin GROUP HwTrq.AbsPosStepSignal.Cnt_u08 "MICROSAR RTE" /begin SUB_GROUP /end SUB_GROUP /begin FUNCTION_LIST /end FUNCTION_LIST /begin REF_CHARACTERISTIC /end REF_CHARACTERISTIC /begin REF_MEASUREMENT HwTrq.AbsPosStepSignal.Cnt_u08 /end REF_MEASUREMENT /end GROUP
/begin GROUP HwTrq.AnaDiffHwTrq.Volt_f32 "MICROSAR RTE" /begin SUB_GROUP /end SUB_GROUP /begin FUNCTION_LIST /end FUNCTION_LIST /begin REF_CHARACTERISTIC /end REF_CHARACTERISTIC /begin REF_MEASUREMENT HwTrq.AnaDiffHwTrq.Volt_f32 /end REF_MEASUREMENT /end GROUP
/begin GROUP HwTrq.AnaHwTorque.HwNm_f32 "MICROSAR RTE" /begin SUB_GROUP /end SUB_GROUP /begin FUNCTION_LIST /end FUNCTION_LIST /begin REF_CHARACTERISTIC /end REF_CHARACTERISTIC /begin REF_MEASUREMENT HwTrq.AnaHwTorque.HwNm_f32 /end REF_MEASUREMENT /end GROUP
/begin GROUP HwTrq.CntrlDisRampComplete.Cnt_lgc "MICROSAR RTE" /begin SUB_GROUP /end SUB_GROUP /begin FUNCTION_LIST /end FUNCTION_LIST /begin REF_CHARACTERISTIC /end REF_CHARACTERISTIC /begin REF_MEASUREMENT HwTrq.CntrlDisRampComplete.Cnt_lgc /end REF_MEASUREMENT /end GROUP
/begin GROUP HwTrq.EOLTrqStepData "MICROSAR RTE" /begin SUB_GROUP /end SUB_GROUP /begin FUNCTION_LIST /end FUNCTION_LIST /begin REF_CHARACTERISTIC /end REF_CHARACTERISTIC /begin REF_MEASUREMENT HwTrq.EOLTrqStepData /end REF_MEASUREMENT /end GROUP
/begin GROUP HwTrq.HwTrqScaleData "MICROSAR RTE" /begin SUB_GROUP /end SUB_GROUP /begin FUNCTION_LIST /end FUNCTION_LIST /begin REF_CHARACTERISTIC /end REF_CHARACTERISTIC
 /begin REF_MEASUREMENT HwTrq.HwTrqScaleData.HwTrqScalePerf_Cnt_lgc HwTrq.HwTrqScaleData.HwTrqScale_VoltsPerDeg_f32 /end REF_MEASUREMENT
/end GROUP
/begin GROUP HwTrq.HwTrqScaleVal.VoltsPerDeg_f32 "MICROSAR RTE" /begin SUB_GROUP /end SUB_GROUP /begin FUNCTION_LIST /end FUNCTION_LIST /begin REF_CHARACTERISTIC /end REF_CHARACTERISTIC /begin REF_MEASUREMENT HwTrq.HwTrqScaleVal.VoltsPerDeg_f32 /end REF_MEASUREMENT /end GROUP
/begin GROUP HwTrq.HwTrqTrimData "MICROSAR RTE" /begin SUB_GROUP /end SUB_GROUP /begin FUNCTION_LIST /end FUNCTION_LIST /begin REF_CHARACTERISTIC /end REF_CHARACTERISTIC
 /begin REF_MEASUREMENT HwTrq.HwTrqTrimData.HwTrqTrimPerf_Cnt_lgc HwTrq.HwTrqTrimData.HwTrqTrim_Volts_f32 HwTrq.HwTrqTrimData.T1Trim_Volts_f32 HwTrq.HwTrqTrimData.T2Trim_Volts_f32 /end REF_MEASUREMENT
/end GROUP
/begin GROUP HwTrq.MECCounter.Cnt_enum "MICROSAR RTE" /begin SUB_GROUP /end SUB_GROUP /begin FUNCTION_LIST /end FUNCTION_LIST /begin REF_CHARACTERISTIC /end REF_CHARACTERISTIC /begin REF_MEASUREMENT HwTrq.MECCounter.Cnt_enum /end REF_MEASUREMENT /end GROUP
/begin GROUP HwTrq.PerInstanceMemories "MICROSAR RTE"
 /begin SUB_GROUP HwTrq.EOLTrqStepData HwTrq.HwTrqScaleData HwTrq.HwTrqTrimData /end SUB_GROUP
 /begin FUNCTION_LIST /end FUNCTION_LIST
 /begin REF_CHARACTERISTIC /end REF_CHARACTERISTIC
 /begin REF_MEASUREMENT /end REF_MEASUREMENT
/end GROUP
/begin GROUP HwTrq.ReceiverPorts "MICROSAR RTE"
 /begin SUB_GROUP HwTrq.AbsPosStepSignal.Cnt_u08 HwTrq.CntrlDisRampComplete.Cnt_lgc HwTrq.MECCounter.Cnt_enum HwTrq.T1ADC.Volt_f32 HwTrq.T2ADC.Volt_f32 /end SUB_GROUP
 /begin FUNCTION_LIST /end FUNCTION_LIST
 /begin REF_CHARACTERISTIC /end REF_CHARACTERISTIC
 /begin REF_MEASUREMENT /end REF_MEASUREMENT
/end GROUP
/begin GROUP HwTrq.SenderPorts "MICROSAR RTE"
 /begin SUB_GROUP HwTrq.AnaDiffHwTrq.Volt_f32 HwTrq.AnaHwTorque.HwNm_f32 HwTrq.HwTrqScaleVal.VoltsPerDeg_f32 HwTrq.SrlComHwTrqValid.Cnt_lgc HwTrq.SysCAnaHwTorque.HwNm_f32 HwTrq.T1TrimVal.Volt_f32 HwTrq.T2TrimVal.Volt_f32 /end SUB_GROUP
 /begin FUNCTION_LIST /end FUNCTION_LIST
 /begin REF_CHARACTERISTIC /end REF_CHARACTERISTIC
 /begin REF_MEASUREMENT /end REF_MEASUREMENT
/end GROUP
/begin GROUP HwTrq.SrlComHwTrqValid.Cnt_lgc "MICROSAR RTE" /begin SUB_GROUP /end SUB_GROUP /begin FUNCTION_LIST /end FUNCTION_LIST /begin REF_CHARACTERISTIC /end REF_CHARACTERISTIC /begin REF_MEASUREMENT HwTrq.SrlComHwTrqValid.Cnt_lgc /end REF_MEASUREMENT /end GROUP
/begin GROUP HwTrq.SysCAnaHwTorque.HwNm_f32 "MICROSAR RTE" /begin SUB_GROUP /end SUB_GROUP /begin FUNCTION_LIST /end FUNCTION_LIST /begin REF_CHARACTERISTIC /end REF_CHARACTERISTIC /begin REF_MEASUREMENT HwTrq.SysCAnaHwTorque.HwNm_f32 /end REF_MEASUREMENT /end GROUP
/begin GROUP HwTrq.T1ADC.Volt_f32 "MICROSAR RTE" /begin SUB_GROUP /end SUB_GROUP /begin FUNCTION_LIST /end FUNCTION_LIST /begin REF_CHARACTERISTIC /end REF_CHARACTERISTIC /begin REF_MEASUREMENT HwTrq.T1ADC.Volt_f32 /end REF_MEASUREMENT /end GROUP
/begin GROUP HwTrq.T1TrimVal.Volt_f32 "MICROSAR RTE" /begin SUB_GROUP /end SUB_GROUP /begin FUNCTION_LIST /end FUNCTION_LIST /begin REF_CHARACTERISTIC /end REF_CHARACTERISTIC /begin REF_MEASUREMENT HwTrq.T1TrimVal.Volt_f32 /end REF_MEASUREMENT /end GROUP
/begin GROUP HwTrq.T2ADC.Volt_f32 "MICROSAR RTE" /begin SUB_GROUP /end SUB_GROUP /begin FUNCTION_LIST /end FUNCTION_LIST /begin REF_CHARACTERISTIC /end REF_CHARACTERISTIC /begin REF_MEASUREMENT HwTrq.T2ADC.Volt_f32 /end REF_MEASUREMENT /end GROUP
/begin GROUP HwTrq.T2TrimVal.Volt_f32 "MICROSAR RTE" /begin SUB_GROUP /end SUB_GROUP /begin FUNCTION_LIST /end FUNCTION_LIST /begin REF_CHARACTERISTIC /end REF_CHARACTERISTIC /begin REF_MEASUREMENT HwTrq.T2TrimVal.Volt_f32 /end REF_MEASUREMENT /end GROUP
/begin GROUP HystComp "MICROSAR RTE" /begin SUB_GROUP HystComp.ReceiverPorts HystComp.SenderPorts /end SUB_GROUP /begin FUNCTION_LIST /end FUNCTION_LIST /begin REF_CHARACTERISTIC /end REF_CHARACTERISTIC /begin REF_MEASUREMENT /end REF_MEASUREMENT /end GROUP
/begin GROUP HystComp.AssistMechTempEst.DegC_f32 "MICROSAR RTE" /begin SUB_GROUP /end SUB_GROUP /begin FUNCTION_LIST /end FUNCTION_LIST /begin REF_CHARACTERISTIC /end REF_CHARACTERISTIC /begin REF_MEASUREMENT HystComp.AssistMechTempEst.DegC_f32 /end REF_MEASUREMENT /end GROUP
/begin GROUP HystComp.BaseAssistCmd.MtrNm_f32 "MICROSAR RTE" /begin SUB_GROUP /end SUB_GROUP /begin FUNCTION_LIST /end FUNCTION_LIST /begin REF_CHARACTERISTIC /end REF_CHARACTERISTIC /begin REF_MEASUREMENT HystComp.BaseAssistCmd.MtrNm_f32 /end REF_MEASUREMENT /end GROUP
/begin GROUP HystComp.DefeatHystService.Cnt_lgc "MICROSAR RTE" /begin SUB_GROUP /end SUB_GROUP /begin FUNCTION_LIST /end FUNCTION_LIST /begin REF_CHARACTERISTIC /end REF_CHARACTERISTIC /begin REF_MEASUREMENT HystComp.DefeatHystService.Cnt_lgc /end REF_MEASUREMENT /end GROUP
/begin GROUP HystComp.FricOffset.HwNm_f32 "MICROSAR RTE" /begin SUB_GROUP /end SUB_GROUP /begin FUNCTION_LIST /end FUNCTION_LIST /begin REF_CHARACTERISTIC /end REF_CHARACTERISTIC /begin REF_MEASUREMENT HystComp.FricOffset.HwNm_f32 /end REF_MEASUREMENT /end GROUP
/begin GROUP HystComp.HwTorque.HwNm_f32 "MICROSAR RTE" /begin SUB_GROUP /end SUB_GROUP /begin FUNCTION_LIST /end FUNCTION_LIST /begin REF_CHARACTERISTIC /end REF_CHARACTERISTIC /begin REF_MEASUREMENT HystComp.HwTorque.HwNm_f32 /end REF_MEASUREMENT /end GROUP
/begin GROUP HystComp.HysteresisComp.MtrNm_f32 "MICROSAR RTE" /begin SUB_GROUP /end SUB_GROUP /begin FUNCTION_LIST /end FUNCTION_LIST /begin REF_CHARACTERISTIC /end REF_CHARACTERISTIC /begin REF_MEASUREMENT HystComp.HysteresisComp.MtrNm_f32 /end REF_MEASUREMENT /end GROUP
/begin GROUP HystComp.ReceiverPorts "MICROSAR RTE"
 /begin SUB_GROUP HystComp.AssistMechTempEst.DegC_f32 HystComp.BaseAssistCmd.MtrNm_f32 HystComp.DefeatHystService.Cnt_lgc HystComp.FricOffset.HwNm_f32 HystComp.HwTorque.HwNm_f32 HystComp.VehicleSpeed.Kph_f32 HystComp.WIRCmdAmpBlnd.MtrNm_f32 /end SUB_GROUP
 /begin FUNCTION_LIST /end FUNCTION_LIST
 /begin REF_CHARACTERISTIC /end REF_CHARACTERISTIC
 /begin REF_MEASUREMENT /end REF_MEASUREMENT
/end GROUP
/begin GROUP HystComp.SenderPorts "MICROSAR RTE" /begin SUB_GROUP HystComp.HysteresisComp.MtrNm_f32 /end SUB_GROUP /begin FUNCTION_LIST /end FUNCTION_LIST /begin REF_CHARACTERISTIC /end REF_CHARACTERISTIC /begin REF_MEASUREMENT /end REF_MEASUREMENT /end GROUP
/begin GROUP HystComp.VehicleSpeed.Kph_f32 "MICROSAR RTE" /begin SUB_GROUP /end SUB_GROUP /begin FUNCTION_LIST /end FUNCTION_LIST /begin REF_CHARACTERISTIC /end REF_CHARACTERISTIC /begin REF_MEASUREMENT HystComp.VehicleSpeed.Kph_f32 /end REF_MEASUREMENT /end GROUP
/begin GROUP HystComp.WIRCmdAmpBlnd.MtrNm_f32 "MICROSAR RTE" /begin SUB_GROUP /end SUB_GROUP /begin FUNCTION_LIST /end FUNCTION_LIST /begin REF_CHARACTERISTIC /end REF_CHARACTERISTIC /begin REF_MEASUREMENT HystComp.WIRCmdAmpBlnd.MtrNm_f32 /end REF_MEASUREMENT /end GROUP
/begin GROUP IoHwAbstractionUsr "MICROSAR RTE" /begin SUB_GROUP IoHwAbstractionUsr.SenderPorts /end SUB_GROUP /begin FUNCTION_LIST /end FUNCTION_LIST /begin REF_CHARACTERISTIC /end REF_CHARACTERISTIC /begin REF_MEASUREMENT /end REF_MEASUREMENT /end GROUP
/begin GROUP IoHwAbstractionUsr.Batt.Volt_f32 "MICROSAR RTE" /begin SUB_GROUP /end SUB_GROUP /begin FUNCTION_LIST /end FUNCTION_LIST /begin REF_CHARACTERISTIC /end REF_CHARACTERISTIC /begin REF_MEASUREMENT IoHwAbstractionUsr.Batt.Volt_f32 /end REF_MEASUREMENT /end GROUP
/begin GROUP IoHwAbstractionUsr.BattSwitched.Volt_f32 "MICROSAR RTE" /begin SUB_GROUP /end SUB_GROUP /begin FUNCTION_LIST /end FUNCTION_LIST /begin REF_CHARACTERISTIC /end REF_CHARACTERISTIC /begin REF_MEASUREMENT IoHwAbstractionUsr.BattSwitched.Volt_f32 /end REF_MEASUREMENT /end GROUP
/begin GROUP IoHwAbstractionUsr.InvCos2Scaled.Volt_f32 "MICROSAR RTE" /begin SUB_GROUP /end SUB_GROUP /begin FUNCTION_LIST /end FUNCTION_LIST /begin REF_CHARACTERISTIC /end REF_CHARACTERISTIC /begin REF_MEASUREMENT IoHwAbstractionUsr.InvCos2Scaled.Volt_f32 /end REF_MEASUREMENT /end GROUP
/begin GROUP IoHwAbstractionUsr.InvSin2Scaled.Volt_f32 "MICROSAR RTE" /begin SUB_GROUP /end SUB_GROUP /begin FUNCTION_LIST /end FUNCTION_LIST /begin REF_CHARACTERISTIC /end REF_CHARACTERISTIC /begin REF_MEASUREMENT IoHwAbstractionUsr.InvSin2Scaled.Volt_f32 /end REF_MEASUREMENT /end GROUP
/begin GROUP IoHwAbstractionUsr.SenderPorts "MICROSAR RTE"
 /begin SUB_GROUP IoHwAbstractionUsr.Batt.Volt_f32 IoHwAbstractionUsr.BattSwitched.Volt_f32 IoHwAbstractionUsr.InvCos2Scaled.Volt_f32 IoHwAbstractionUsr.InvSin2Scaled.Volt_f32 IoHwAbstractionUsr.SysCT1ADC.Volt_f32 IoHwAbstractionUsr.SysCT2ADC.Volt_f32 IoHwAbstractionUsr.SysCVSwitch.Volt_f32 IoHwAbstractionUsr.T1ADC.Volt_f32 IoHwAbstractionUsr.T2ADC.Volt_f32 IoHwAbstractionUsr.TemperatureADC.Volt_f32 /end SUB_GROUP
 /begin FUNCTION_LIST /end FUNCTION_LIST
 /begin REF_CHARACTERISTIC /end REF_CHARACTERISTIC
 /begin REF_MEASUREMENT /end REF_MEASUREMENT
/end GROUP
/begin GROUP IoHwAbstractionUsr.SysCT1ADC.Volt_f32 "MICROSAR RTE" /begin SUB_GROUP /end SUB_GROUP /begin FUNCTION_LIST /end FUNCTION_LIST /begin REF_CHARACTERISTIC /end REF_CHARACTERISTIC /begin REF_MEASUREMENT IoHwAbstractionUsr.SysCT1ADC.Volt_f32 /end REF_MEASUREMENT /end GROUP
/begin GROUP IoHwAbstractionUsr.SysCT2ADC.Volt_f32 "MICROSAR RTE" /begin SUB_GROUP /end SUB_GROUP /begin FUNCTION_LIST /end FUNCTION_LIST /begin REF_CHARACTERISTIC /end REF_CHARACTERISTIC /begin REF_MEASUREMENT IoHwAbstractionUsr.SysCT2ADC.Volt_f32 /end REF_MEASUREMENT /end GROUP
/begin GROUP IoHwAbstractionUsr.SysCVSwitch.Volt_f32 "MICROSAR RTE" /begin SUB_GROUP /end SUB_GROUP /begin FUNCTION_LIST /end FUNCTION_LIST /begin REF_CHARACTERISTIC /end REF_CHARACTERISTIC /begin REF_MEASUREMENT IoHwAbstractionUsr.SysCVSwitch.Volt_f32 /end REF_MEASUREMENT /end GROUP
/begin GROUP IoHwAbstractionUsr.T1ADC.Volt_f32 "MICROSAR RTE" /begin SUB_GROUP /end SUB_GROUP /begin FUNCTION_LIST /end FUNCTION_LIST /begin REF_CHARACTERISTIC /end REF_CHARACTERISTIC /begin REF_MEASUREMENT IoHwAbstractionUsr.T1ADC.Volt_f32 /end REF_MEASUREMENT /end GROUP
/begin GROUP IoHwAbstractionUsr.T2ADC.Volt_f32 "MICROSAR RTE" /begin SUB_GROUP /end SUB_GROUP /begin FUNCTION_LIST /end FUNCTION_LIST /begin REF_CHARACTERISTIC /end REF_CHARACTERISTIC /begin REF_MEASUREMENT IoHwAbstractionUsr.T2ADC.Volt_f32 /end REF_MEASUREMENT /end GROUP
/begin GROUP IoHwAbstractionUsr.TemperatureADC.Volt_f32 "MICROSAR RTE" /begin SUB_GROUP /end SUB_GROUP /begin FUNCTION_LIST /end FUNCTION_LIST /begin REF_CHARACTERISTIC /end REF_CHARACTERISTIC /begin REF_MEASUREMENT IoHwAbstractionUsr.TemperatureADC.Volt_f32 /end REF_MEASUREMENT /end GROUP
/begin GROUP MtrDrvDiag "MICROSAR RTE"
 /begin SUB_GROUP MtrDrvDiag.ModeRequirePorts MtrDrvDiag.ReceiverPorts MtrDrvDiag.SenderPorts /end SUB_GROUP
 /begin FUNCTION_LIST /end FUNCTION_LIST
 /begin REF_CHARACTERISTIC /end REF_CHARACTERISTIC
 /begin REF_MEASUREMENT /end REF_MEASUREMENT
/end GROUP
/begin GROUP MtrDrvDiag.FETFaultPhase.Cnt_enum "MICROSAR RTE" /begin SUB_GROUP /end SUB_GROUP /begin FUNCTION_LIST /end FUNCTION_LIST /begin REF_CHARACTERISTIC /end REF_CHARACTERISTIC /begin REF_MEASUREMENT MtrDrvDiag.FETFaultPhase.Cnt_enum /end REF_MEASUREMENT /end GROUP
/begin GROUP MtrDrvDiag.FETFaultType.Cnt_enum "MICROSAR RTE" /begin SUB_GROUP /end SUB_GROUP /begin FUNCTION_LIST /end FUNCTION_LIST /begin REF_CHARACTERISTIC /end REF_CHARACTERISTIC /begin REF_MEASUREMENT MtrDrvDiag.FETFaultType.Cnt_enum /end REF_MEASUREMENT /end GROUP
/begin GROUP MtrDrvDiag.ModeRequirePorts "MICROSAR RTE" /begin SUB_GROUP MtrDrvDiag.SystemState.Mode /end SUB_GROUP /begin FUNCTION_LIST /end FUNCTION_LIST /begin REF_CHARACTERISTIC /end REF_CHARACTERISTIC /begin REF_MEASUREMENT /end REF_MEASUREMENT /end GROUP
/begin GROUP MtrDrvDiag.MtrDrvrInitComplete.Cnt_lgc "MICROSAR RTE" /begin SUB_GROUP /end SUB_GROUP /begin FUNCTION_LIST /end FUNCTION_LIST /begin REF_CHARACTERISTIC /end REF_CHARACTERISTIC /begin REF_MEASUREMENT MtrDrvDiag.MtrDrvrInitComplete.Cnt_lgc /end REF_MEASUREMENT /end GROUP
/begin GROUP MtrDrvDiag.MtrDrvrInitStart.Cnt_lgc "MICROSAR RTE" /begin SUB_GROUP /end SUB_GROUP /begin FUNCTION_LIST /end FUNCTION_LIST /begin REF_CHARACTERISTIC /end REF_CHARACTERISTIC /begin REF_MEASUREMENT MtrDrvDiag.MtrDrvrInitStart.Cnt_lgc /end REF_MEASUREMENT /end GROUP
/begin GROUP MtrDrvDiag.ReceiverPorts "MICROSAR RTE"
 /begin SUB_GROUP MtrDrvDiag.MtrDrvrInitStart.Cnt_lgc MtrDrvDiag.VswitchClosed.Cnt_lgc /end SUB_GROUP
 /begin FUNCTION_LIST /end FUNCTION_LIST
 /begin REF_CHARACTERISTIC /end REF_CHARACTERISTIC
 /begin REF_MEASUREMENT /end REF_MEASUREMENT
/end GROUP
/begin GROUP MtrDrvDiag.SenderPorts "MICROSAR RTE"
 /begin SUB_GROUP MtrDrvDiag.FETFaultPhase.Cnt_enum MtrDrvDiag.FETFaultType.Cnt_enum MtrDrvDiag.MtrDrvrInitComplete.Cnt_lgc /end SUB_GROUP
 /begin FUNCTION_LIST /end FUNCTION_LIST
 /begin REF_CHARACTERISTIC /end REF_CHARACTERISTIC
 /begin REF_MEASUREMENT /end REF_MEASUREMENT
/end GROUP
/begin GROUP MtrDrvDiag.SystemState.Mode "MICROSAR RTE" /begin SUB_GROUP /end SUB_GROUP /begin FUNCTION_LIST /end FUNCTION_LIST /begin REF_CHARACTERISTIC /end REF_CHARACTERISTIC /begin REF_MEASUREMENT MtrDrvDiag.SystemState.Mode /end REF_MEASUREMENT /end GROUP
/begin GROUP MtrDrvDiag.VswitchClosed.Cnt_lgc "MICROSAR RTE" /begin SUB_GROUP /end SUB_GROUP /begin FUNCTION_LIST /end FUNCTION_LIST /begin REF_CHARACTERISTIC /end REF_CHARACTERISTIC /begin REF_MEASUREMENT MtrDrvDiag.VswitchClosed.Cnt_lgc /end REF_MEASUREMENT /end GROUP
/begin GROUP MtrPos "MICROSAR RTE"
 /begin SUB_GROUP MtrPos.PerInstanceMemories MtrPos.ReceiverPorts MtrPos.SenderPorts /end SUB_GROUP
 /begin FUNCTION_LIST /end FUNCTION_LIST
 /begin REF_CHARACTERISTIC /end REF_CHARACTERISTIC
 /begin REF_MEASUREMENT /end REF_MEASUREMENT
/end GROUP
/begin GROUP MtrPos.AlignedCumMtrPosMRF.Deg_f32 "MICROSAR RTE" /begin SUB_GROUP /end SUB_GROUP /begin FUNCTION_LIST /end FUNCTION_LIST /begin REF_CHARACTERISTIC /end REF_CHARACTERISTIC /begin REF_MEASUREMENT MtrPos.AlignedCumMtrPosMRF.Deg_f32 /end REF_MEASUREMENT /end GROUP
/begin GROUP MtrPos.AssistAssemblyPolarity.Cnt_s08 "MICROSAR RTE" /begin SUB_GROUP /end SUB_GROUP /begin FUNCTION_LIST /end FUNCTION_LIST /begin REF_CHARACTERISTIC /end REF_CHARACTERISTIC /begin REF_MEASUREMENT MtrPos.AssistAssemblyPolarity.Cnt_s08 /end REF_MEASUREMENT /end GROUP
/begin GROUP MtrPos.CumMtrPosCRF.Deg_f32 "MICROSAR RTE" /begin SUB_GROUP /end SUB_GROUP /begin FUNCTION_LIST /end FUNCTION_LIST /begin REF_CHARACTERISTIC /end REF_CHARACTERISTIC /begin REF_MEASUREMENT MtrPos.CumMtrPosCRF.Deg_f32 /end REF_MEASUREMENT /end GROUP
/begin GROUP MtrPos.CumMtrPosMRF.Deg_f32 "MICROSAR RTE" /begin SUB_GROUP /end SUB_GROUP /begin FUNCTION_LIST /end FUNCTION_LIST /begin REF_CHARACTERISTIC /end REF_CHARACTERISTIC /begin REF_MEASUREMENT MtrPos.CumMtrPosMRF.Deg_f32 /end REF_MEASUREMENT /end GROUP
/begin GROUP MtrPos.MtrPosSnsr_EOLData "MICROSAR RTE" /begin SUB_GROUP /end SUB_GROUP /begin FUNCTION_LIST /end FUNCTION_LIST /begin REF_CHARACTERISTIC /end REF_CHARACTERISTIC
 /begin REF_MEASUREMENT MtrPos.MtrPosSnsr_EOLData.BEMFCal_Rev_u0p16 MtrPos.MtrPosSnsr_EOLData.Cos1AmpRec_Uls_u3p13 MtrPos.MtrPosSnsr_EOLData.Cos1GainCorr_Uls_u1p15 MtrPos.MtrPosSnsr_EOLData.Cos1OffCorr_Volts_s2p13 MtrPos.MtrPosSnsr_EOLData.Cos1Offset_Volts_u3p13 MtrPos.MtrPosSnsr_EOLData.CosDelta1Rec_Uls_u3p13 MtrPos.MtrPosSnsr_EOLData.CosHarTbl_Cnt_sm6p13 MtrPos.MtrPosSnsr_EOLData.R_BEMFCal_Rev_u0p16 MtrPos.MtrPosSnsr_EOLData.Sin1AmpRec_Uls_u3p13 MtrPos.MtrPosSnsr_EOLData.Sin1GainCorr_Uls_u1p15 MtrPos.MtrPosSnsr_EOLData.Sin1OffCorr_Volts_s2p13 MtrPos.MtrPosSnsr_EOLData.Sin1Offset_Volts_u3p13 MtrPos.MtrPosSnsr_EOLData.SinDelta1_Uls_s2p13 MtrPos.MtrPosSnsr_EOLData.SinHarTbl_Cnt_sm6p13 /end REF_MEASUREMENT
/end GROUP
/begin GROUP MtrPos.PerInstanceMemories "MICROSAR RTE" /begin SUB_GROUP MtrPos.MtrPosSnsr_EOLData /end SUB_GROUP /begin FUNCTION_LIST /end FUNCTION_LIST /begin REF_CHARACTERISTIC /end REF_CHARACTERISTIC /begin REF_MEASUREMENT /end REF_MEASUREMENT /end GROUP
/begin GROUP MtrPos.ReceiverPorts "MICROSAR RTE" /begin SUB_GROUP MtrPos.AssistAssemblyPolarity.Cnt_s08 /end SUB_GROUP /begin FUNCTION_LIST /end FUNCTION_LIST /begin REF_CHARACTERISTIC /end REF_CHARACTERISTIC /begin REF_MEASUREMENT /end REF_MEASUREMENT /end GROUP
/begin GROUP MtrPos.SenderPorts "MICROSAR RTE"
 /begin SUB_GROUP MtrPos.AlignedCumMtrPosMRF.Deg_f32 MtrPos.CumMtrPosCRF.Deg_f32 MtrPos.CumMtrPosMRF.Deg_f32 MtrPos.SysCCumMtrPosCRF.Deg_f32 MtrPos.SysCCumMtrPosMRF.Deg_f32 /end SUB_GROUP
 /begin FUNCTION_LIST /end FUNCTION_LIST
 /begin REF_CHARACTERISTIC /end REF_CHARACTERISTIC
 /begin REF_MEASUREMENT /end REF_MEASUREMENT
/end GROUP
/begin GROUP MtrPos.SysCCumMtrPosCRF.Deg_f32 "MICROSAR RTE" /begin SUB_GROUP /end SUB_GROUP /begin FUNCTION_LIST /end FUNCTION_LIST /begin REF_CHARACTERISTIC /end REF_CHARACTERISTIC /begin REF_MEASUREMENT MtrPos.SysCCumMtrPosCRF.Deg_f32 /end REF_MEASUREMENT /end GROUP
/begin GROUP MtrPos.SysCCumMtrPosMRF.Deg_f32 "MICROSAR RTE" /begin SUB_GROUP /end SUB_GROUP /begin FUNCTION_LIST /end FUNCTION_LIST /begin REF_CHARACTERISTIC /end REF_CHARACTERISTIC /begin REF_MEASUREMENT MtrPos.SysCCumMtrPosMRF.Deg_f32 /end REF_MEASUREMENT /end GROUP
/begin GROUP MtrVel "MICROSAR RTE" /begin SUB_GROUP MtrVel.ReceiverPorts MtrVel.SenderPorts /end SUB_GROUP /begin FUNCTION_LIST /end FUNCTION_LIST /begin REF_CHARACTERISTIC /end REF_CHARACTERISTIC /begin REF_MEASUREMENT /end REF_MEASUREMENT /end GROUP
/begin GROUP MtrVel.AsstAssemPol.Cnt_s08 "MICROSAR RTE" /begin SUB_GROUP /end SUB_GROUP /begin FUNCTION_LIST /end FUNCTION_LIST /begin REF_CHARACTERISTIC /end REF_CHARACTERISTIC /begin REF_MEASUREMENT MtrVel.AsstAssemPol.Cnt_s08 /end REF_MEASUREMENT /end GROUP
/begin GROUP MtrVel.CRFMotorVel.MtrRadpS_f32 "MICROSAR RTE" /begin SUB_GROUP /end SUB_GROUP /begin FUNCTION_LIST /end FUNCTION_LIST /begin REF_CHARACTERISTIC /end REF_CHARACTERISTIC /begin REF_MEASUREMENT MtrVel.CRFMotorVel.MtrRadpS_f32 /end REF_MEASUREMENT /end GROUP
/begin GROUP MtrVel.HandwheelVel.HwRadpS_f32 "MICROSAR RTE" /begin SUB_GROUP /end SUB_GROUP /begin FUNCTION_LIST /end FUNCTION_LIST /begin REF_CHARACTERISTIC /end REF_CHARACTERISTIC /begin REF_MEASUREMENT MtrVel.HandwheelVel.HwRadpS_f32 /end REF_MEASUREMENT /end GROUP
/begin GROUP MtrVel.HwVelValid.Cnt_lgc "MICROSAR RTE" /begin SUB_GROUP /end SUB_GROUP /begin FUNCTION_LIST /end FUNCTION_LIST /begin REF_CHARACTERISTIC /end REF_CHARACTERISTIC /begin REF_MEASUREMENT MtrVel.HwVelValid.Cnt_lgc /end REF_MEASUREMENT /end GROUP
/begin GROUP MtrVel.MRFMotorVel.MtrRadpS_f32 "MICROSAR RTE" /begin SUB_GROUP /end SUB_GROUP /begin FUNCTION_LIST /end FUNCTION_LIST /begin REF_CHARACTERISTIC /end REF_CHARACTERISTIC /begin REF_MEASUREMENT MtrVel.MRFMotorVel.MtrRadpS_f32 /end REF_MEASUREMENT /end GROUP
/begin GROUP MtrVel.MRFMotorVelUnfiltered.MtrRadpS_f32 "MICROSAR RTE" /begin SUB_GROUP /end SUB_GROUP /begin FUNCTION_LIST /end FUNCTION_LIST /begin REF_CHARACTERISTIC /end REF_CHARACTERISTIC /begin REF_MEASUREMENT MtrVel.MRFMotorVelUnfiltered.MtrRadpS_f32 /end REF_MEASUREMENT /end GROUP
/begin GROUP MtrVel.ReceiverPorts "MICROSAR RTE"
 /begin SUB_GROUP MtrVel.AsstAssemPol.Cnt_s08 MtrVel.SysCDiagHandWheelVel.HwRadpS_f32 MtrVel.SysCDiagMtrVelMRF.MtrRadpS_f32 MtrVel.VehicleSpeed.Kph_f32 /end SUB_GROUP
 /begin FUNCTION_LIST /end FUNCTION_LIST
 /begin REF_CHARACTERISTIC /end REF_CHARACTERISTIC
 /begin REF_MEASUREMENT /end REF_MEASUREMENT
/end GROUP
/begin GROUP MtrVel.SenderPorts "MICROSAR RTE"
 /begin SUB_GROUP MtrVel.CRFMotorVel.MtrRadpS_f32 MtrVel.HandwheelVel.HwRadpS_f32 MtrVel.HwVelValid.Cnt_lgc MtrVel.MRFMotorVel.MtrRadpS_f32 MtrVel.MRFMotorVelUnfiltered.MtrRadpS_f32 MtrVel.SysCHandwheelVel.HwRadpS_f32 MtrVel.SysCMotorVelMRF.MtrRadpS_f32 /end SUB_GROUP
 /begin FUNCTION_LIST /end FUNCTION_LIST
 /begin REF_CHARACTERISTIC /end REF_CHARACTERISTIC
 /begin REF_MEASUREMENT /end REF_MEASUREMENT
/end GROUP
/begin GROUP MtrVel.SysCDiagHandWheelVel.HwRadpS_f32 "MICROSAR RTE" /begin SUB_GROUP /end SUB_GROUP /begin FUNCTION_LIST /end FUNCTION_LIST /begin REF_CHARACTERISTIC /end REF_CHARACTERISTIC /begin REF_MEASUREMENT MtrVel.SysCDiagHandWheelVel.HwRadpS_f32 /end REF_MEASUREMENT /end GROUP
/begin GROUP MtrVel.SysCDiagMtrVelMRF.MtrRadpS_f32 "MICROSAR RTE" /begin SUB_GROUP /end SUB_GROUP /begin FUNCTION_LIST /end FUNCTION_LIST /begin REF_CHARACTERISTIC /end REF_CHARACTERISTIC /begin REF_MEASUREMENT MtrVel.SysCDiagMtrVelMRF.MtrRadpS_f32 /end REF_MEASUREMENT /end GROUP
/begin GROUP MtrVel.SysCHandwheelVel.HwRadpS_f32 "MICROSAR RTE" /begin SUB_GROUP /end SUB_GROUP /begin FUNCTION_LIST /end FUNCTION_LIST /begin REF_CHARACTERISTIC /end REF_CHARACTERISTIC /begin REF_MEASUREMENT MtrVel.SysCHandwheelVel.HwRadpS_f32 /end REF_MEASUREMENT /end GROUP
/begin GROUP MtrVel.SysCMotorVelMRF.MtrRadpS_f32 "MICROSAR RTE" /begin SUB_GROUP /end SUB_GROUP /begin FUNCTION_LIST /end FUNCTION_LIST /begin REF_CHARACTERISTIC /end REF_CHARACTERISTIC /begin REF_MEASUREMENT MtrVel.SysCMotorVelMRF.MtrRadpS_f32 /end REF_MEASUREMENT /end GROUP
/begin GROUP MtrVel.VehicleSpeed.Kph_f32 "MICROSAR RTE" /begin SUB_GROUP /end SUB_GROUP /begin FUNCTION_LIST /end FUNCTION_LIST /begin REF_CHARACTERISTIC /end REF_CHARACTERISTIC /begin REF_MEASUREMENT MtrVel.VehicleSpeed.Kph_f32 /end REF_MEASUREMENT /end GROUP
/begin GROUP PeakCurrEst "MICROSAR RTE"
 /begin SUB_GROUP PeakCurrEst.ModeRequirePorts PeakCurrEst.ReceiverPorts PeakCurrEst.SenderPorts /end SUB_GROUP
 /begin FUNCTION_LIST /end FUNCTION_LIST
 /begin REF_CHARACTERISTIC /end REF_CHARACTERISTIC
 /begin REF_MEASUREMENT /end REF_MEASUREMENT
/end GROUP
/begin GROUP PeakCurrEst.EstPkCurr.AmpSq_f32 "MICROSAR RTE" /begin SUB_GROUP /end SUB_GROUP /begin FUNCTION_LIST /end FUNCTION_LIST /begin REF_CHARACTERISTIC /end REF_CHARACTERISTIC /begin REF_MEASUREMENT PeakCurrEst.EstPkCurr.AmpSq_f32 /end REF_MEASUREMENT /end GROUP
/begin GROUP PeakCurrEst.FiltEstPkCurr.AmpSq_f32 "MICROSAR RTE" /begin SUB_GROUP /end SUB_GROUP /begin FUNCTION_LIST /end FUNCTION_LIST /begin REF_CHARACTERISTIC /end REF_CHARACTERISTIC /begin REF_MEASUREMENT PeakCurrEst.FiltEstPkCurr.AmpSq_f32 /end REF_MEASUREMENT /end GROUP
/begin GROUP PeakCurrEst.ModeRequirePorts "MICROSAR RTE" /begin SUB_GROUP PeakCurrEst.SystemState.Mode /end SUB_GROUP /begin FUNCTION_LIST /end FUNCTION_LIST /begin REF_CHARACTERISTIC /end REF_CHARACTERISTIC /begin REF_MEASUREMENT /end REF_MEASUREMENT /end GROUP
/begin GROUP PeakCurrEst.MtrCurrDax.Amp_f32 "MICROSAR RTE" /begin SUB_GROUP /end SUB_GROUP /begin FUNCTION_LIST /end FUNCTION_LIST /begin REF_CHARACTERISTIC /end REF_CHARACTERISTIC /begin REF_MEASUREMENT PeakCurrEst.MtrCurrDax.Amp_f32 /end REF_MEASUREMENT /end GROUP
/begin GROUP PeakCurrEst.MtrCurrQax.Amp_f32 "MICROSAR RTE" /begin SUB_GROUP /end SUB_GROUP /begin FUNCTION_LIST /end FUNCTION_LIST /begin REF_CHARACTERISTIC /end REF_CHARACTERISTIC /begin REF_MEASUREMENT PeakCurrEst.MtrCurrQax.Amp_f32 /end REF_MEASUREMENT /end GROUP
/begin GROUP PeakCurrEst.ReceiverPorts "MICROSAR RTE"
 /begin SUB_GROUP PeakCurrEst.MtrCurrDax.Amp_f32 PeakCurrEst.MtrCurrQax.Amp_f32 /end SUB_GROUP
 /begin FUNCTION_LIST /end FUNCTION_LIST
 /begin REF_CHARACTERISTIC /end REF_CHARACTERISTIC
 /begin REF_MEASUREMENT /end REF_MEASUREMENT
/end GROUP
/begin GROUP PeakCurrEst.SenderPorts "MICROSAR RTE"
 /begin SUB_GROUP PeakCurrEst.EstPkCurr.AmpSq_f32 PeakCurrEst.FiltEstPkCurr.AmpSq_f32 /end SUB_GROUP
 /begin FUNCTION_LIST /end FUNCTION_LIST
 /begin REF_CHARACTERISTIC /end REF_CHARACTERISTIC
 /begin REF_MEASUREMENT /end REF_MEASUREMENT
/end GROUP
/begin GROUP PeakCurrEst.SystemState.Mode "MICROSAR RTE" /begin SUB_GROUP /end SUB_GROUP /begin FUNCTION_LIST /end FUNCTION_LIST /begin REF_CHARACTERISTIC /end REF_CHARACTERISTIC /begin REF_MEASUREMENT PeakCurrEst.SystemState.Mode /end REF_MEASUREMENT /end GROUP
/begin GROUP Polarity "MICROSAR RTE"
 /begin SUB_GROUP Polarity.PerInstanceMemories Polarity.ReceiverPorts Polarity.SenderPorts /end SUB_GROUP
 /begin FUNCTION_LIST /end FUNCTION_LIST
 /begin REF_CHARACTERISTIC /end REF_CHARACTERISTIC
 /begin REF_MEASUREMENT /end REF_MEASUREMENT
/end GROUP
/begin RECORD_LAYOUT RTE_RL_SWORD FNC_VALUES 1 SWORD ROW_DIR DIRECT /end RECORD_LAYOUT
/begin RECORD_LAYOUT RTE_RL_SLONG FNC_VALUES 1 SLONG ROW_DIR DIRECT /end RECORD_LAYOUT
/begin RECORD_LAYOUT RTE_RL_FLOAT32_IEEE FNC_VALUES 1 FLOAT32_IEEE ROW_DIR DIRECT /end RECORD_LAYOUT
/**********************************************************************************************************************
* COMPU_METHOD / COMPU_VTAB_RANGE
*********************************************************************************************************************/
/begin COMPU_METHOD RTE_CM_BOOLEAN "" TAB_VERB "%3.1" "" COMPU_TAB_REF RTE_CM_BOOLEAN /end COMPU_METHOD
/begin COMPU_VTAB_RANGE RTE_CM_BOOLEAN "" 2 0 0 "false" 1 255 "true" /end COMPU_VTAB_RANGE
/begin COMPU_METHOD RTE_CM_ENUM_StaMd_Mode "" TAB_VERB "%.1" "" COMPU_TAB_REF RTE_CM_ENUM_StaMd_Mode /end COMPU_METHOD
/begin COMPU_VTAB_RANGE RTE_CM_ENUM_StaMd_Mode "" 5 0 0 "RTE_MODE_StaMd_Mode_DISABLE" 1 1 "RTE_MODE_StaMd_Mode_OFF" 2 2 "RTE_MODE_StaMd_Mode_OPERATE" 3 3 "RTE_MODE_StaMd_Mode_WARMINIT" 4 4 "RTE_TRANSITION_StaMd_Mode" /end COMPU_VTAB_RANGE
/begin COMPU_METHOD RTE_CM_ENUM_ManufModeType "" TAB_VERB "%.1" "" COMPU_TAB_REF RTE_CM_ENUM_ManufModeType /end COMPU_METHOD
/begin COMPU_VTAB_RANGE RTE_CM_ENUM_ManufModeType "" 3 0 0 "ProductionMode" 1 1 "ManufacturingMode" 2 2 "EngineeringMode" /end COMPU_VTAB_RANGE
/begin COMPU_METHOD RTE_CM_ENUM_FETPHASETYPE_ENUM "" TAB_VERB "%.1" "" COMPU_TAB_REF RTE_CM_ENUM_FETPHASETYPE_ENUM /end COMPU_METHOD
/begin COMPU_VTAB_RANGE RTE_CM_ENUM_FETPHASETYPE_ENUM "" 4 0 0 "NOPHASE" 1 1 "PHASEA" 2 2 "PHASEB" 3 3 "PHASEC" /end COMPU_VTAB_RANGE
/begin COMPU_METHOD RTE_CM_ENUM_FETFAULTTYPE_ENUM "" TAB_VERB "%.1" "" COMPU_TAB_REF RTE_CM_ENUM_FETFAULTTYPE_ENUM /end COMPU_METHOD
/begin COMPU_VTAB_RANGE RTE_CM_ENUM_FETFAULTTYPE_ENUM "" 3 0 0 "NOFAULT" 1 1 "LOWER" 2 2 "UPPER" /end COMPU_VTAB_RANGE
