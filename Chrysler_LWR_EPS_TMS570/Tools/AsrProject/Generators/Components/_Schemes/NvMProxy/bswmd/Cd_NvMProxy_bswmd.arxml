AUTOSAR XML (schema 3.1.2)
package /NEXTEER_DEF
  ecu parameter definition AUTOSARParameterDefinition: module=NvMProxy
  module definition NvMProxy [0..1]: variants pre-compile  # Configuration of the NvM Proxy module
    container NvMProxyConfigSet [0..256]  # This container defines NvM Proxy Blocks.
      container NvMProxyBlock [0..256]  # This container specifies configuration parameters for an individual test block.
        string NvmRamBlockDataAddressSecure: set at pre-compile, origin=Nexteer, symbolic-name-value=true  # Symbol name for unsecured NvM data provided by the NvM driver
        enumeration InitBlockHandling: {None, CRC16, Redundant, ZeroData}, origin=NEXTEER  # This contains type of initialization process that should be done on the block
        enumeration InitCheckFailResponse: {N/A, SetNTC_0x0A, SetNTC_0x08_LoadROMDefaults, SetNTC_0x08_CallNotificationFunction, SetNTC_0x07_LoadROMDefaults, SetNTC_0x07_CallNotificationFunction, SetNTC_0x06_LoadROMDefaults, SetNTC_0x06_CallNotificationFunction}, origin=NEXTEER  # This contains type of action to be taken if a block fails its initialization check (for CRC16 or Redundant). Choose N/A if CRC16 or Redundant not selected.
        string ROMDefault_Or_NotificationFunction_Symbol: origin=Nexteer, symbolic-name-value=true  # This symbolic name of the default data (if LoadROMDefaults is chosen) or function (if CallNotificationFunction is chosen). Set to NULL_PTR if not applicable.
        boolean NvMRamGlobalShared: origin=Nexteer  # Set to true if NvM shadow for this block is already in global shared memory. Typically this is false for most blocks that need to go through the NvM Proxy component, however, some blocks may be an exception (i.e. TypeH block and EEPROM CloseCheck block). Setting this value to true will bypass creating a separate RAM buffer since the NvM driver can already directly write to this data.
        reference NvmBlockDescriptorRef: origin=NEXTEER, destination=NvmBlockDescriptor  # This defines the NvM block to which this proxy configuration is linked.
    container NvMProxyGeneral
      string NvMProxyIncludes [0..100]: origin=NEXTEER, symbolic-name-value=true  # This parameter specifies the include files that contain the definitions of any symbols referenced in the NvM configuration (typically any NvM declared outside of the RTE).
      string FailureAPI: origin=Nexteer  # String containing API for interaction with MyCompany Diagnostic manager to set fault status.
      boolean NvMProxyDevErrorDetect: set at published-information, origin=Nexteer, default-value=false  # Switch for enabling the development error detection.
    container CommonPublishedInformation  # Common container, aggregated by all modules. It contains published information about vendor and versions.
      integer ArMajorVersion: set at published-information, origin=Nexteer, default-value=1  # Major version number of AUTOSAR specification on which the appropriate implementation is based on.
      integer ArMinorVersion: set at published-information, origin=Nexteer, default-value=2  # Minor version number of AUTOSAR specification on which the appropriate implementation is based on.
      integer ArPatchVersion: set at published-information, origin=Nexteer, default-value=0  # Patch level version number of AUTOSAR specification on which the appropriate implementation is based on.
      integer SwMajorVersion: set at published-information, origin=Nexteer, default-value=1  # Major version number of the vendor specific implementation of the module.
      integer SwMinorVersion: set at published-information, origin=Nexteer, default-value=0  # Minor version number of the vendor specific implementation of the module. The numbering is vendor specific.
      integer SwPatchVersion: set at published-information, origin=Nexteer, default-value=0  # Patch level version number of the vendor specific implementation of the module. The numbering is vendor specific.
      integer ModuleId: set at published-information, origin=Nexteer, default-value=104  # Module ID of this module from Module List
      integer VendorId: set at published-information, origin=Nexteer, default-value=0  # Vendor ID of the dedicated implementation of this module according to the AUTOSAR vendor list
      string VendorApiInfix [0..1]: set at published-information, origin=Nexteer
