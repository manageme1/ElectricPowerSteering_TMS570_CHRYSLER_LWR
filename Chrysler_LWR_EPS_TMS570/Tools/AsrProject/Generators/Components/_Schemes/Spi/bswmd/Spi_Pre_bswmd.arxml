AUTOSAR XML (schema 3.1.4)
# COPYRIGHT
# Copyright (c) 2012 by Vctr Informatik GmbH. All rights reserved.
# This software is copyright protected and proprietary to Vctr Informatik GmbH.
# Vctr Informatik GmbH grants to you only those rights as set out in the license conditions.
package /MICROSAR
  module config Spi_Pre: definition=Spi
    SpiGeneral: SpiLevelDelivered=1
  module config Spi_Pre_Class1: definition=Spi
    Spi_Runtime (SpiDriver): SpiMaxHWUnit=4, SpiMaxChannel=254, SpiMaxJob=254, SpiMaxSequence=254
