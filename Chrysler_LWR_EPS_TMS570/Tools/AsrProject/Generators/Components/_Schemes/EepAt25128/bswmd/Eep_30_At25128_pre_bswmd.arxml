AUTOSAR XML (schema 3.0.2)
# COPYRIGHT
# Copyright (c) 2010 by Vctr Informatik GmbH. All rights reserved.
# This software is copyright protected and proprietary to Vctr Informatik GmbH.
# Vctr Informatik GmbH grants to you only those rights as set out in the license conditions.
package /MICROSAR
  module config EepAt25128_Pre: definition=EepAt25128, implementation-config-variant=VARIANT-POST-BUILD
    19 x EepDeviceInformation:
      Atmel_At25128: EepChipSize=16384, EepAddressBitWidth=EepAddressing16Bit, EepChipOffset=0, EepPageSize=64  # Atmel AT25128
      Atmel_At25256: EepChipSize=32768, EepAddressBitWidth=EepAddressing16Bit, EepChipOffset=0, EepPageSize=EepPageSize64  # Atmel AT25256
      Microchip_25LC080A: EepChipSize=1024, EepAddressBitWidth=EepAddressing16Bit, EepChipOffset=0, EepPageSize=16  # Microchip 25LC080A
      Microchip_25LC080B: EepChipSize=1024, EepAddressBitWidth=EepAddressing16Bit, EepChipOffset=0, EepPageSize=EepPageSize32  # Microchip 25LC080B
      Microchip_25LC160A: EepChipSize=2048, EepAddressBitWidth=EepAddressing16Bit, EepChipOffset=0, EepPageSize=EepPageSize16  # Microchip 25LC160A
      Microchip_25LC160B: EepChipSize=2048, EepAddressBitWidth=EepAddressing16Bit, EepChipOffset=0, EepPageSize=EepPageSize32  # Microchip 25LC160B
      Microchip_25LC320A: EepChipSize=4096, EepAddressBitWidth=EepAddressing16Bit, EepChipOffset=0, EepPageSize=EepPageSize32  # Microchip 25LC320A
      Microchip_25LC640A: EepChipSize=8192, EepAddressBitWidth=EepAddressing16Bit, EepChipOffset=0, EepPageSize=EepPageSize32  # Microchip 25LC640A
      Microchip_25LC128: EepChipSize=16384, EepAddressBitWidth=EepAddressing16Bit, EepChipOffset=0, EepPageSize=EepPageSize64  # Microchip 25LC128
      Microchip_25LC256: EepChipSize=32768, EepAddressBitWidth=EepAddressing16Bit, EepChipOffset=0, EepPageSize=EepPageSize64  # Microchip 25LC256
      Seiko_S25C010A: EepChipSize=128, EepAddressBitWidth=EepAddressing8Bit, EepChipOffset=0, EepPageSize=EepPageSize16  # Seiko S-25C010A
      Seiko_S25C020A: EepChipSize=256, EepAddressBitWidth=EepAddressing8Bit, EepChipOffset=0, EepPageSize=EepPageSize16  # Seiko S-25C020A
      Seiko_S25C040A: EepChipSize=512, EepAddressBitWidth=EepAddressing9Bit, EepChipOffset=0, EepPageSize=EepPageSize16  # Seiko S-25C040A
      STMicroelectronics_M35SW08: EepChipSize=2048, EepAddressBitWidth=EepAddressing16Bit, EepChipOffset=32, EepPageSize=EepPageSize32  # STMicroelectronics M35SW08
      STMicroelectronics_M35SW16: EepChipSize=4096, EepAddressBitWidth=EepAddressing16Bit, EepChipOffset=32, EepPageSize=EepPageSize32  # STMicroelectronics M35SW16
      STMicroelectronics_M95080: EepChipSize=1024, EepAddressBitWidth=EepAddressing16Bit, EepChipOffset=0, EepPageSize=EepPageSize32  # STMicroelectronics M95080
      STMicroelectronics_M95160: EepChipSize=2048, EepAddressBitWidth=EepAddressing16Bit, EepChipOffset=0, EepPageSize=EepPageSize32  # STMicroelectronics M95160
      STMicroelectronics_M95320: EepChipSize=4096, EepAddressBitWidth=EepAddressing16Bit, EepChipOffset=0, EepPageSize=EepPageSize32  # STMicroelectronics M95320
      STMicroelectronics_M95640: EepChipSize=8192, EepAddressBitWidth=EepAddressing16Bit, EepChipOffset=0, EepPageSize=EepPageSize32  # STMicroelectronics M95640
