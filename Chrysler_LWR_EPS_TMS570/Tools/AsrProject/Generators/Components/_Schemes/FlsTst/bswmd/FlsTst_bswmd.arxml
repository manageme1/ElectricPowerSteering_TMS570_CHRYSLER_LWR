AUTOSAR XML (schema 3.1.2)
package /NEXTEER_DEF
  ecu parameter definition AUTOSARParameterDefinition: module=FlsTst
  module definition FlsTst [0..1]: variants pre-compile  # Configuration of the Flash Test module
    container FlsTstConfigSet [0..255]  # FlsTstConfigSet container
      container FlsTstBlockBgndConfigSet [0..256]  # This container defines the blocks in background mode.
        container FlsTstBlock [0..256]  # This container specifies configuration parameters for an individual test block.
          integer FlsTstBlockBaseAddress: 0..4194303, set at published-information, origin=Nexteer  # Start Address of the Flash block.
          string FlsTstBlockBaseSymbol [0..1]: set at pre-compile, origin=Nexteer  # MyCompany extension. Symbol name for start of Flash block. If this is defined, then the FlsTstBlockBaseAddress param is ignored.
          integer FlsTstBlockIndex: 0..4294967295, set at published-information, origin=Nexteer  # Foreground Test: Index identifies block to be tested by FlsTst_StartFgnd(); Background Test: The scheduling for background test shall follow an order defined by this index. '0' means highest priority.
          integer FlsTstBlockSize: 0..4294967295, set at pre-compile, origin=Nexteer  # This parameter shall represent the Flash Test block size.
          integer FlsTstNumberOfTestedCells: 0..4294967295, set at published-information, origin=Nexteer  # Configures the Number of cells to be tested in background mode during one scheduled task (FlsTst_MainFunction() call). MyCompany unused.
          integer FlsTstSignatureAddress: 0..4294967295, set at published-information, origin=Nexteer  # Address of the signature reference value of the Flash test block.
          string FlsTstSignatureSymbol [0..1]: set at pre-compile in variant pre-compile+link-time / post-build in variant post-build, origin=Nexteer  # MyCompany extension. Symbol name for the Flash Test signature. If this is defined, then the FlsTstSignatureAddress param is ignored.
          enumeration FlsTstTestAlgorithm: {FLSTST_16BIT_CRC, FLSTST_32BIT_CRC, FLSTST_8BIT_CRC, FLSTST_CHECKSUM, FLSTST_DUPLICATED_MEMORY, FLSTST_ECC, FLSTST_64BIT_CRC}, set at published-information, origin=Nexteer, default-value=FLSTST_64BIT_CRC  # This is the configuration of the test algorithm for foreground mode and background mode. The availability of algorithm is implementation specific.
      container FlsTstBlockFgndConfigSet [0..256]  # This container defines the blocks in foreground mode.
        container FlsTstBlock [0..256]  # This container specifies configuration parameters for an individual test block.
          integer FlsTstBlockBaseAddress: 0..4194303, set at pre-compile, origin=Nexteer  # Start Address of the Flash block.
          string FlsTstBlockBaseSymbol [0..1]: set at pre-compile in variant pre-compile+link-time / post-build in variant post-build, origin=Nexteer  # MyCompany extension. Symbol name for start of Flash block. If this is defined, then the FlsTstBlockBaseAddress param is ignored.
          integer FlsTstBlockIndex: 0..4294967295, set at pre-compile, origin=Nexteer  # Foreground Test: Index identifies block to be tested by FlsTst_StartFgnd(); Background Test: The scheduling for background test shall follow an order defined by this index. '0' means highest priority.
          integer FlsTstBlockSize: 0..4294967295, set at pre-compile, origin=Nexteer  # This parameter shall represent the Flash Test block size.
          integer FlsTstNumberOfTestedCells: 0..4294967295, set at pre-compile, origin=Nexteer  # Configures the Number of cells to be tested in background mode during one scheduled task (FlsTst_MainFunction() call). MyCompany unused.
          integer FlsTstSignatureAddress: 0..4294967295, set at pre-compile, origin=Nexteer  # Address of the signature reference value of the Flash test block.
          string FlsTstSignatureSymbol [0..1]: set at pre-compile in variant pre-compile+link-time / post-build in variant post-build, origin=Nexteer  # MyCompany extension. Symbol name for the Flash Test signature. If this is defined, then the FlsTstSignatureAddress param is ignored.
          enumeration FlsTstTestAlgorithm: {FLSTST_16BIT_CRC, FLSTST_32BIT_CRC, FLSTST_8BIT_CRC, FLSTST_CHECKSUM, FLSTST_DUPLICATED_MEMORY, FLSTST_ECC, FLSTST_64BIT_CRC}, set at pre-compile, origin=Nexteer, default-value=FLSTST_64BIT_CRC  # This is the configuration of the test algorithm for foreground mode and background mode. The availability of algorithm is implementation specific.
      integer FlsTstBlockNumberBgnd: set at pre-compile in variant pre-compile+link-time / post-build in variant post-build, origin=Nexteer, default-value=0  # This parameter shall represent the number of test blocks available for the background test. calculationFormula = Number of configured FlsTstBlocks in the FlsTstBlockBgndConfigSet (or 0 if no FlsTstBlocks are configured).
      integer FlsTstBlockNumberFgnd: set at pre-compile in variant pre-compile+link-time / post-build in variant post-build, origin=Nexteer, default-value=0  # This parameter shall represent the number of test blocks available for the foreground test. calculationFormula = Number of configured FlsTstBlocks in the FlsTstBlockFgndConfigSet (or 0 if no FlsTstBlocks are configured).
      function name FlsTstTestCompletedNotification: set at post-build in variant post-build / pre-compile in variant pre-compile  # Pointer to function, which shall be called after finishing the background Flash test interval.
    container FlsTstConfigurationOfOptApiServices
      boolean FlsTstGetCurrentStateApi: set at pre-compile, origin=Nexteer, default-value=false  # Adds / removes the service FlsTst_GetCurrentState() from the code.
      boolean FlsTstGetErrorDetailsApi: set at pre-compile, origin=Nexteer, default-value=false  # Adds / removes the service FlsTst_GetErrorDetails() from the code.
      boolean FlsTstGetTestResultBgndApi: set at pre-compile, origin=Nexteer, default-value=false  # Adds / removes the service FlsTst_GetTestResultBgnd() from the code.
      boolean FlsTstGetTestResultFgndApi: set at pre-compile, origin=Nexteer, default-value=false  # Adds / removes the service FlsTst_GetTestResultFgnd() from the code.
      boolean FlsTstGetTestSignatureBgndApi: set at pre-compile, origin=Nexteer, default-value=false  # Adds / removes the service FlsTst_GetTestSignatureBgnd() from the code.
      boolean FlsTstGetTestSignatureFgndApi: set at pre-compile, origin=Nexteer, default-value=false  # Adds / removes the service FlsTst_GetTestSignatureFgnd() from the code.
      boolean FlsTstStartFgndApi: set at pre-compile, origin=Nexteer, default-value=false  # Adds / removes the service FlsTst_StartFgnd() from the code.
      boolean FlsTstSuspendResumeApi: set at pre-compile, origin=Nexteer, default-value=false  # Adds / removes the services FlsTst_Suspend() and FlsTst_Resume() from the code.
      boolean FlsTstTestEccApi: set at pre-compile, origin=Nexteer, default-value=false  # Adds / removes the service FlsTst_TestEcc() from the code.
      boolean FlsTstVersionInfoApi: set at pre-compile, origin=Nexteer, default-value=false  # Adds / removes the service FlsTst_GetVersionInfo() from the code.
    container FlsTstDemEventParameterRefs  # Container for the references to DemEventParameter elements which shall be invoked using the API Dem_ReportErrorStatus API in case the corresponding error occurs. The EventId is taken from the referenced DemEventParameter's DemEventId value. The standardized errors are provided in the container and can be extended by vendor specific error references.
      string FLSTST_E_FLSTST_FAILURE: set at pre-compile, origin=Nexteer  # Reference to the DemEventParameter which shall be issued when the error "Flash Failure" has occurred. MyCompany devation defines this parameter as a string which is the NTC enumeration symbol name for this event ID.
      integer FLSTST_E_FLSTST_INFO: 0..255, set at pre-compile, origin=Nexteer  # This parameter defines MyCompany "parameter byte" provided with the error "Flash Failure" indication.
      string FLSTST_E_SELFTEST_FAILURE: set at pre-compile, origin=Nexteer  # MyCompany extension to FlsTst requirements defines a Self Test. This parameter defines the API and passed parameters to be invoked upon a failure detection.
      integer FLSTST_E_SELFTEST_INFO: 0..255, set at pre-compile, origin=Nexteer  # MyCompany extension to FlsTst requirements defines a Self Test. This parameter defines MyCompany "parameter byte" provided with the failure indication.
      string FLSTST_E_MPU_FAILURE: set at pre-compile, origin=Nexteer  # MyCompany extension to FlsTst requirements defines a DMA MPU failure. This parameter defines the event ID symbol to be used in the API upon a failure detection.
      integer FLSTST_E_MPU_INFO: 0..255, set at pre-compile, origin=Nexteer  # MyCompany extension to FlsTst requirements defines a DMA MPU failure. This parameter defines MyCompany "parameter byte" provided with the failure indication.
      string FLSTST_E_UNEXPECTEDIRQ_FAILURE: set at pre-compile, origin=Nexteer  # MyCompany extension to FlsTst requirements defines a DMA MPU failure. This parameter defines the API and passed parameters to be invoked upon a failure detection.
      integer FLSTST_E_UNEXPECTEDIRQ_INFO: 0..255, set at pre-compile, origin=Nexteer  # MyCompany extension to FlsTst requirements defines a Self Test. This parameter defines MyCompany "parameter byte" provided with the failure indication.
      string FlsTstDemInclude: set at pre-compile, origin=Nexteer  # MyCompany extension to FlsTst to allow custom definition of the Event Failed API used. This parameter defines the header file name containing the API prototypes and Event definitions.
      string FailureAPI: set at pre-compile, origin=Nexteer  # String containing API for interaction with MyCompany Diagnostic manager to set fault status.
    container FlsTstGeneral
      boolean FlsTstDevErrorDetect: set at published-information, origin=Nexteer, default-value=false  # Switch for enabling the development error detection.
      integer FlsTstNumberOfTestedCellsAtomic: set at published-information, origin=Nexteer, default-value=1  # Configures the Number of cells to be tested in background mode without checking user requests (Abort, Suspend). MyCompany not used.
      boolean FlsTstTestCompletedNotificationSupported: set at pre-compile, origin=Nexteer, default-value=true  # Switch to indicate that the notification is supported.
      integer FlsTstTestIntervalIdEndValue: set at published-information, origin=Nexteer, default-value=4294967295  # Defines the end value of the Test Interval Id.
      boolean FlsTstTestResultSignature: set at published-information, origin=Nexteer, default-value=false  # Configures the result of the test in background mode: True: Test Result is a signature (see FlsTst155, FlsTst054) False: Test Result is ok/not ok (see FlsTst153, FlsTst042). MyCompany not used.
    container CommonPublishedInformation  # Common container, aggregated by all modules. It contains published information about vendor and versions.
      integer ArMajorVersion: set at published-information, origin=Nexteer, default-value=1  # Major version number of AUTOSAR specification on which the appropriate implementation is based on.
      integer ArMinorVersion: set at published-information, origin=Nexteer, default-value=2  # Minor version number of AUTOSAR specification on which the appropriate implementation is based on.
      integer ArPatchVersion: set at published-information, origin=Nexteer, default-value=0  # Patch level version number of AUTOSAR specification on which the appropriate implementation is based on.
      integer SwMajorVersion: set at published-information, origin=Nexteer, default-value=1  # Major version number of the vendor specific implementation of the module.
      integer SwMinorVersion: set at published-information, origin=BMW GroupNexteer, default-value=0  # Minor version number of the vendor specific implementation of the module. The numbering is vendor specific.
      integer SwPatchVersion: set at published-information, origin=Nexteer, default-value=0  # Patch level version number of the vendor specific implementation of the module. The numbering is vendor specific.
      integer ModuleId: set at published-information, origin=Nexteer, default-value=104  # Module ID of this module from Module List
      integer VendorId: set at published-information, origin=Nexteer, default-value=0  # Vendor ID of the dedicated implementation of this module according to the AUTOSAR vendor list
      string VendorApiInfix [0..1]: set at published-information, origin=Nexteer
