AUTOSAR XML (schema 3.0.1)
package /MICROSAR
  module config SchM_Rec: definition=SchM, implementation-config-variant=VARIANT-PRE-COMPILE  # Configuration of the SchM (BSW Scheduler) module.
    Det (SchMModuleConfiguration): SchMModuleLiteral=Det, SchMModuleInclude=Det.h, SchMModuleConfigVersion=1.0.0, SchMModuleImplementationRef=Det_Impl
      SCHM_DET_INSTANCE_0 (InstanceConfiguration): SchMInstanceLiteral=SCHM_DET_INSTANCE_0
        DET_EXCLUSIVE_AREA_0 (ExclusiveAreaConf):
          SchMExclusiveAreaLiteral = DET_EXCLUSIVE_AREA_0
          SchMExclusiveAreaDescription = Critical section to guarantee atomic handling of log buffer, requires global interrupt disabling.
