AUTOSAR XML (schema 3.0.1)
package /MICROSAR
  module config Board_Pre: definition=Board
    BoardGeneral: BoardOsType=Autosar
  module config Board_Rec: definition=Board, implementation-config-variant=VARIANT-PRE-COMPILE
    BoardGeneral
