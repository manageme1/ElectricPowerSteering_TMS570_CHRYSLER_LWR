AUTOSAR XML (schema 314)
package /ModeDclrGroup
  mode declaration group ComMMode: initial-mode=NO_COMMUNICATION
    mode FULL_COMMUNICATION
    mode NO_COMMUNICATION
    mode SILENT_COMMUNICATION
  mode declaration group EcuM_Mode: initial-mode=STARTUP
    6 x mode:
      POST_RUN
      RUN
      SHUTDOWN
      SLEEP
      STARTUP
      WAKE_SLEEP
  mode declaration group StaMd_Mode: initial-mode=WARMINIT  # EPS System State mode declaration
    4 x mode:
      DISABLE
      OFF
      OPERATE
      WARMINIT
package /PortInterface
  94 x client server interface:
    AbsHwPosScom_Scom
      operation HwPosSrvRead
        arg Par: type=Boolean, direction=OUT
      operation HwPosSrvSetToZero
        arg Par: type=Boolean, direction=IN
    ActivePull_SCom  # Serial communication port for setting and getting a sdoftware component parameter. The parameter is typically an EOL parameter.
      4 x operation:
        ReadParam
          4 x arg, all with direction=OUT:
            PullCompCmd_HwNm_f32: type=Float
            STComp_HwNm_f32: type=Float
            LTComp_HwNm_f32: type=Float
            EnableLearn_Cnt_lgc: type=Boolean
        Reset
        SetLTComp
          arg LTComp_HwNm_f32: type=Float, direction=IN
        SetSTComp
          arg STComp_HwNm_f32: type=Float, direction=IN
    AssistLmtFunc_Scom
      operation GetSteeringAssistDefeat
        arg SteeringAsstDefeat_Cnt_lgc: type=Boolean, direction=OUT
      operation ManualTrqCmd: possible-error=[RTE_E_MtrTrqLmt_SCom_VSTH, RTE_E_OK]
        arg EnableManualCtrl: type=Boolean, direction=IN
        arg MtrTrqCmd_MtrNm_f32: type=Float, direction=IN
      operation SetSteeringAssistDefeat
        arg SteeringAsstDefeat_Cnt_lgc: type=Boolean, direction=IN
      error RTE_E_MtrTrqLmt_SCom_VSTH: error-code=34
      error RTE_E_OK: error-code=1
    AvgFricLrn_SCom
      9 x operation:
        CaptureOnTheFly
        GetEOLFric
          arg EOLFric_HwNm_f32: type=Float, direction=OUT
        GetOffsetOutputDefeat
          arg DefeatOffsetOutput_Cnt_lgc: type=Boolean, direction=OUT
        GetSelect
          arg EnableFricLearning_Cnt_lgc: type=Boolean, direction=OUT
          arg EnableOffsetOutput_Cnt_lgc: type=Boolean, direction=OUT
          arg OpMode_Uls_u08: type=UInt8, direction=OUT
        InitLearnedTables
        ResetToZero
        SetEOLFric
          arg EOLFric_HwNm_f32: type=Float, direction=IN
        SetOffsetOutputDefeat
          arg DefeatOffsetOutput_Cnt_lgc: type=Boolean, direction=IN
        SetSelect
          arg EnableFricLearning_Cnt_lgc: type=Boolean, direction=IN
          arg EnableOffsetOutput_Cnt_lgc: type=Boolean, direction=IN
          arg OpMode_Uls_u08: type=UInt8, direction=IN
    Batt
      operation Batt_V_f32: possible-error=Batt/E_NOT_OK
        arg signal: type=Float, direction=OUT
      error E_NOT_OK: error-code=1
    BatteryVoltage_SCom
      operation ClearTransOvData
      operation ReadTransOvData
        arg OvervoltageCounter_Cnt_u16: type=UInt16, direction=OUT
        arg MaxBattVoltage_Volts_f32: type=Float, direction=OUT
    BattSwitched
      operation BattSwitched_V_f32: possible-error=BattSwitched/E_NOT_OK
        arg signal: type=Float, direction=OUT
      error E_NOT_OK: error-code=1
    CDDPorts: is-service=true
      operation ApplyMtrElecMechPol
        arg MtrElecMechPol_Cnt_s8: type=SInt8, direction=IN
      operation ClearPhsReasSum
        arg DataAccessBfr_Cnt_T_u16: type=UInt16, direction=IN
    CmMtrCurr_SCom
      5 x operation:
        CalGain: possible-error=[ConditionNotCorrect, CurrentOutOfRange, VehSpdOutofRange]
        CalOffset: possible-error=[ConditionNotCorrect, CurrentOutOfRange, VehSpdOutofRange]
        MtrCurrOffReadStatus
          arg CurrOffStatus: type=MtrCurrOffProcessFlag, direction=OUT
        ReadMtrCurrCals
          arg ShCurrCalPtr: type=PhaseCurrCal_DataType, direction=OUT
        SetMtrCurrCals
          arg ShCurrCalPtr: type=PhaseCurrCal_DataType, direction=IN
      error ConditionNotCorrect: error-code=34
      error CurrentOutOfRange: error-code=20
      error VehSpdOutofRange: error-code=21
    ComM_ChannelLimitation: is-service=true
      operation GetInhibitionStatus: possible-error=ComM_ChannelLimitation/E_NOT_OK
        arg Status: type=ComM_InhibitionStatusType, direction=OUT
      operation LimitChannelToNoComMode: possible-error=ComM_ChannelLimitation/E_NOT_OK
        arg Status: type=Boolean, direction=IN
      error E_NOT_OK: error-code=1
    ComM_ChannelWakeUp: is-service=true
      operation PreventWakeUp: possible-error=ComM_ChannelWakeUp/E_NOT_OK
        arg Status: type=Boolean, direction=IN
      error E_NOT_OK: error-code=1
    ComM_ECUModeLimitation: is-service=true
      4 x operation, all with possible-error=ComM_ECUModeLimitation/E_NOT_OK:
        LimitECUToNoComMode
          arg Status: type=Boolean, direction=IN
        ReadInhibitCounter
          arg CounterValue: type=UInt16, direction=OUT
        ResetInhibitCounter
        SetECUGroupClassification
          arg Status: type=ComM_InhibitionStatusType, direction=IN
      error E_NOT_OK: error-code=1
    ComM_GetNumSendRcvAppl: is-service=true
      operation GetNumSendRcvAppl: possible-error=ComM_GetNumSendRcvAppl/E_NOT_OK
        arg sendRcvApplCount: type=UInt8, direction=OUT
      error E_NOT_OK: error-code=1
    ComM_UserRequest: is-service=true
      4 x operation:
        GetCurrentComMode: possible-error=ComM_UserRequest/E_NOT_OK
          arg ComMode: type=ComM_ModeType, direction=OUT
        GetMaxComMode: possible-error=ComM_UserRequest/E_NOT_OK
          arg ComMode: type=ComM_ModeType, direction=OUT
        GetRequestedComMode: possible-error=ComM_UserRequest/E_NOT_OK
          arg ComMode: type=ComM_ModeType, direction=OUT
        RequestComMode: possible-error=[COMM_E_MODE_LIMITATION, ComM_UserRequest/E_NOT_OK]
          arg ComMode: type=ComM_ModeType, direction=IN
      error COMM_E_MODE_LIMITATION: error-code=2
      error E_NOT_OK: error-code=1
    CtrlTemp_V_f32
      operation CtrlTemp_V_f32: possible-error=CtrlTemp_V_f32/E_NOT_OK
        arg signal: type=Float, direction=OUT
      error E_NOT_OK: error-code=1
    DemIf
      4 x operation:
        DemShutdown
        RestartDem
        SetEventStatus: possible-error=DemIf/E_NOT_OK
          arg EventId: type=UInt8, direction=IN
          arg EventStatus: type=NxtrDiagMgrStatus, direction=IN
        SetOperationCycleState
          arg NxtrOperationCycleId: type=NxtrOpCycle, direction=IN
          arg NxtrCycleState: type=NxtrOpCycleState, direction=IN
      error E_NOT_OK: error-code=1
    DiagMgr_StaCtrl
      operation Shutdown
    DiagnosticMonitor: is-service=true
      7 x operation:
        GetDTCOfEvent: possible-error=[DEM_GET_DTCOFEVENT_WRONG_DTCKIND, DEM_GET_DTCOFEVENT_WRONG_EVENTID, DiagnosticMonitor/E_NOT_OK]
          arg DTCKind: type=Dem_DTCKindType, direction=IN
          arg DTC: type=Dem_DTCType, direction=OUT
        GetEventFailed: possible-error=DiagnosticMonitor/E_NOT_OK
          arg Failed: type=Boolean, direction=OUT
        GetEventStatus: possible-error=DiagnosticMonitor/E_NOT_OK
          arg EventStatus: type=Dem_EventStatusExtendedType, direction=OUT
        GetEventTested: possible-error=DiagnosticMonitor/E_NOT_OK
          arg Failed: type=Boolean, direction=OUT
        GetFaultDetectionCounter: possible-error=DiagnosticMonitor/E_NOT_OK
          arg EventIdFaultDetectionCounter: type=Dem_FaultDetectionCounterType, direction=OUT
        ResetEventStatus: possible-error=[DiagnosticMonitor/DEM_E_QUEUE_OVERFLOW, DiagnosticMonitor/E_NOT_OK]
        SetEventStatus: possible-error=[DiagnosticMonitor/DEM_E_QUEUE_OVERFLOW, DiagnosticMonitor/E_NOT_OK]
          arg EventStatus: type=Dem_EventStatusType, direction=IN
      4 x error:
        DEM_E_QUEUE_OVERFLOW: error-code=15
        DEM_GET_DTCOFEVENT_WRONG_DTCKIND: error-code=4
        DEM_GET_DTCOFEVENT_WRONG_EVENTID: error-code=5
        E_NOT_OK: error-code=1
    DigitalIn
      operation OP_SET: possible-error=DigitalIn/E_NOT_OK
        arg signal: type=IoHwAb_BoolType, direction=IN
      error E_NOT_OK: error-code=1
    DigitalInOut
      operation OP_GET: possible-error=DigitalInOut/E_NOT_OK
        arg signal: type=IoHwAb_BoolType, direction=OUT
      operation OP_SET: possible-error=DigitalInOut/E_NOT_OK
        arg signal: type=IoHwAb_BoolType, direction=IN
      error E_NOT_OK: error-code=1
    DigitalOut
      operation OP_SET: possible-error=DigitalOut/E_NOT_OK
        arg signal: type=IoHwAb_BoolType, direction=IN
      error E_NOT_OK: error-code=1
    EpsEn
      operation OP_GET: possible-error=EpsEn/E_NOT_OK
        arg signal: type=IoHwAb_BoolType, direction=OUT
      error E_NOT_OK: error-code=1
    FaultInjection
      operation FltInjection
        arg SignalPath_Uls_f32: type=Float, direction=INOUT
        arg LocationKey_Cnt_enum: type=FltInjectionLocType, direction=IN
    FaultInjection_SCom
      operation FltInjection
        arg SignalPath_Uls_f32: type=Float, direction=INOUT
        arg LocationKey_Cnt_enum: type=FltInjectionLocType, direction=IN
    FetDrvCntl
      operation OP_GET: possible-error=FetDrvCntl/E_NOT_OK
        arg signal: type=IoHwAb_BoolType, direction=OUT
      error E_NOT_OK: error-code=1
    FetDrvReset
      operation OP_GET: possible-error=FetDrvReset/E_NOT_OK
        arg signal: type=IoHwAb_BoolType, direction=OUT
      operation OP_SET: possible-error=FetDrvReset/E_NOT_OK
        arg signal: type=IoHwAb_BoolType, direction=IN
      error E_NOT_OK: error-code=1
    FetFlt1Data
      operation OP_GET: possible-error=FetFlt1Data/E_NOT_OK
        arg signal: type=IoHwAb_BoolType, direction=OUT
      error E_NOT_OK: error-code=1
    FetFlt2Clk
      operation OP_GET: possible-error=FetFlt2Clk/E_NOT_OK
        arg signal: type=IoHwAb_BoolType, direction=OUT
      operation OP_SET: possible-error=FetFlt2Clk/E_NOT_OK
        arg signal: type=IoHwAb_BoolType, direction=IN
      error E_NOT_OK: error-code=1
    FltInjection_SCom
      operation FltInjection
        arg SignalPath_Uls_f32: type=Float, direction=INOUT
        arg LocationKey_Cnt_enum: type=FltInjectionLocType, direction=IN
    HwTorque
      4 x operation, all with possible-error=HwTorque/E_NOT_OK:
        T1_V_f32
          arg signal: type=Float, direction=OUT
        T1Diag_V_f32
          arg signal: type=Float, direction=OUT
        T2_V_f32
          arg signal: type=Float, direction=OUT
        T2Diag_V_f32
          arg signal: type=Float, direction=OUT
      error E_NOT_OK: error-code=1
    HwTrq_SCom  # Serial communication port for setting and getting a sdoftware component parameter. The parameter is typically an EOL parameter.
      9 x operation:
        ClrHwTrqScale: possible-error=HwTrq_SCom/ConditionsNotCorrect
        ClrHwTrqTrim: possible-error=HwTrq_SCom/ConditionsNotCorrect
        ManualSetHwTrqTrim: possible-error=HwTrq_SCom/ConditionsNotCorrect
          arg HwTrqTrimDataPtr: type=HwTrqTrim_Datatype, direction=IN
        ReadEOLTrqStep
          arg TrqStep_HwNm_T_f32: type=EOLTrqStepType, direction=OUT
        ReadHwTrqScale
          arg HwTrqScaleDataPtr: type=HwTrqScale_Datatype, direction=OUT
        ReadHwTrqTrim
          arg HwTrqTrimDatPtr: type=HwTrqTrim_Datatype, direction=OUT
        SetEOLTrqStep
          arg TrqStep_HwNm_T_f32: type=EOLTrqStepType, direction=IN
        SetHwTrqScale: possible-error=HwTrq_SCom/ConditionsNotCorrect
          arg ScaleValue: type=Float, direction=IN
        SetHwTrqTrim: possible-error=HwTrq_SCom/ConditionsNotCorrect
      error ConditionsNotCorrect: error-code=34
    IndicatorStatus: is-service=true
      operation GetIndicatorStatus: possible-error=IndicatorStatus/E_NOT_OK
        arg IndicatorStatus: type=Dem_IndicatorStatusType, direction=OUT
      error E_NOT_OK: error-code=1
    IoHwAbPortConfig
      operation SetFetFlt2ToOutput: possible-error=IoHwAbPortConfig/E_NOT_OK
        arg signal: type=IoHwAb_BoolType, direction=IN
      error E_NOT_OK: error-code=1
    IPMTrqCanc_Scom
      operation ReadCogTrqCal
        arg CogTrqCalPtr: type=IPMCoggingCancTrq, direction=OUT
        arg ID: type=UInt16, direction=IN
      operation SetCogTrqCal
        arg CogTrqCalPtr: type=IPMCoggingCancTrq, direction=IN
        arg ID: type=UInt16, direction=IN
    LearnPinionCtr_SCom  # Serial communication port for setting and getting a sdoftware component parameter. The parameter is typically an EOL parameter.
      operation GetLearnPinionCtrStatus
        arg LearnPinionCtrStatusDatPtr: type=Boolean, direction=OUT
      operation SetInputParam
        arg LearnPinionCtrEnable_lgc: type=Boolean, direction=IN
      error ConditionsNotCorrect: error-code=34
      error RequestOutOfRange: error-code=49
    LrnEOT_Scom
      operation ResetEOT
    LTReInitialize_SCom  # Serial communication port for setting and getting a sdoftware component parameter. The parameter is typically an EOL parameter.
      operation SetInputParam
        arg LTReInitializeService_HwNm_f32: type=Float, direction=IN
    MilestoneRequest
      operation WarmInitMilestoneComplete
        arg user: type=StaMd_Users, direction=IN
      operation WarmInitMilestoneNotComplete
        arg user: type=StaMd_Users, direction=IN
    MtrCurrTempOffset_Scom
      operation Get
        arg CurrTempOffCal: type=CurrTempOffsetType, direction=OUT
      operation Set
        arg CurrTempOffCal: type=CurrTempOffsetType, direction=IN
    MtrPos
      4 x operation, all with possible-error=MtrPos/E_NOT_OK:
        CosTheta1_V_f32
          arg signal: type=Float, direction=OUT
        InvCosTheta2_V_f32
          arg signal: type=Float, direction=OUT
        InvSinTheta2_V_f32
          arg signal: type=Float, direction=OUT
        SinTheta1_V_f32
          arg signal: type=Float, direction=OUT
      error E_NOT_OK: error-code=1
    MtrPos_SCom
      operation ReadEOLMtrCals
        arg MtrCalDataPtr: type=MtrPosCal_DataType, direction=OUT
      operation SetEOLMtrCals
        arg MtrCalDataPtr: type=MtrPosCal_DataType, direction=IN
    MtrTrqLmt_SCom
      operation ManualTrqCmd: possible-error=VSTH
        arg EnableManualCtrl: type=Boolean, direction=IN
        arg MtrTrqCmd_MtrNm_f32: type=Float, direction=IN
      operation ReadEOLTrqCmdSclFac
        arg TrqCmdSclFacPtr_Uls_T_u7p9: type=UInt16, direction=OUT
      operation SetEOLTrqCmdSclFac
        arg TrqCmdSclFac_Uls_T_u7p9: type=UInt16, direction=IN
      error VSTH: error-code=34
    MtrVelCDDInterface
      operation GetMtrVelSignals
        4 x arg, all with direction=OUT:
          SinAvg_Uls_T_s2p13: type=SInt16
          CosAvg_Uls_T_s2p13: type=SInt16
          PosAvg_Rev_T_u0p16: type=UInt16
          TimeAvg_uS_T_u16p0: type=UInt16
    NvM_AC3_SRBS_Srv: is-service=true  # Port Interface for NVRAM Blocks of Management Types "NATIVE" or "REDUNDANT" without default values.
      6 x operation:
        EraseBlock: possible-error=NvM_AC3_SRBS_Srv/E_NOT_OK
        GetErrorStatus
          arg ErrorStatus: type=NvM_RequestResultType, direction=OUT
        InvalidateNvBlock: possible-error=NvM_AC3_SRBS_Srv/E_NOT_OK
        ReadBlock: possible-error=NvM_AC3_SRBS_Srv/E_NOT_OK
          arg DstPtr: type=NvM_DestPtr, direction=OUT
        SetRamBlockStatus
          arg RamBlockStatus: type=Boolean, direction=IN
        WriteBlock: possible-error=NvM_AC3_SRBS_Srv/E_NOT_OK
          arg DstPtr: type=NvM_DestPtr, direction=IN
      error E_NOT_OK: error-code=1
    NvM_AC3_SRBS_Srv_Defs: is-service=true  # Port Interface for NVRAM Blocks of Management Types "NATIVE" or "REDUNDANT" with default values.
      7 x operation:
        EraseBlock: possible-error=NvM_AC3_SRBS_Srv_Defs/E_NOT_OK
        GetErrorStatus
          arg ErrorStatus: type=NvM_RequestResultType, direction=OUT
        InvalidateNvBlock: possible-error=NvM_AC3_SRBS_Srv_Defs/E_NOT_OK
        ReadBlock: possible-error=NvM_AC3_SRBS_Srv_Defs/E_NOT_OK
          arg DstPtr: type=NvM_DestPtr, direction=OUT
        RestoreBlockDefaults: possible-error=NvM_AC3_SRBS_Srv_Defs/E_NOT_OK
          arg DstPtr: type=NvM_DestPtr, direction=OUT
        SetRamBlockStatus
          arg RamBlockStatus: type=Boolean, direction=IN
        WriteBlock: possible-error=NvM_AC3_SRBS_Srv_Defs/E_NOT_OK
          arg DstPtr: type=NvM_DestPtr, direction=IN
      error E_NOT_OK: error-code=1
    NvM_Administration: is-service=true
      operation SetBlockProtection
        arg ProtectionEnabled: type=Boolean, direction=IN
    NvM_NotifyJobFinished: is-service=true
      operation JobFinished: possible-error=NvM_NotifyJobFinished/E_NOT_OK
        arg ServiceId: type=NvM_ServiceIdType, direction=IN
        arg JobResult: type=NvM_RequestResultType, direction=IN
      error E_NOT_OK: error-code=1
    NxtrDiagMgr
      4 x operation, all with possible-error=NxtrDiagMgr/E_NOT_OK:
        GetNTCActive
          arg NTC_Cnt_T_enum: type=NTCNumber, direction=IN
          arg NTCActive_Ptr_T_lgc: type=Boolean, direction=OUT
        GetNTCFailed
          arg NTC_Cnt_T_enum: type=NTCNumber, direction=IN
          arg NTCFailed_Ptr_T_lgc: type=Boolean, direction=OUT
        GetNTCStatus
          arg NTC_Cnt_T_enum: type=NTCNumber, direction=IN
          arg Status_Ptr_T_u08: type=UInt8, direction=OUT
        SetNTCStatus
          arg NTC_Cnt_T_enum: type=NTCNumber, direction=IN
          arg Param_Cnt_T_u08: type=UInt8, direction=IN
          arg Status_Cnt_T_enum: type=NxtrDiagMgrStatus, direction=IN
      error E_NOT_OK: error-code=1
    OperationCycle: is-service=true
      operation SetOperationCycleState: possible-error=[OperationCycle/DEM_E_QUEUE_OVERFLOW, OperationCycle/E_NOT_OK]
        arg CycleState: type=Dem_OperationCycleStateType, direction=IN
      error DEM_E_QUEUE_OVERFLOW: error-code=15
      error E_NOT_OK: error-code=1
    OverlayState
      operation Transition
        arg State_Cnt_T_u08: type=UInt8, direction=IN
    OvrVoltFdbk
      operation OP_GET: possible-error=OvrVoltFdbk/E_NOT_OK
        arg signal: type=IoHwAb_BoolType, direction=OUT
      error E_NOT_OK: error-code=1
    ParameterEst_SCom
      operation ReadMtrParamCals
        arg MtrParamCalPtr: type=MtrParamCal_DataType, direction=OUT
      operation SetMtrParamCals
        arg MtrParamCalPtr: type=MtrParamCal_DataType, direction=OUT
    PhaseDscnt
      operation Cmd: possible-error=PhaseDscnt/E_NOT_OK
        arg signal: type=IoHwAb_BoolType, direction=IN
      operation PhaseDscntCmd: possible-error=PhaseDscnt/E_NOT_OK
        arg signal: type=IoHwAb_BoolType, direction=IN
      error E_NOT_OK: error-code=1
    Polarity_SCom
      operation ReadPolarity
        arg Polarity_Ptr_T_b08: type=UInt8, direction=OUT
      operation SetPolarity
        arg Polarity_Cnt_T_b08: type=UInt8, direction=IN
    PwrSwitchEn
      operation OP_GET: possible-error=PwrSwitchEn/E_NOT_OK
        arg signal: type=IoHwAb_BoolType, direction=OUT
      error E_NOT_OK: error-code=1
    RacktoVehCntrOffset_Scom
      operation ClearRacktoVehCntrOffset
      operation SetRacktoVehCntrOffset
    ResetPullComp_SCom  # Serial communication port for setting and getting a sdoftware component parameter. The parameter is typically an EOL parameter.
      operation SetInputParam: possible-error=[HwTrqConditionsNotCorrect, VehSpdConditionsNotCorrect]
      error HwTrqConditionsNotCorrect: error-code=11
      error VehSpdConditionsNotCorrect: error-code=5
    SCom_EOLNomMtrParam  # Serial communication port for setting and getting a sdoftware component parameter. The parameter is typically an EOL parameter.
      operation Get
        arg NomKe_VpRadpS_f32: type=Float, direction=OUT
        arg NomRmtr_Ohm_f32: type=Float, direction=OUT
      operation Set
        arg NomKe_VpRadpS_f32: type=Float, direction=IN
        arg NomRmtr_Ohm_f32: type=Float, direction=IN
      error ConditionsNotCorrect: error-code=34
      error RequestOutOfRange: error-code=49
    SCom_KeIntgSVParam  # Serial communication port for setting and getting a sdoftware component parameter. The parameter is typically an EOL parameter.
      operation Get
        arg KeIntgSV_Amp_f32: type=Float, direction=OUT
      operation Set
        arg KeIntgSV_Amp_f32: type=Float, direction=IN
    SCom_ManualVehSpd
      operation SCom_ManualVehSpd
        arg VehSpd_Kph_f32: sw-calibration-access=READ-ONLY, type=Float, direction=IN
    SCom_NxtrDiagMgr
      5 x operation:
        ClearBlackBox
        ClearLatchCounters
        GetNTCInfo
          4 x arg:
            NTC_Cnt_T_enum: type=NTCNumber, direction=IN
            Param_Ptr_T_u08: type=UInt8, direction=OUT
            Status_Ptr_T_u08: type=UInt8, direction=OUT
            AgingCounter_Ptr_T_u08: type=UInt8, direction=OUT
        ReadStrgArray
        ResetNTCStatus
    SCom_ParEng  # Serial communication port for setting and getting a sdoftware component parameter. The parameter is typically an EOL parameter.
      operation Get
        arg Par_f32: type=Float, direction=OUT
      operation Set
        arg Par_f32: type=Float, direction=IN
      error ConditionsNotCorrect: error-code=34
      error RequestOutOfRange: error-code=49
    SCom_RIntgSVParam  # Serial communication port for setting and getting a sdoftware component parameter.
      operation Get
        arg RIntgSV_Amp_f32: type=Float, direction=OUT
      operation Set
        arg RIntgSV_Amp_f32: type=Float, direction=IN
    Scom_RtnAsync  # Serial communication port for activating a remote asynchronous routine
      operation Start: possible-error=Scom_RtnAsync/ConditionsNotCorrect
      operation Status: possible-error=Scom_RtnAsync/ConditionsNotCorrect
        arg status: type=RoutineStatus, direction=OUT
      operation Stop: possible-error=Scom_RtnAsync/ConditionsNotCorrect
      error ConditionsNotCorrect: error-code=34
      error RequestOutOfRange: error-code=49
    SCom_RtnSync  # Serial communication port for activating a remote synchronous routine
      operation Start: possible-error=SCom_RtnSync/ConditionsNotCorrect
      error ConditionsNotCorrect: error-code=34
      error RequestOutOfRange: error-code=49
    Shcur
      operation Shcur_V_f32: possible-error=Shcur/E_NOT_OK
        arg signal: type=Float, direction=OUT
      error E_NOT_OK: error-code=1
    SnsrlessHwPos_Scom
      operation SetCenterPosition
    Spi_Ch: is-service=true
      operation SetupEB
        arg SrcDataBufferPtr: type=Spi_DataPtr, direction=IN
        arg DesDataBufferPtr: type=Spi_DataPtr, direction=IN
        arg Length: type=Spi_NumberOfDataType, direction=IN
    Spi_Notification: is-service=true
      operation JobEnd
      operation SequenceEnd
    Spi_Seq: is-service=true
      operation AsyncTransmit
      operation GetSequenceResult: possible-error=[SPI_SEQ_CANCELLED, SPI_SEQ_FAILED, SPI_SEQ_PENDING]
      error SPI_SEQ_CANCELLED: error-code=3
      error SPI_SEQ_FAILED: error-code=2
      error SPI_SEQ_PENDING: error-code=1
    SrlComInput_SCom
      operation ManualVehSpd
        arg VehSpd_Kph_f32: type=Float, direction=IN
    StaMd_SCom
      operation EcuReset
    StateRequest: is-service=true
      5 x operation, all with possible-error=StateRequest/E_NOT_OK:
        GetState
          arg state: type=EcuM_StateType, direction=OUT
        ReleasePOSTRUN
        ReleaseRUN
        RequestPOSTRUN
        RequestRUN
      error E_NOT_OK: error-code=1
    StOpCtrl_RampRqst
      operation CancelCmd
        arg user: type=StOpRamp_User, direction=IN
      operation RampCmd
        arg user: type=StOpRamp_User, direction=IN
        arg rampCmd: type=RT_RampCmd, direction=IN
    STReInitialize_SCom  # Serial communication port for setting and getting a sdoftware component parameter. The parameter is typically an EOL parameter.
      operation SetInputParam
        arg STReInitializeService_HwNm_f32: type=Float, direction=IN
    SysFault2
      operation OP_GET: possible-error=SysFault2/E_NOT_OK
        arg signal: type=IoHwAb_BoolType, direction=OUT
      operation OP_SET: possible-error=SysFault2/E_NOT_OK
        arg signal: type=IoHwAb_BoolType, direction=IN
      error E_NOT_OK: error-code=1
    SysFault3
      operation OP_GET: possible-error=SysFault3/E_NOT_OK
        arg signal: type=IoHwAb_BoolType, direction=OUT
      operation OP_SET: possible-error=SysFault3/E_NOT_OK
        arg signal: type=IoHwAb_BoolType, direction=IN
      error E_NOT_OK: error-code=1
    SystemTime: is-service=true
      6 x operation:
        DtrmnElapsedTime_mS_u16  # MyCompany SystemTime Service
          arg InitialTime: type=UInt32, direction=IN
          arg ElapsedTime: type=UInt16, direction=OUT
        DtrmnElapsedTime_mS_u32
          arg InitialTime: type=UInt32, direction=IN
          arg ElapsedTime: type=UInt32, direction=OUT
        DtrmnElapsedTime_uS_u16
          arg InitialTime: type=UInt32, direction=IN
          arg ElapsedTime: type=UInt16, direction=OUT
        DtrmnElapsedTime_uS_u32
          arg InitialTime: type=UInt32, direction=IN
          arg ElapsedTime: type=UInt32, direction=OUT
        GetSystemTime_mS_u32
          arg CurrentTime: type=UInt32, direction=OUT
        GetSystemTime_uS_u32
          arg CurrentTime: type=UInt32, direction=OUT
    TcCS
      operation OP_SET: possible-error=TcCS/E_NOT_OK
        arg signal: type=IoHwAb_BoolType, direction=IN
      error E_NOT_OK: error-code=1
    TcEOLCals_Scom
      operation ClearTcEOLCals
      operation ReadTcEOLCals
      operation SetTcEOLCals: possible-error=RequestDataOutOfRange
        6 x arg, all with type=UInt8, direction=IN:
          TcEolSineOffset_Cnt_P_u8
          TcEolCosineOffset_Cnt_P_u8
          TcEolSin2CosGain_Cnt_P_u8
          TcEolSinVsCosMin_Cnt_P_u8
          TcEolSinVsCosMax_Cnt_P_u8
          TcEolCalChksm_Cnt_P_u8
      error RequestDataOutOfRange: error-code=34
    TcMCLR
      operation OP_SET: possible-error=TcMCLR/E_NOT_OK
        arg signal: type=IoHwAb_BoolType, direction=IN
      error E_NOT_OK: error-code=1
    TOD
      operation OP_SET: possible-error=TOD/E_NOT_OK
        arg signal: type=IoHwAb_BoolType, direction=IN
      error E_NOT_OK: error-code=1
    TODReset
      operation OP_SET: possible-error=TODReset/E_NOT_OK
        arg signal: type=IoHwAb_BoolType, direction=IN
      error E_NOT_OK: error-code=1
    TrqCanc_Scom
      4 x operation:
        ReadCogTrqCal
          arg CogTrqCalPtr: type=CoggingCancTrq, direction=OUT
          arg ID: type=UInt16, direction=IN
        ReadCogTrqCalComp
          arg ID: type=UInt16, direction=IN
          arg CogTrqCalPtr: type=CoggingCancTrq, direction=OUT
        SetCogTrqCal
          arg CogTrqCalPtr: type=CoggingCancTrq, direction=IN
          arg ID: type=UInt16, direction=IN
        SetCogTrqCalComp
          arg ID: type=UInt16, direction=IN
          arg CogTrqCalPtr: type=CoggingCancTrq, direction=OUT
    TuningAdj
      7 x operation:
        ApplyNegHyst
          arg LPAssistCmdFilt_HwNm_T_s8p7: type=SInt16, direction=IN
          arg Hys_Ptr_T_s8p7: type=SInt16, direction=INOUT
        BlndAltBaseAssist
          arg VehSpd_Kph_T_u9p7: type=UInt16, direction=IN
          arg AbsBaseTrq_HwNm_T_u8p8: type=UInt16, direction=IN
          arg BaseAssist_Ptr_T_s4p11: type=SInt16, direction=INOUT
        BlndAltConstFric
          arg VehSpd_Kph_T_u9p7: type=UInt16, direction=IN
          arg ConstFric_Ptr_T_u9p7: type=UInt16, direction=INOUT
        BlndAltDmpFiltKp
          arg VehSpd_Kph_T_u9p7: type=UInt16, direction=IN
          arg DmpFiltKp_Ptr_T_u16: type=UInt16, direction=INOUT
        BlndAltHPGain
          arg VehSpd_Kph_T_u9p7: type=UInt16, direction=IN
          arg HPGainLookup_HwNm_T_u8p8: type=UInt16, direction=IN
          arg HPGain_Ptr_T_u5p11: type=UInt16, direction=INOUT
        BlndAltLPFKn
          arg VehSpd_Kph_T_u9p7: type=UInt16, direction=IN
          arg AssistLPFKn_Ptr_T_u16: type=UInt16, direction=INOUT
        BlndAltRollDmp
          arg TrqCmd_MtrNm_T_u5p11: type=UInt16, direction=IN
          arg RollDmp_Ptr_T_u0p16: type=UInt16, direction=INOUT
    VehicleCenter_Scom
      operation ClearCenterPosition
      operation SetCenterPosition: possible-error=[VehicleCenter_Scom/E_NOT_OK, E_NOT_OK_OUTOFRANGE]
        arg Offset_HwDeg_P_f32: type=Float, direction=IN
      error E_NOT_OK: error-code=1
      error E_NOT_OK_OUTOFRANGE: error-code=49
    Vref
      operation Vref_V_f32: possible-error=Vref/E_NOT_OK
        arg signal: type=Float, direction=OUT
      error E_NOT_OK: error-code=1
    WdgM_AliveSupervision: is-service=true
      operation CheckpointReached: possible-error=WdgM_AliveSupervision/E_NOT_OK  # Indicates to the Watchdog Manager that a Checkpoint within a Supervised Entity has been reached.
      error E_NOT_OK: error-code=1
    WdgM_CheckpointReached: is-service=true
      operation CheckpointReached: possible-error=WdgM_CheckpointReached/E_NOT_OK  # Indicates to the Watchdog Manager that a Checkpoint within a Supervised Entity has been reached.
      error E_NOT_OK: error-code=1
    WdgM_GlobalMode: is-service=true
      7 x operation, all with possible-error=WdgM_GlobalMode/E_NOT_OK:
        GetGlobalStatus  # Returns the global monitoring status of the Watchdog Manager.
          arg Status: type=WdgM_GlobalStatusType, direction=OUT
        GetMode  # Returns the current mode of the Watchdog Manager.
          arg Mode: type=WdgM_ModeType, direction=OUT
        GlobalStateChangeCbk  # Global state change callback notification
          arg Status: type=WdgM_GlobalStatusType, direction=IN
        LocalStateChangeCbk  # Local state change callback notification
          arg Status: type=WdgM_LocalStatusType, direction=IN
        MainFunction  # Performs the processing of the cyclic Watchdog Manager jobs.
        PerformReset  # Instructs the Watchdog Manager to cause a watchdog reset.
        SetMode  # Sets the mode of the Watchdog Manager if the caller is allowed to do so.
      error E_NOT_OK: error-code=1
    WdgM_IndividualMode: is-service=true
      operation ActivateSupervisionEntity: possible-error=WdgM_IndividualMode/E_NOT_OK  # This function activates the monitoring of the given Supervised Entity
      operation DeactivateSupervisionEntity: possible-error=WdgM_IndividualMode/E_NOT_OK  # This function deactivates the monitoring of the given Supervised Entity
      operation GetLocalStatus: possible-error=WdgM_IndividualMode/E_NOT_OK  # Returns the monitoring status of an individual Supervised Entity.
        arg Status: type=WdgM_LocalStatusType, direction=OUT
      error E_NOT_OK: error-code=1
    WdMonitor
      operation OP_SET: possible-error=WdMonitor/E_NOT_OK
        arg signal: type=IoHwAb_BoolType, direction=IN
      error E_NOT_OK: error-code=1
    WdReset
      operation OP_SET: possible-error=WdReset/E_NOT_OK
        arg signal: type=IoHwAb_BoolType, direction=IN
      error E_NOT_OK: error-code=1
    WhlImbRej_SCom
      operation GetWIRInfo
        5 x arg, all with direction=OUT:
          WIRCmpActRng{1..3}Ptr_Cnt_u32: type=UInt32
          AlgFltStatusPtr_Cnt_b16: type=UInt16
          WIRMaxCompPtr_Pct_f32: type=Float
  183 x sender receiver interface:
    AirTempOutside_DegC_f32
      data DegC_f32: type=UInt16
    AltFaultActive_Cnt_lgc
      data Cnt_lgc: type=Boolean
    APA_State_enum
      data State_enum: type=APA_State_enum
    Authority
      data Uls_f32: sw-calibration-access=READ-ONLY, type=Float
    Authority_Uls_f32
      data Uls_f32: sw-calibration-access=READ-ONLY, type=Float
    BattSwActive
      data Cnt_lgc: sw-calibration-access=READ-ONLY, type=Boolean
    BoolStatusFlag
      data Cnt_lgc: sw-calibration-access=READ-ONLY, type=Boolean
    BoolStatusFlag_Cnt_lgc
      data Cnt_lgc: sw-calibration-access=READ-ONLY, type=Boolean
    BoolStatusFlagCnt_lgc
      data Cnt_lgc: sw-calibration-access=READ-ONLY, type=Boolean
    ByteCounter
      data Cnt_u08: type=UInt8
    Count_Cnt_s08
      data Cnt_s08: sw-calibration-access=READ-ONLY, type=SInt8
    Count_Cnt_s16
      data Cnt_s16: sw-calibration-access=READ-ONLY, type=SInt16
    Count_Cnt_s32
      data Cnt_s32: sw-calibration-access=READ-ONLY, type=SInt32
    Count_Cnt_u08
      data Cnt_u08: sw-calibration-access=READ-ONLY, type=UInt8
    Count_Cnt_u16
      data Cnt_u16: sw-calibration-access=READ-ONLY, type=UInt16
    Count_Cnt_u32
      data Cnt_u32: sw-calibration-access=READ-ONLY, type=UInt32
    Counter
      data Cnt_u08: sw-calibration-access=READ-ONLY, type=UInt8
    Counts32
      data Cnt_u32: sw-calibration-access=READ-ONLY, type=UInt32
    Current
      data Amp_f32: sw-calibration-access=READ-ONLY, type=Float
    Current_Amp_f32
      data Amp_f32: sw-calibration-access=READ-ONLY, type=Float
    CurrentSqr
      data AmpSq_f32: type=Float
    CurrOffProcessFlag
      data Cnt_enum: sw-calibration-access=READ-ONLY, type=MtrCurrOffProcessFlag
    Cycles
      data Cnt_u08: sw-calibration-access=READ-ONLY, type=UInt8
    DeadTimeComp
      data Uls_f32: sw-calibration-access=READ-ONLY, type=Float
    DefaultVehSpd
      data Cnt_lgc: sw-calibration-access=READ-ONLY, type=Boolean
    DefeatDutySvc_Cnt_lgc
      data Cnt_lgc: sw-calibration-access=READ-ONLY, type=Boolean
    DefeatFricLearning
      data Cnt_lgc: sw-calibration-access=READ-ONLY, type=Boolean
    Direction
      data Cnt_s08: sw-calibration-access=READ-ONLY, type=SInt8
    Direction_Cnt_s08
      data Cnt_s08: sw-calibration-access=READ-ONLY, type=SInt8
    DSTSTATE
      data Uls_enum: sw-calibration-access=READ-ONLY, type=TOC_STATE
    DummyRxPort
      data DummyRxSignal: type=DummyRxSignal
    DutyCycleCounts
      data Cnt_u16: sw-calibration-access=READ-ONLY, type=UInt16
    DutyCycleSmall
      data Cnt_u16: sw-calibration-access=READ-ONLY, type=UInt16
    EcuM_CurrentMode: is-service=true
      mode declaration group prototype currentMode: type=EcuM_Mode
    ElPwDStatStrtStop
      data Cnt_enum: type=ElPwDStatStrtStopType
    Enable
      data Cnt_lgc: sw-calibration-access=READ-ONLY, type=Boolean
    Enable_Cnt_lgc
      data Cnt_lgc: sw-calibration-access=READ-ONLY, type=Boolean
    EnergyModeState
      data Cnt_enum: sw-calibration-access=READ-ONLY, type=EnergyModeStateType
    EOLMtrSnsrAdjParam
      12 x data, all with sw-calibration-access=READ-ONLY, type=Float:
        EOLCos1AmpRec_Uls_f32
        EOLCos1GainCorr_Uls_f32
        EOLCos1Offset_Volts_f32
        EOLCos1OffsetCorr_Volts_f32
        EOLCos2AmpRec_Uls_f32
        EOLCos2Offset_Volts_f32
        EOLSin1AmpRec_Uls_f32
        EOLSin1GainCorr_Uls_f32
        EOLSin1Offset_Volts_f32
        EOLSin1OffsetCorr_Volts_f32
        EOLSin2AmpRec_Uls_f32
        EOLSin2Offset_Volts_f32
    EOTDisable_Cnt_T_lgc
      data Cnt_lgc: sw-calibration-access=READ-ONLY, type=Boolean
    ErrorMaskMode
      data Cnt_b32: sw-calibration-access=READ-ONLY, type=UInt32
    EstKe
      data VpRadpS_f32: sw-calibration-access=READ-ONLY, type=Float
    EstL
      data Henry_f32: sw-calibration-access=READ-ONLY, type=Float
    EstR
      data Ohm_f32: sw-calibration-access=READ-ONLY, type=Float
    FETFaultPhase
      data Cnt_enum: sw-calibration-access=READ-ONLY, type=FETPHASETYPE_ENUM
    FETFaultType
      data Cnt_enum: sw-calibration-access=READ-ONLY, type=FETFAULTTYPE_ENUM
    Force_kN_f32
      data kN_f32: sw-calibration-access=READ-ONLY, type=Float
    ForcekN
      data kN_f32: type=Float
    Frequency
      data Hz_f32: sw-calibration-access=READ-ONLY, type=Float
    Frequency_Hz_f32
      data Hz_f32: sw-calibration-access=READ-ONLY, type=Float
    Haptic_State_enum
      data State_enum: type=Haptic_State_enum
    HwAccel
      data HwDegpSecSqr_f32: sw-calibration-access=READ-ONLY, type=Float
    HwAccel_HwDegpSecSqr_f32
      data HwDegpSecSqr_f32: sw-calibration-access=READ-ONLY, type=Float
    HwNmSq_f32
      data HwNmSq_f32: type=Float
    HwPos
      data HwDeg_f32: sw-calibration-access=READ-ONLY, type=Float
    HwPos_HwDeg_f32
      data HwDeg_f32: sw-calibration-access=READ-ONLY, type=Float
    HwTrq
      data HwNm_f32: sw-calibration-access=READ-ONLY, type=Float
    HwTrq_HwNm_f32
      data HwNm_f32: sw-calibration-access=READ-ONLY, type=Float
    HwTrqScale_VoltsPerDeg_f32
      data VoltsPerDeg_f32: sw-calibration-access=READ-ONLY, type=Float
    HwTrqSq_HwNmSq_f32
      data HwNmSq_f32: type=Float
    HwTrqStatus_Cnt_enum
      data Cnt_enum: type=HwTrqStatusType
    HwVel
      data HwRadpS_f32: sw-calibration-access=READ-ONLY, type=Float
    HwVel_HwDegpSec_f32
      data HwDegpSec_f32: sw-calibration-access=READ-ONLY, type=Float
    HwVel_HwRadpS_f32
      data HwRadpS_f32: sw-calibration-access=READ-ONLY, type=Float
    HwVelDegpSec
      data HwDegpSec_f32: sw-calibration-access=READ-ONLY, type=Float
    IgnCnt_Cnt_u16
      data Cnt_u16: sw-calibration-access=READ-ONLY, type=UInt16
    Inductance
      data Henry_f32: sw-calibration-access=READ-ONLY, type=Float
    Inductance_Henry_f32
      data Henry_f32: sw-calibration-access=READ-ONLY, type=Float
    InstMtrDir
      data Cnt_s16: sw-calibration-access=READ-ONLY, type=SInt16
    KphpS_f32
      data KphpS_f32: type=Float
    LatAccel_g_f32
      data g_f32: type=Float
    LearnedEOT
      4 x data, all with sw-calibration-access=READ-ONLY:
        CCWFound_Cnt_lgc: type=Boolean
        CCWPosition_HwDeg_f32: type=Float
        CWFound_Cnt_lgc: type=Boolean
        CWPosition_HwDeg_f32: type=Float
    LearnPinionCtrState
      data Cnt_enum: sw-calibration-access=READ-ONLY, type=PinionCtrStateType
    LKA_State_enum
      data State_enum: type=LKA_State_enum
    ManufModes
      data Cnt_enum: sw-calibration-access=READ-ONLY, type=ManufModeType
    ManufModes_Cnt_enum
      data Cnt_enum: sw-calibration-access=READ-ONLY, type=ManufModeType
    ModIdx
      data Uls_f32: sw-calibration-access=READ-ONLY, type=Float
    MtrPos_Deg_f32
      data Deg_f32: sw-calibration-access=READ-ONLY, type=Float
    MtrPos_Rad_f32
      data Rad_f32: sw-calibration-access=READ-ONLY, type=Float
    MtrPos_Rev_f32
      data Rev_f32: sw-calibration-access=READ-ONLY, type=Float
    MtrPos_Rev_u0p16
      data Rev_u0p16: sw-calibration-access=READ-ONLY, type=UInt16
    MtrPosDeg
      data Deg_f32: sw-calibration-access=READ-ONLY, type=Float
    MtrPosGain
      data Uls_f32: sw-calibration-access=READ-ONLY, type=Float
    MtrPosOffset
      data Volts_f32: sw-calibration-access=READ-ONLY, type=Float
    MtrPosRev
      data Rev_f32: sw-calibration-access=READ-ONLY, type=Float
    MtrQuad
      data Cnt_u08: sw-calibration-access=READ-ONLY, type=UInt8
    MtrQuad_Cnt_u08
      data Cnt_u08: sw-calibration-access=READ-ONLY, type=UInt8
    MtrQuad_deprecated
      data Cnt_u16: sw-calibration-access=READ-ONLY, type=UInt16
    MtrRevCntr
      data Cnt_s16: sw-calibration-access=READ-ONLY, type=SInt16
    MtrTrq
      data MtrNm_f32: sw-calibration-access=READ-ONLY, type=Float
    MtrTrq_MtrNm_f32
      data MtrNm_f32: sw-calibration-access=READ-ONLY, type=Float
    MtrTrqCmdSign
      data Cnt_s16: sw-calibration-access=READ-ONLY, type=SInt16
    MtrVel
      data MtrRadpS_f32: sw-calibration-access=READ-ONLY, type=Float
    MtrVel_MtrRadpS_f32
      data MtrRadpS_f32: sw-calibration-access=READ-ONLY, type=Float
    MtrVltConstant
      data VpRadpS_f32: sw-calibration-access=READ-ONLY, type=Float
    MtrVltConstant_VpRadpS_f32
      data VpRadpS_f32: sw-calibration-access=READ-ONLY, type=Float
    NET_CFG_STAT_PT
      data DE_NET_CFG_STAT_PT: type=UInt8
    OscTrajState
      data Cnt_enum: sw-calibration-access=READ-ONLY, type=OscTrajCmdStateType
    PADelta1
      data Cnt_u16: sw-calibration-access=READ-ONLY, type=UInt16
    Personalization
      data Cnt_enum: sw-calibration-access=READ-ONLY, type=PersonalizationType
    PhaseAdvance
      data Cnt_s16: sw-calibration-access=READ-ONLY, type=SInt16
    PhaseAdvFinal
      data Cnt_u16: sw-calibration-access=READ-ONLY, type=UInt16
    PhsAdv
      data Cnt_s16: sw-calibration-access=READ-ONLY, type=SInt16
    PhsAdv_Cnt_s16
      data Cnt_s16: sw-calibration-access=READ-ONLY, type=SInt16
    PhsReas
      data Volts_f32: sw-calibration-access=READ-ONLY, type=Float
    PI_Authority
      data Uls_f32: sw-calibration-access=READ-ONLY, type=Float
    PI_Current
      data Amp_f32: sw-calibration-access=READ-ONLY, type=Float
    PI_EnableFlag
      data Cnt_lgc: sw-calibration-access=READ-ONLY, type=Boolean
    PI_HandwheelPosition
      data HwDeg_f32: sw-calibration-access=READ-ONLY, type=Float
    PI_HandwheelTorque
      data HwNm_f32: sw-calibration-access=READ-ONLY, type=Float
    PI_MotorTorque
      data MtrNm_f32: sw-calibration-access=READ-ONLY, type=Float
    PI_MotorVelocity
      data MtrRadpS_f32: sw-calibration-access=READ-ONLY, type=Float
    PI_MtrPosDeg
      data Deg_f32: sw-calibration-access=READ-ONLY, type=Float
    PI_MtrPosRev
      data Rev_f32: sw-calibration-access=READ-ONLY, type=Float
    PI_NTCActionFlags
      data Cnt_lgc: sw-calibration-access=READ-ONLY, type=Boolean
    PI_PkCurr
      data AmpSq_f32: sw-calibration-access=READ-ONLY, type=Float
    PI_RawADCSig
      data Volts_f32: sw-calibration-access=READ-ONLY, type=Float
    PI_Temperature
      data DegC_f32: sw-calibration-access=READ-ONLY, type=Float
    PI_Validity
      data Cnt_lgc: sw-calibration-access=READ-ONLY, type=Boolean
    PI_VehSpd
      data Kph_f32: sw-calibration-access=READ-ONLY, type=Float
    PkCurr
      data AmpSq_f32: sw-calibration-access=READ-ONLY, type=Float
    PkCurr_AmpSq_f32
      data AmpSq_f32: sw-calibration-access=READ-ONLY, type=Float
    PlCmp_DisableLearning_Cnt_lgc
      data Cnt_lgc: type=Boolean
    Polarity
      data Cnt_s8: sw-calibration-access=READ-ONLY, type=SInt8
    Polarity_Cnt_s8
      data Cnt_s8: sw-calibration-access=READ-ONLY, type=SInt8
    Power_Watt_f32
      data Watt_f32: sw-calibration-access=READ-ONLY, type=Float
    PwPckTqDStat
      data Cnt_enum: type=PwPckTqDStatType
    RacktoVehCntrOffset
      data Cnt_u16: sw-calibration-access=READ-ONLY, type=UInt16
    RampRate
      data XpmS_f32: sw-calibration-access=READ-ONLY, type=Float
    RampRate_XpmS_f32
      data XpmS_f32: sw-calibration-access=READ-ONLY, type=Float
    Resistance
      data Ohm_f32: sw-calibration-access=READ-ONLY, type=Float
    Resistance_Ohm_f32
      data Ohm_f32: sw-calibration-access=READ-ONLY, type=Float
    RevOffsetState
      data Cnt_u08: sw-calibration-access=READ-ONLY, type=UInt8
    Rx_Driving_Mode_Control_HS
      data Driving_Mode_Control_HS: sw-calibration-access=READ-ONLY, type=RT_Driving_Mode_Control_HS
    Rx_Engine_General_Status_1
      data Engine_General_Status_1: sw-calibration-access=READ-ONLY, type=RT_Engine_General_Status_1
    Rx_PPEI_NonDrivn_Whl_Rotationl_Stat
      data PPEI_NonDrivn_Whl_Rotationl_Stat: sw-calibration-access=READ-ONLY, type=RT_PPEI_NonDrivn_Whl_Rotationl_Stat
    Rx_PPEI_Platform_General_Status
      data PPEI_Platform_General_Status: sw-calibration-access=READ-ONLY, type=RT_PPEI_Platform_General_Status
    Rx_PPEI_Steering_Wheel_Angle_CE
      data PPEI_Steering_Wheel_Angle_CE: sw-calibration-access=READ-ONLY, type=RT_PPEI_Steering_Wheel_Angle_CE
    Rx_PPEI_Vehicle_Speed_and_Distance
      data PPEI_Vehicle_Speed_and_Distance: sw-calibration-access=READ-ONLY, type=RT_PPEI_Vheicle_Speed_and_Distance
    Rx_Trans_General_Status_2
      data Trans_General_Status_2: sw-calibration-access=READ-ONLY, type=RT_Trans_General_Status_2
    Rx_Wheel_Pulses_HS
      data Wheel_Pulses_HS: sw-calibration-access=READ-ONLY, type=RT_Wheel_Pulses_HS
    ScaleFactor
      data Uls_f32: sw-calibration-access=READ-ONLY, type=Float
    ScaleFactor_Uls_f32
      data Uls_f32: sw-calibration-access=READ-ONLY, type=Float
    SignalValidity
      data Cnt_lgc: sw-calibration-access=READ-ONLY, type=Boolean
    SrlComEngOn
      data Cnt_lgc: sw-calibration-access=READ-ONLY, type=Boolean
    SrlComRevOffset
      data Rev_s16: sw-calibration-access=READ-ONLY, type=SInt16
    SrlComRevOffsetStatus
      data Cnt_u08: sw-calibration-access=READ-ONLY, type=ST_OFFS_QUAD_EPS
    SrlComSPMOn
      data Cnt_lgc: sw-calibration-access=READ-ONLY, type=Boolean
    SrlComSvcDft
      data Cnt_b32: sw-calibration-access=READ-ONLY, type=UInt32
    StaMdsTerm
      data Cnt_lgc: sw-calibration-access=READ-ONLY, type=Boolean
    SWDutyCycle
      data Uls_f32: type=Float
    SystemState
      mode declaration group prototype Mode: type=StaMd_Mode
    Temp_DegC_u16
      data DegC_u16: type=UInt16
    Temperature
      data DegC_f32: sw-calibration-access=READ-ONLY, type=Float
    Temperature_DegC_f32
      data DegC_f32: sw-calibration-access=READ-ONLY, type=Float
    ThermalAssistScl
      data Uls_f32: sw-calibration-access=READ-ONLY, type=Float
    Time_USec_u32
      data USec_u32: sw-calibration-access=READ-ONLY, type=UInt32
    TrqLmt
      data Pct_f32: sw-calibration-access=READ-ONLY, type=Float
    TuningSessionActPtr
      data Cnt_u8: sw-calibration-access=READ-ONLY, type=TuningSessionAddrPtrEnum
    TunPersSelect
      data Cnt_u16: sw-calibration-access=READ-ONLY, type=UInt16
    Tx_DTC_Triggered_778
      data DTC_Triggered_778: sw-calibration-access=READ-ONLY, type=RT_DTC_Triggered_778
    Tx_Power_Steering_Information_HS
      data Power_Steering_Information_HS: sw-calibration-access=READ-ONLY, type=RT_Power_Steering_Information_HS
    Uls_f32
      data Uls_f32: type=Float
    UnityScalar
      data Uls_f32: sw-calibration-access=READ-ONLY, type=Float
    UnityScalar_Uls_f32
      data Uls_f32: sw-calibration-access=READ-ONLY, type=Float
    Validity
      data Cnt_lgc: sw-calibration-access=READ-ONLY, type=Boolean
    Validity_Cnt_lgc
      data Cnt_lgc: sw-calibration-access=READ-ONLY, type=Boolean
    Vecu
      data Volt_f32: sw-calibration-access=READ-ONLY, range raw >5..<31, type=Float  # This port prototype is inteded to communicate voltage signals that represent the ecu supplied voltage. This signal has a lower limit, which is non-zero, to allow users of the signal to use it as a denominator in an expression without requiring a divide by 0 check.
    Vecu_deprecated
      data Volts_f32: sw-calibration-access=READ-ONLY, range phys >5..<31, type=Float
    Vecu_Volt_f32
      data Volt_f32: sw-calibration-access=READ-ONLY, range raw >5..<31, type=Float  # This port prototype is inteded to communicate voltage signals that represent the ecu supplied voltage. This signal has a lower limit, which is non-zero, to allow users of the signal to use it as a denominator in an expression without requiring a divide by 0 check.
    VehAccel
      data KphpS_f32: sw-calibration-access=READ-ONLY, type=Float
    VehAccel_KphpS_f32
      data KphpS_f32: sw-calibration-access=READ-ONLY, type=Float
    VehSpd
      data Kph_f32: sw-calibration-access=READ-ONLY, type=Float
    VehSpd_Kph_f32
      data Kph_f32: sw-calibration-access=READ-ONLY, type=Float
    VltgCtrlTerm
      data Uls_f32: sw-calibration-access=READ-ONLY, type=Float
    VltgCtrlTerm_Uls_f32
      data Uls_f32: sw-calibration-access=READ-ONLY, type=Float
    Voltage
      data Volt_f32: sw-calibration-access=READ-ONLY, range raw >0..<31, type=Float  # This signal is intended to communicate any type voltage signal measured by the ecu. This signal has a lower limit of 0 which reequires users of the signal to provide divide by 0 protection if it is used as a denominator in a calculation. See Vecu port prototype if a port with a lower limit is desired.
    Voltage_Volt_f32
      data Volt_f32: sw-calibration-access=READ-ONLY, range raw >0..<31, type=Float  # This signal is intended to communicate any type voltage signal measured by the ecu. This signal has a lower limit of 0 which reequires users of the signal to provide divide by 0 protection if it is used as a denominator in a calculation. See Vecu port prototype if a port with a lower limit is desired.
    VswitchClosed
      data Cnt_lgc: sw-calibration-access=READ-ONLY, type=Boolean
    WhlSpd
      data cRadPerSec_u16: sw-calibration-access=READ-ONLY, type=UInt16
    WhlSpd_Hz_f32
      data Hz_f32: type=Float
    YawRate
      data DegpS_f32: sw-calibration-access=READ-ONLY, type=Float
    YawRate_DegpS_f32
      data DegpS_f32: sw-calibration-access=READ-ONLY, type=Float
